;
; File Name: cyfitteriar.inc
; 
; PSoC Creator  4.2
;
; Description:
; 
;
;-------------------------------------------------------------------------------
; Copyright (c) 2007-2018 Cypress Semiconductor.  All rights reserved.
; You may use this file only in accordance with the license, terms, conditions, 
; disclaimers, and limitations in the end user license agreement accompanying 
; the software package with which this file was provided.
;-------------------------------------------------------------------------------

#ifndef INCLUDED_CYFITTERIAR_INC
#define INCLUDED_CYFITTERIAR_INC
    INCLUDE cydeviceiar.inc
    INCLUDE cydeviceiar_trm.inc

/* LEFT_HA */
LEFT_HA__0__INTTYPE EQU CYREG_PICU0_INTTYPE1
LEFT_HA__0__MASK EQU 0x02
LEFT_HA__0__PC EQU CYREG_PRT0_PC1
LEFT_HA__0__PORT EQU 0
LEFT_HA__0__SHIFT EQU 1
LEFT_HA__AG EQU CYREG_PRT0_AG
LEFT_HA__AMUX EQU CYREG_PRT0_AMUX
LEFT_HA__BIE EQU CYREG_PRT0_BIE
LEFT_HA__BIT_MASK EQU CYREG_PRT0_BIT_MASK
LEFT_HA__BYP EQU CYREG_PRT0_BYP
LEFT_HA__CTL EQU CYREG_PRT0_CTL
LEFT_HA__DM0 EQU CYREG_PRT0_DM0
LEFT_HA__DM1 EQU CYREG_PRT0_DM1
LEFT_HA__DM2 EQU CYREG_PRT0_DM2
LEFT_HA__DR EQU CYREG_PRT0_DR
LEFT_HA__INP_DIS EQU CYREG_PRT0_INP_DIS
LEFT_HA__INTTYPE_BASE EQU CYDEV_PICU_INTTYPE_PICU0_BASE
LEFT_HA__LCD_COM_SEG EQU CYREG_PRT0_LCD_COM_SEG
LEFT_HA__LCD_EN EQU CYREG_PRT0_LCD_EN
LEFT_HA__MASK EQU 0x02
LEFT_HA__PORT EQU 0
LEFT_HA__PRT EQU CYREG_PRT0_PRT
LEFT_HA__PRTDSI__CAPS_SEL EQU CYREG_PRT0_CAPS_SEL
LEFT_HA__PRTDSI__DBL_SYNC_IN EQU CYREG_PRT0_DBL_SYNC_IN
LEFT_HA__PRTDSI__OE_SEL0 EQU CYREG_PRT0_OE_SEL0
LEFT_HA__PRTDSI__OE_SEL1 EQU CYREG_PRT0_OE_SEL1
LEFT_HA__PRTDSI__OUT_SEL0 EQU CYREG_PRT0_OUT_SEL0
LEFT_HA__PRTDSI__OUT_SEL1 EQU CYREG_PRT0_OUT_SEL1
LEFT_HA__PRTDSI__SYNC_OUT EQU CYREG_PRT0_SYNC_OUT
LEFT_HA__PS EQU CYREG_PRT0_PS
LEFT_HA__SHIFT EQU 1
LEFT_HA__SLW EQU CYREG_PRT0_SLW

/* LEFT_HB */
LEFT_HB__0__INTTYPE EQU CYREG_PICU0_INTTYPE3
LEFT_HB__0__MASK EQU 0x08
LEFT_HB__0__PC EQU CYREG_PRT0_PC3
LEFT_HB__0__PORT EQU 0
LEFT_HB__0__SHIFT EQU 3
LEFT_HB__AG EQU CYREG_PRT0_AG
LEFT_HB__AMUX EQU CYREG_PRT0_AMUX
LEFT_HB__BIE EQU CYREG_PRT0_BIE
LEFT_HB__BIT_MASK EQU CYREG_PRT0_BIT_MASK
LEFT_HB__BYP EQU CYREG_PRT0_BYP
LEFT_HB__CTL EQU CYREG_PRT0_CTL
LEFT_HB__DM0 EQU CYREG_PRT0_DM0
LEFT_HB__DM1 EQU CYREG_PRT0_DM1
LEFT_HB__DM2 EQU CYREG_PRT0_DM2
LEFT_HB__DR EQU CYREG_PRT0_DR
LEFT_HB__INP_DIS EQU CYREG_PRT0_INP_DIS
LEFT_HB__INTTYPE_BASE EQU CYDEV_PICU_INTTYPE_PICU0_BASE
LEFT_HB__LCD_COM_SEG EQU CYREG_PRT0_LCD_COM_SEG
LEFT_HB__LCD_EN EQU CYREG_PRT0_LCD_EN
LEFT_HB__MASK EQU 0x08
LEFT_HB__PORT EQU 0
LEFT_HB__PRT EQU CYREG_PRT0_PRT
LEFT_HB__PRTDSI__CAPS_SEL EQU CYREG_PRT0_CAPS_SEL
LEFT_HB__PRTDSI__DBL_SYNC_IN EQU CYREG_PRT0_DBL_SYNC_IN
LEFT_HB__PRTDSI__OE_SEL0 EQU CYREG_PRT0_OE_SEL0
LEFT_HB__PRTDSI__OE_SEL1 EQU CYREG_PRT0_OE_SEL1
LEFT_HB__PRTDSI__OUT_SEL0 EQU CYREG_PRT0_OUT_SEL0
LEFT_HB__PRTDSI__OUT_SEL1 EQU CYREG_PRT0_OUT_SEL1
LEFT_HB__PRTDSI__SYNC_OUT EQU CYREG_PRT0_SYNC_OUT
LEFT_HB__PS EQU CYREG_PRT0_PS
LEFT_HB__SHIFT EQU 3
LEFT_HB__SLW EQU CYREG_PRT0_SLW

/* LEFT_HC */
LEFT_HC__0__INTTYPE EQU CYREG_PICU0_INTTYPE5
LEFT_HC__0__MASK EQU 0x20
LEFT_HC__0__PC EQU CYREG_PRT0_PC5
LEFT_HC__0__PORT EQU 0
LEFT_HC__0__SHIFT EQU 5
LEFT_HC__AG EQU CYREG_PRT0_AG
LEFT_HC__AMUX EQU CYREG_PRT0_AMUX
LEFT_HC__BIE EQU CYREG_PRT0_BIE
LEFT_HC__BIT_MASK EQU CYREG_PRT0_BIT_MASK
LEFT_HC__BYP EQU CYREG_PRT0_BYP
LEFT_HC__CTL EQU CYREG_PRT0_CTL
LEFT_HC__DM0 EQU CYREG_PRT0_DM0
LEFT_HC__DM1 EQU CYREG_PRT0_DM1
LEFT_HC__DM2 EQU CYREG_PRT0_DM2
LEFT_HC__DR EQU CYREG_PRT0_DR
LEFT_HC__INP_DIS EQU CYREG_PRT0_INP_DIS
LEFT_HC__INTTYPE_BASE EQU CYDEV_PICU_INTTYPE_PICU0_BASE
LEFT_HC__LCD_COM_SEG EQU CYREG_PRT0_LCD_COM_SEG
LEFT_HC__LCD_EN EQU CYREG_PRT0_LCD_EN
LEFT_HC__MASK EQU 0x20
LEFT_HC__PORT EQU 0
LEFT_HC__PRT EQU CYREG_PRT0_PRT
LEFT_HC__PRTDSI__CAPS_SEL EQU CYREG_PRT0_CAPS_SEL
LEFT_HC__PRTDSI__DBL_SYNC_IN EQU CYREG_PRT0_DBL_SYNC_IN
LEFT_HC__PRTDSI__OE_SEL0 EQU CYREG_PRT0_OE_SEL0
LEFT_HC__PRTDSI__OE_SEL1 EQU CYREG_PRT0_OE_SEL1
LEFT_HC__PRTDSI__OUT_SEL0 EQU CYREG_PRT0_OUT_SEL0
LEFT_HC__PRTDSI__OUT_SEL1 EQU CYREG_PRT0_OUT_SEL1
LEFT_HC__PRTDSI__SYNC_OUT EQU CYREG_PRT0_SYNC_OUT
LEFT_HC__PS EQU CYREG_PRT0_PS
LEFT_HC__SHIFT EQU 5
LEFT_HC__SLW EQU CYREG_PRT0_SLW

/* LEFT_LA */
LEFT_LA__0__INTTYPE EQU CYREG_PICU0_INTTYPE2
LEFT_LA__0__MASK EQU 0x04
LEFT_LA__0__PC EQU CYREG_PRT0_PC2
LEFT_LA__0__PORT EQU 0
LEFT_LA__0__SHIFT EQU 2
LEFT_LA__AG EQU CYREG_PRT0_AG
LEFT_LA__AMUX EQU CYREG_PRT0_AMUX
LEFT_LA__BIE EQU CYREG_PRT0_BIE
LEFT_LA__BIT_MASK EQU CYREG_PRT0_BIT_MASK
LEFT_LA__BYP EQU CYREG_PRT0_BYP
LEFT_LA__CTL EQU CYREG_PRT0_CTL
LEFT_LA__DM0 EQU CYREG_PRT0_DM0
LEFT_LA__DM1 EQU CYREG_PRT0_DM1
LEFT_LA__DM2 EQU CYREG_PRT0_DM2
LEFT_LA__DR EQU CYREG_PRT0_DR
LEFT_LA__INP_DIS EQU CYREG_PRT0_INP_DIS
LEFT_LA__INTTYPE_BASE EQU CYDEV_PICU_INTTYPE_PICU0_BASE
LEFT_LA__LCD_COM_SEG EQU CYREG_PRT0_LCD_COM_SEG
LEFT_LA__LCD_EN EQU CYREG_PRT0_LCD_EN
LEFT_LA__MASK EQU 0x04
LEFT_LA__PORT EQU 0
LEFT_LA__PRT EQU CYREG_PRT0_PRT
LEFT_LA__PRTDSI__CAPS_SEL EQU CYREG_PRT0_CAPS_SEL
LEFT_LA__PRTDSI__DBL_SYNC_IN EQU CYREG_PRT0_DBL_SYNC_IN
LEFT_LA__PRTDSI__OE_SEL0 EQU CYREG_PRT0_OE_SEL0
LEFT_LA__PRTDSI__OE_SEL1 EQU CYREG_PRT0_OE_SEL1
LEFT_LA__PRTDSI__OUT_SEL0 EQU CYREG_PRT0_OUT_SEL0
LEFT_LA__PRTDSI__OUT_SEL1 EQU CYREG_PRT0_OUT_SEL1
LEFT_LA__PRTDSI__SYNC_OUT EQU CYREG_PRT0_SYNC_OUT
LEFT_LA__PS EQU CYREG_PRT0_PS
LEFT_LA__SHIFT EQU 2
LEFT_LA__SLW EQU CYREG_PRT0_SLW

/* LEFT_LB */
LEFT_LB__0__INTTYPE EQU CYREG_PICU0_INTTYPE4
LEFT_LB__0__MASK EQU 0x10
LEFT_LB__0__PC EQU CYREG_PRT0_PC4
LEFT_LB__0__PORT EQU 0
LEFT_LB__0__SHIFT EQU 4
LEFT_LB__AG EQU CYREG_PRT0_AG
LEFT_LB__AMUX EQU CYREG_PRT0_AMUX
LEFT_LB__BIE EQU CYREG_PRT0_BIE
LEFT_LB__BIT_MASK EQU CYREG_PRT0_BIT_MASK
LEFT_LB__BYP EQU CYREG_PRT0_BYP
LEFT_LB__CTL EQU CYREG_PRT0_CTL
LEFT_LB__DM0 EQU CYREG_PRT0_DM0
LEFT_LB__DM1 EQU CYREG_PRT0_DM1
LEFT_LB__DM2 EQU CYREG_PRT0_DM2
LEFT_LB__DR EQU CYREG_PRT0_DR
LEFT_LB__INP_DIS EQU CYREG_PRT0_INP_DIS
LEFT_LB__INTTYPE_BASE EQU CYDEV_PICU_INTTYPE_PICU0_BASE
LEFT_LB__LCD_COM_SEG EQU CYREG_PRT0_LCD_COM_SEG
LEFT_LB__LCD_EN EQU CYREG_PRT0_LCD_EN
LEFT_LB__MASK EQU 0x10
LEFT_LB__PORT EQU 0
LEFT_LB__PRT EQU CYREG_PRT0_PRT
LEFT_LB__PRTDSI__CAPS_SEL EQU CYREG_PRT0_CAPS_SEL
LEFT_LB__PRTDSI__DBL_SYNC_IN EQU CYREG_PRT0_DBL_SYNC_IN
LEFT_LB__PRTDSI__OE_SEL0 EQU CYREG_PRT0_OE_SEL0
LEFT_LB__PRTDSI__OE_SEL1 EQU CYREG_PRT0_OE_SEL1
LEFT_LB__PRTDSI__OUT_SEL0 EQU CYREG_PRT0_OUT_SEL0
LEFT_LB__PRTDSI__OUT_SEL1 EQU CYREG_PRT0_OUT_SEL1
LEFT_LB__PRTDSI__SYNC_OUT EQU CYREG_PRT0_SYNC_OUT
LEFT_LB__PS EQU CYREG_PRT0_PS
LEFT_LB__SHIFT EQU 4
LEFT_LB__SLW EQU CYREG_PRT0_SLW

/* LEFT_LC */
LEFT_LC__0__INTTYPE EQU CYREG_PICU0_INTTYPE6
LEFT_LC__0__MASK EQU 0x40
LEFT_LC__0__PC EQU CYREG_PRT0_PC6
LEFT_LC__0__PORT EQU 0
LEFT_LC__0__SHIFT EQU 6
LEFT_LC__AG EQU CYREG_PRT0_AG
LEFT_LC__AMUX EQU CYREG_PRT0_AMUX
LEFT_LC__BIE EQU CYREG_PRT0_BIE
LEFT_LC__BIT_MASK EQU CYREG_PRT0_BIT_MASK
LEFT_LC__BYP EQU CYREG_PRT0_BYP
LEFT_LC__CTL EQU CYREG_PRT0_CTL
LEFT_LC__DM0 EQU CYREG_PRT0_DM0
LEFT_LC__DM1 EQU CYREG_PRT0_DM1
LEFT_LC__DM2 EQU CYREG_PRT0_DM2
LEFT_LC__DR EQU CYREG_PRT0_DR
LEFT_LC__INP_DIS EQU CYREG_PRT0_INP_DIS
LEFT_LC__INTTYPE_BASE EQU CYDEV_PICU_INTTYPE_PICU0_BASE
LEFT_LC__LCD_COM_SEG EQU CYREG_PRT0_LCD_COM_SEG
LEFT_LC__LCD_EN EQU CYREG_PRT0_LCD_EN
LEFT_LC__MASK EQU 0x40
LEFT_LC__PORT EQU 0
LEFT_LC__PRT EQU CYREG_PRT0_PRT
LEFT_LC__PRTDSI__CAPS_SEL EQU CYREG_PRT0_CAPS_SEL
LEFT_LC__PRTDSI__DBL_SYNC_IN EQU CYREG_PRT0_DBL_SYNC_IN
LEFT_LC__PRTDSI__OE_SEL0 EQU CYREG_PRT0_OE_SEL0
LEFT_LC__PRTDSI__OE_SEL1 EQU CYREG_PRT0_OE_SEL1
LEFT_LC__PRTDSI__OUT_SEL0 EQU CYREG_PRT0_OUT_SEL0
LEFT_LC__PRTDSI__OUT_SEL1 EQU CYREG_PRT0_OUT_SEL1
LEFT_LC__PRTDSI__SYNC_OUT EQU CYREG_PRT0_SYNC_OUT
LEFT_LC__PS EQU CYREG_PRT0_PS
LEFT_LC__SHIFT EQU 6
LEFT_LC__SLW EQU CYREG_PRT0_SLW

/* LEFT_DIR */
LEFT_DIR__0__INTTYPE EQU CYREG_PICU15_INTTYPE0
LEFT_DIR__0__MASK EQU 0x01
LEFT_DIR__0__PC EQU CYREG_IO_PC_PRT15_PC0
LEFT_DIR__0__PORT EQU 15
LEFT_DIR__0__SHIFT EQU 0
LEFT_DIR__AG EQU CYREG_PRT15_AG
LEFT_DIR__AMUX EQU CYREG_PRT15_AMUX
LEFT_DIR__BIE EQU CYREG_PRT15_BIE
LEFT_DIR__BIT_MASK EQU CYREG_PRT15_BIT_MASK
LEFT_DIR__BYP EQU CYREG_PRT15_BYP
LEFT_DIR__CTL EQU CYREG_PRT15_CTL
LEFT_DIR__DM0 EQU CYREG_PRT15_DM0
LEFT_DIR__DM1 EQU CYREG_PRT15_DM1
LEFT_DIR__DM2 EQU CYREG_PRT15_DM2
LEFT_DIR__DR EQU CYREG_PRT15_DR
LEFT_DIR__INP_DIS EQU CYREG_PRT15_INP_DIS
LEFT_DIR__INTTYPE_BASE EQU CYDEV_PICU_INTTYPE_PICU15_BASE
LEFT_DIR__LCD_COM_SEG EQU CYREG_PRT15_LCD_COM_SEG
LEFT_DIR__LCD_EN EQU CYREG_PRT15_LCD_EN
LEFT_DIR__MASK EQU 0x01
LEFT_DIR__PORT EQU 15
LEFT_DIR__PRT EQU CYREG_PRT15_PRT
LEFT_DIR__PRTDSI__CAPS_SEL EQU CYREG_PRT15_CAPS_SEL
LEFT_DIR__PRTDSI__DBL_SYNC_IN EQU CYREG_PRT15_DBL_SYNC_IN
LEFT_DIR__PRTDSI__OE_SEL0 EQU CYREG_PRT15_OE_SEL0
LEFT_DIR__PRTDSI__OE_SEL1 EQU CYREG_PRT15_OE_SEL1
LEFT_DIR__PRTDSI__OUT_SEL0 EQU CYREG_PRT15_OUT_SEL0
LEFT_DIR__PRTDSI__OUT_SEL1 EQU CYREG_PRT15_OUT_SEL1
LEFT_DIR__PRTDSI__SYNC_OUT EQU CYREG_PRT15_SYNC_OUT
LEFT_DIR__PS EQU CYREG_PRT15_PS
LEFT_DIR__SHIFT EQU 0
LEFT_DIR__SLW EQU CYREG_PRT15_SLW

/* LEFT_HALL_A */
LEFT_HALL_A__0__INTTYPE EQU CYREG_PICU1_INTTYPE5
LEFT_HALL_A__0__MASK EQU 0x20
LEFT_HALL_A__0__PC EQU CYREG_PRT1_PC5
LEFT_HALL_A__0__PORT EQU 1
LEFT_HALL_A__0__SHIFT EQU 5
LEFT_HALL_A__AG EQU CYREG_PRT1_AG
LEFT_HALL_A__AMUX EQU CYREG_PRT1_AMUX
LEFT_HALL_A__BIE EQU CYREG_PRT1_BIE
LEFT_HALL_A__BIT_MASK EQU CYREG_PRT1_BIT_MASK
LEFT_HALL_A__BYP EQU CYREG_PRT1_BYP
LEFT_HALL_A__CTL EQU CYREG_PRT1_CTL
LEFT_HALL_A__DM0 EQU CYREG_PRT1_DM0
LEFT_HALL_A__DM1 EQU CYREG_PRT1_DM1
LEFT_HALL_A__DM2 EQU CYREG_PRT1_DM2
LEFT_HALL_A__DR EQU CYREG_PRT1_DR
LEFT_HALL_A__INP_DIS EQU CYREG_PRT1_INP_DIS
LEFT_HALL_A__INTTYPE_BASE EQU CYDEV_PICU_INTTYPE_PICU1_BASE
LEFT_HALL_A__LCD_COM_SEG EQU CYREG_PRT1_LCD_COM_SEG
LEFT_HALL_A__LCD_EN EQU CYREG_PRT1_LCD_EN
LEFT_HALL_A__MASK EQU 0x20
LEFT_HALL_A__PORT EQU 1
LEFT_HALL_A__PRT EQU CYREG_PRT1_PRT
LEFT_HALL_A__PRTDSI__CAPS_SEL EQU CYREG_PRT1_CAPS_SEL
LEFT_HALL_A__PRTDSI__DBL_SYNC_IN EQU CYREG_PRT1_DBL_SYNC_IN
LEFT_HALL_A__PRTDSI__OE_SEL0 EQU CYREG_PRT1_OE_SEL0
LEFT_HALL_A__PRTDSI__OE_SEL1 EQU CYREG_PRT1_OE_SEL1
LEFT_HALL_A__PRTDSI__OUT_SEL0 EQU CYREG_PRT1_OUT_SEL0
LEFT_HALL_A__PRTDSI__OUT_SEL1 EQU CYREG_PRT1_OUT_SEL1
LEFT_HALL_A__PRTDSI__SYNC_OUT EQU CYREG_PRT1_SYNC_OUT
LEFT_HALL_A__PS EQU CYREG_PRT1_PS
LEFT_HALL_A__SHIFT EQU 5
LEFT_HALL_A__SLW EQU CYREG_PRT1_SLW

/* LEFT_HALL_B */
LEFT_HALL_B__0__INTTYPE EQU CYREG_PICU1_INTTYPE6
LEFT_HALL_B__0__MASK EQU 0x40
LEFT_HALL_B__0__PC EQU CYREG_PRT1_PC6
LEFT_HALL_B__0__PORT EQU 1
LEFT_HALL_B__0__SHIFT EQU 6
LEFT_HALL_B__AG EQU CYREG_PRT1_AG
LEFT_HALL_B__AMUX EQU CYREG_PRT1_AMUX
LEFT_HALL_B__BIE EQU CYREG_PRT1_BIE
LEFT_HALL_B__BIT_MASK EQU CYREG_PRT1_BIT_MASK
LEFT_HALL_B__BYP EQU CYREG_PRT1_BYP
LEFT_HALL_B__CTL EQU CYREG_PRT1_CTL
LEFT_HALL_B__DM0 EQU CYREG_PRT1_DM0
LEFT_HALL_B__DM1 EQU CYREG_PRT1_DM1
LEFT_HALL_B__DM2 EQU CYREG_PRT1_DM2
LEFT_HALL_B__DR EQU CYREG_PRT1_DR
LEFT_HALL_B__INP_DIS EQU CYREG_PRT1_INP_DIS
LEFT_HALL_B__INTTYPE_BASE EQU CYDEV_PICU_INTTYPE_PICU1_BASE
LEFT_HALL_B__LCD_COM_SEG EQU CYREG_PRT1_LCD_COM_SEG
LEFT_HALL_B__LCD_EN EQU CYREG_PRT1_LCD_EN
LEFT_HALL_B__MASK EQU 0x40
LEFT_HALL_B__PORT EQU 1
LEFT_HALL_B__PRT EQU CYREG_PRT1_PRT
LEFT_HALL_B__PRTDSI__CAPS_SEL EQU CYREG_PRT1_CAPS_SEL
LEFT_HALL_B__PRTDSI__DBL_SYNC_IN EQU CYREG_PRT1_DBL_SYNC_IN
LEFT_HALL_B__PRTDSI__OE_SEL0 EQU CYREG_PRT1_OE_SEL0
LEFT_HALL_B__PRTDSI__OE_SEL1 EQU CYREG_PRT1_OE_SEL1
LEFT_HALL_B__PRTDSI__OUT_SEL0 EQU CYREG_PRT1_OUT_SEL0
LEFT_HALL_B__PRTDSI__OUT_SEL1 EQU CYREG_PRT1_OUT_SEL1
LEFT_HALL_B__PRTDSI__SYNC_OUT EQU CYREG_PRT1_SYNC_OUT
LEFT_HALL_B__PS EQU CYREG_PRT1_PS
LEFT_HALL_B__SHIFT EQU 6
LEFT_HALL_B__SLW EQU CYREG_PRT1_SLW

/* LEFT_HALL_C */
LEFT_HALL_C__0__INTTYPE EQU CYREG_PICU1_INTTYPE7
LEFT_HALL_C__0__MASK EQU 0x80
LEFT_HALL_C__0__PC EQU CYREG_PRT1_PC7
LEFT_HALL_C__0__PORT EQU 1
LEFT_HALL_C__0__SHIFT EQU 7
LEFT_HALL_C__AG EQU CYREG_PRT1_AG
LEFT_HALL_C__AMUX EQU CYREG_PRT1_AMUX
LEFT_HALL_C__BIE EQU CYREG_PRT1_BIE
LEFT_HALL_C__BIT_MASK EQU CYREG_PRT1_BIT_MASK
LEFT_HALL_C__BYP EQU CYREG_PRT1_BYP
LEFT_HALL_C__CTL EQU CYREG_PRT1_CTL
LEFT_HALL_C__DM0 EQU CYREG_PRT1_DM0
LEFT_HALL_C__DM1 EQU CYREG_PRT1_DM1
LEFT_HALL_C__DM2 EQU CYREG_PRT1_DM2
LEFT_HALL_C__DR EQU CYREG_PRT1_DR
LEFT_HALL_C__INP_DIS EQU CYREG_PRT1_INP_DIS
LEFT_HALL_C__INTTYPE_BASE EQU CYDEV_PICU_INTTYPE_PICU1_BASE
LEFT_HALL_C__LCD_COM_SEG EQU CYREG_PRT1_LCD_COM_SEG
LEFT_HALL_C__LCD_EN EQU CYREG_PRT1_LCD_EN
LEFT_HALL_C__MASK EQU 0x80
LEFT_HALL_C__PORT EQU 1
LEFT_HALL_C__PRT EQU CYREG_PRT1_PRT
LEFT_HALL_C__PRTDSI__CAPS_SEL EQU CYREG_PRT1_CAPS_SEL
LEFT_HALL_C__PRTDSI__DBL_SYNC_IN EQU CYREG_PRT1_DBL_SYNC_IN
LEFT_HALL_C__PRTDSI__OE_SEL0 EQU CYREG_PRT1_OE_SEL0
LEFT_HALL_C__PRTDSI__OE_SEL1 EQU CYREG_PRT1_OE_SEL1
LEFT_HALL_C__PRTDSI__OUT_SEL0 EQU CYREG_PRT1_OUT_SEL0
LEFT_HALL_C__PRTDSI__OUT_SEL1 EQU CYREG_PRT1_OUT_SEL1
LEFT_HALL_C__PRTDSI__SYNC_OUT EQU CYREG_PRT1_SYNC_OUT
LEFT_HALL_C__PS EQU CYREG_PRT1_PS
LEFT_HALL_C__SHIFT EQU 7
LEFT_HALL_C__SLW EQU CYREG_PRT1_SLW

/* Miscellaneous */
BCLK__BUS_CLK__HZ EQU 24000000
BCLK__BUS_CLK__KHZ EQU 24000
BCLK__BUS_CLK__MHZ EQU 24
CYDEV_CHIP_DIE_LEOPARD EQU 1
CYDEV_CHIP_DIE_PSOC4A EQU 18
CYDEV_CHIP_DIE_PSOC5LP EQU 2
CYDEV_CHIP_DIE_PSOC5TM EQU 3
CYDEV_CHIP_DIE_TMA4 EQU 4
CYDEV_CHIP_DIE_UNKNOWN EQU 0
CYDEV_CHIP_FAMILY_FM0P EQU 5
CYDEV_CHIP_FAMILY_FM3 EQU 6
CYDEV_CHIP_FAMILY_FM4 EQU 7
CYDEV_CHIP_FAMILY_PSOC3 EQU 1
CYDEV_CHIP_FAMILY_PSOC4 EQU 2
CYDEV_CHIP_FAMILY_PSOC5 EQU 3
CYDEV_CHIP_FAMILY_PSOC6 EQU 4
CYDEV_CHIP_FAMILY_UNKNOWN EQU 0
CYDEV_CHIP_FAMILY_USED EQU CYDEV_CHIP_FAMILY_PSOC5
CYDEV_CHIP_JTAG_ID EQU 0x2E161069
CYDEV_CHIP_MEMBER_3A EQU 1
CYDEV_CHIP_MEMBER_4A EQU 18
CYDEV_CHIP_MEMBER_4D EQU 13
CYDEV_CHIP_MEMBER_4E EQU 6
CYDEV_CHIP_MEMBER_4F EQU 19
CYDEV_CHIP_MEMBER_4G EQU 4
CYDEV_CHIP_MEMBER_4H EQU 17
CYDEV_CHIP_MEMBER_4I EQU 23
CYDEV_CHIP_MEMBER_4J EQU 14
CYDEV_CHIP_MEMBER_4K EQU 15
CYDEV_CHIP_MEMBER_4L EQU 22
CYDEV_CHIP_MEMBER_4M EQU 21
CYDEV_CHIP_MEMBER_4N EQU 10
CYDEV_CHIP_MEMBER_4O EQU 7
CYDEV_CHIP_MEMBER_4P EQU 20
CYDEV_CHIP_MEMBER_4Q EQU 12
CYDEV_CHIP_MEMBER_4R EQU 8
CYDEV_CHIP_MEMBER_4S EQU 11
CYDEV_CHIP_MEMBER_4T EQU 9
CYDEV_CHIP_MEMBER_4U EQU 5
CYDEV_CHIP_MEMBER_4V EQU 16
CYDEV_CHIP_MEMBER_5A EQU 3
CYDEV_CHIP_MEMBER_5B EQU 2
CYDEV_CHIP_MEMBER_6A EQU 24
CYDEV_CHIP_MEMBER_FM3 EQU 28
CYDEV_CHIP_MEMBER_FM4 EQU 29
CYDEV_CHIP_MEMBER_PDL_FM0P_TYPE1 EQU 25
CYDEV_CHIP_MEMBER_PDL_FM0P_TYPE2 EQU 26
CYDEV_CHIP_MEMBER_PDL_FM0P_TYPE3 EQU 27
CYDEV_CHIP_MEMBER_UNKNOWN EQU 0
CYDEV_CHIP_MEMBER_USED EQU CYDEV_CHIP_MEMBER_5B
CYDEV_CHIP_DIE_EXPECT EQU CYDEV_CHIP_MEMBER_USED
CYDEV_CHIP_DIE_ACTUAL EQU CYDEV_CHIP_DIE_EXPECT
CYDEV_CHIP_REV_LEOPARD_ES1 EQU 0
CYDEV_CHIP_REV_LEOPARD_ES2 EQU 1
CYDEV_CHIP_REV_LEOPARD_ES3 EQU 3
CYDEV_CHIP_REV_LEOPARD_PRODUCTION EQU 3
CYDEV_CHIP_REV_PSOC4A_ES0 EQU 17
CYDEV_CHIP_REV_PSOC4A_PRODUCTION EQU 17
CYDEV_CHIP_REV_PSOC5LP_ES0 EQU 0
CYDEV_CHIP_REV_PSOC5LP_PRODUCTION EQU 0
CYDEV_CHIP_REV_PSOC5TM_ES0 EQU 0
CYDEV_CHIP_REV_PSOC5TM_ES1 EQU 1
CYDEV_CHIP_REV_PSOC5TM_PRODUCTION EQU 1
CYDEV_CHIP_REV_TMA4_ES EQU 17
CYDEV_CHIP_REV_TMA4_ES2 EQU 33
CYDEV_CHIP_REV_TMA4_PRODUCTION EQU 17
CYDEV_CHIP_REVISION_3A_ES1 EQU 0
CYDEV_CHIP_REVISION_3A_ES2 EQU 1
CYDEV_CHIP_REVISION_3A_ES3 EQU 3
CYDEV_CHIP_REVISION_3A_PRODUCTION EQU 3
CYDEV_CHIP_REVISION_4A_ES0 EQU 17
CYDEV_CHIP_REVISION_4A_PRODUCTION EQU 17
CYDEV_CHIP_REVISION_4D_PRODUCTION EQU 0
CYDEV_CHIP_REVISION_4E_CCG2_NO_USBPD EQU 0
CYDEV_CHIP_REVISION_4E_PRODUCTION EQU 0
CYDEV_CHIP_REVISION_4F_PRODUCTION EQU 0
CYDEV_CHIP_REVISION_4F_PRODUCTION_256DMA EQU 0
CYDEV_CHIP_REVISION_4F_PRODUCTION_256K EQU 0
CYDEV_CHIP_REVISION_4G_ES EQU 17
CYDEV_CHIP_REVISION_4G_ES2 EQU 33
CYDEV_CHIP_REVISION_4G_PRODUCTION EQU 17
CYDEV_CHIP_REVISION_4H_PRODUCTION EQU 0
CYDEV_CHIP_REVISION_4I_PRODUCTION EQU 0
CYDEV_CHIP_REVISION_4J_PRODUCTION EQU 0
CYDEV_CHIP_REVISION_4K_PRODUCTION EQU 0
CYDEV_CHIP_REVISION_4L_PRODUCTION EQU 0
CYDEV_CHIP_REVISION_4M_PRODUCTION EQU 0
CYDEV_CHIP_REVISION_4N_PRODUCTION EQU 0
CYDEV_CHIP_REVISION_4O_PRODUCTION EQU 0
CYDEV_CHIP_REVISION_4P_PRODUCTION EQU 0
CYDEV_CHIP_REVISION_4Q_PRODUCTION EQU 0
CYDEV_CHIP_REVISION_4R_PRODUCTION EQU 0
CYDEV_CHIP_REVISION_4S_PRODUCTION EQU 0
CYDEV_CHIP_REVISION_4T_PRODUCTION EQU 0
CYDEV_CHIP_REVISION_4U_PRODUCTION EQU 0
CYDEV_CHIP_REVISION_4V_PRODUCTION EQU 0
CYDEV_CHIP_REVISION_5A_ES0 EQU 0
CYDEV_CHIP_REVISION_5A_ES1 EQU 1
CYDEV_CHIP_REVISION_5A_PRODUCTION EQU 1
CYDEV_CHIP_REVISION_5B_ES0 EQU 0
CYDEV_CHIP_REVISION_5B_PRODUCTION EQU 0
CYDEV_CHIP_REVISION_6A_ES EQU 17
CYDEV_CHIP_REVISION_6A_NO_UDB EQU 33
CYDEV_CHIP_REVISION_6A_PRODUCTION EQU 33
CYDEV_CHIP_REVISION_FM3_PRODUCTION EQU 0
CYDEV_CHIP_REVISION_FM4_PRODUCTION EQU 0
CYDEV_CHIP_REVISION_PDL_FM0P_TYPE1_PRODUCTION EQU 0
CYDEV_CHIP_REVISION_PDL_FM0P_TYPE2_PRODUCTION EQU 0
CYDEV_CHIP_REVISION_PDL_FM0P_TYPE3_PRODUCTION EQU 0
CYDEV_CHIP_REVISION_USED EQU CYDEV_CHIP_REVISION_5B_PRODUCTION
CYDEV_CHIP_REV_EXPECT EQU CYDEV_CHIP_REVISION_USED
CYDEV_CONFIG_FASTBOOT_ENABLED EQU 1
CYDEV_CONFIG_UNUSED_IO_AllowButWarn EQU 0
CYDEV_CONFIG_UNUSED_IO EQU CYDEV_CONFIG_UNUSED_IO_AllowButWarn
CYDEV_CONFIG_UNUSED_IO_AllowWithInfo EQU 1
CYDEV_CONFIG_UNUSED_IO_Disallowed EQU 2
CYDEV_CONFIGURATION_COMPRESSED EQU 1
CYDEV_CONFIGURATION_DMA EQU 0
CYDEV_CONFIGURATION_ECC EQU 1
CYDEV_CONFIGURATION_IMOENABLED EQU CYDEV_CONFIG_FASTBOOT_ENABLED
CYDEV_CONFIGURATION_MODE_COMPRESSED EQU 0
CYDEV_CONFIGURATION_MODE EQU CYDEV_CONFIGURATION_MODE_COMPRESSED
CYDEV_CONFIGURATION_MODE_DMA EQU 2
CYDEV_CONFIGURATION_MODE_UNCOMPRESSED EQU 1
CYDEV_DEBUG_ENABLE_MASK EQU 0x20
CYDEV_DEBUG_ENABLE_REGISTER EQU CYREG_MLOGIC_DEBUG
CYDEV_DEBUGGING_DPS_Disable EQU 3
CYDEV_DEBUGGING_DPS_JTAG_4 EQU 1
CYDEV_DEBUGGING_DPS_JTAG_5 EQU 0
CYDEV_DEBUGGING_DPS_SWD EQU 2
CYDEV_DEBUGGING_DPS_SWD_SWV EQU 6
CYDEV_DEBUGGING_DPS EQU CYDEV_DEBUGGING_DPS_SWD_SWV
CYDEV_DEBUGGING_ENABLE EQU 1
CYDEV_DEBUGGING_XRES EQU 0
CYDEV_DMA_CHANNELS_AVAILABLE EQU 24
CYDEV_ECC_ENABLE EQU 0
CYDEV_HEAP_SIZE EQU 0x80
CYDEV_INSTRUCT_CACHE_ENABLED EQU 1
CYDEV_INTR_RISING EQU 0x00000000
CYDEV_IS_EXPORTING_CODE EQU 0
CYDEV_IS_IMPORTING_CODE EQU 0
CYDEV_PROJ_TYPE EQU 0
CYDEV_PROJ_TYPE_BOOTLOADER EQU 1
CYDEV_PROJ_TYPE_LAUNCHER EQU 5
CYDEV_PROJ_TYPE_LOADABLE EQU 2
CYDEV_PROJ_TYPE_LOADABLEANDBOOTLOADER EQU 4
CYDEV_PROJ_TYPE_MULTIAPPBOOTLOADER EQU 3
CYDEV_PROJ_TYPE_STANDARD EQU 0
CYDEV_PROTECTION_ENABLE EQU 0
CYDEV_STACK_SIZE EQU 0x0800
CYDEV_USE_BUNDLED_CMSIS EQU 1
CYDEV_VARIABLE_VDDA EQU 0
CYDEV_VDDA_MV EQU 5000
CYDEV_VDDD_MV EQU 5000
CYDEV_VDDIO0_MV EQU 5000
CYDEV_VDDIO1_MV EQU 5000
CYDEV_VDDIO2_MV EQU 5000
CYDEV_VDDIO3_MV EQU 5000
CYDEV_VIO0_MV EQU 5000
CYDEV_VIO1_MV EQU 5000
CYDEV_VIO2_MV EQU 5000
CYDEV_VIO3_MV EQU 5000
CYIPBLOCK_ARM_CM3_VERSION EQU 0
CYIPBLOCK_P3_ANAIF_VERSION EQU 0
CYIPBLOCK_P3_CAN_VERSION EQU 0
CYIPBLOCK_P3_CAPSENSE_VERSION EQU 0
CYIPBLOCK_P3_COMP_VERSION EQU 0
CYIPBLOCK_P3_DECIMATOR_VERSION EQU 0
CYIPBLOCK_P3_DFB_VERSION EQU 0
CYIPBLOCK_P3_DMA_VERSION EQU 0
CYIPBLOCK_P3_DRQ_VERSION EQU 0
CYIPBLOCK_P3_DSM_VERSION EQU 0
CYIPBLOCK_P3_EMIF_VERSION EQU 0
CYIPBLOCK_P3_I2C_VERSION EQU 0
CYIPBLOCK_P3_LCD_VERSION EQU 0
CYIPBLOCK_P3_LPF_VERSION EQU 0
CYIPBLOCK_P3_OPAMP_VERSION EQU 0
CYIPBLOCK_P3_PM_VERSION EQU 0
CYIPBLOCK_P3_SCCT_VERSION EQU 0
CYIPBLOCK_P3_TIMER_VERSION EQU 0
CYIPBLOCK_P3_USB_VERSION EQU 0
CYIPBLOCK_P3_VIDAC_VERSION EQU 0
CYIPBLOCK_P3_VREF_VERSION EQU 0
CYIPBLOCK_S8_GPIO_VERSION EQU 0
CYIPBLOCK_S8_IRQ_VERSION EQU 0
CYIPBLOCK_S8_SAR_VERSION EQU 0
CYIPBLOCK_S8_SIO_VERSION EQU 0
CYIPBLOCK_S8_UDB_VERSION EQU 0
DMA_CHANNELS_USED__MASK0 EQU 0x00000000
CYDEV_BOOTLOADER_ENABLE EQU 0

#endif /* INCLUDED_CYFITTERIAR_INC */
