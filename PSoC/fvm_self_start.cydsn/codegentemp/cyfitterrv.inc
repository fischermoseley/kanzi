;
; File Name: cyfitterrv.inc
; 
; PSoC Creator  4.2
;
; Description:
; 
;
;-------------------------------------------------------------------------------
; Copyright (c) 2007-2018 Cypress Semiconductor.  All rights reserved.
; You may use this file only in accordance with the license, terms, conditions, 
; disclaimers, and limitations in the end user license agreement accompanying 
; the software package with which this file was provided.
;-------------------------------------------------------------------------------

    IF :LNOT::DEF:INCLUDED_CYFITTERRV_INC
INCLUDED_CYFITTERRV_INC EQU 1
    GET cydevicerv.inc
    GET cydevicerv_trm.inc

; DRIVE1
DRIVE1_HA__0__INTTYPE EQU CYREG_PICU0_INTTYPE6
DRIVE1_HA__0__MASK EQU 0x40
DRIVE1_HA__0__PC EQU CYREG_PRT0_PC6
DRIVE1_HA__0__PORT EQU 0
DRIVE1_HA__0__SHIFT EQU 6
DRIVE1_HA__AG EQU CYREG_PRT0_AG
DRIVE1_HA__AMUX EQU CYREG_PRT0_AMUX
DRIVE1_HA__BIE EQU CYREG_PRT0_BIE
DRIVE1_HA__BIT_MASK EQU CYREG_PRT0_BIT_MASK
DRIVE1_HA__BYP EQU CYREG_PRT0_BYP
DRIVE1_HA__CTL EQU CYREG_PRT0_CTL
DRIVE1_HA__DM0 EQU CYREG_PRT0_DM0
DRIVE1_HA__DM1 EQU CYREG_PRT0_DM1
DRIVE1_HA__DM2 EQU CYREG_PRT0_DM2
DRIVE1_HA__DR EQU CYREG_PRT0_DR
DRIVE1_HA__INP_DIS EQU CYREG_PRT0_INP_DIS
DRIVE1_HA__INTTYPE_BASE EQU CYDEV_PICU_INTTYPE_PICU0_BASE
DRIVE1_HA__LCD_COM_SEG EQU CYREG_PRT0_LCD_COM_SEG
DRIVE1_HA__LCD_EN EQU CYREG_PRT0_LCD_EN
DRIVE1_HA__MASK EQU 0x40
DRIVE1_HA__PORT EQU 0
DRIVE1_HA__PRT EQU CYREG_PRT0_PRT
DRIVE1_HA__PRTDSI__CAPS_SEL EQU CYREG_PRT0_CAPS_SEL
DRIVE1_HA__PRTDSI__DBL_SYNC_IN EQU CYREG_PRT0_DBL_SYNC_IN
DRIVE1_HA__PRTDSI__OE_SEL0 EQU CYREG_PRT0_OE_SEL0
DRIVE1_HA__PRTDSI__OE_SEL1 EQU CYREG_PRT0_OE_SEL1
DRIVE1_HA__PRTDSI__OUT_SEL0 EQU CYREG_PRT0_OUT_SEL0
DRIVE1_HA__PRTDSI__OUT_SEL1 EQU CYREG_PRT0_OUT_SEL1
DRIVE1_HA__PRTDSI__SYNC_OUT EQU CYREG_PRT0_SYNC_OUT
DRIVE1_HA__PS EQU CYREG_PRT0_PS
DRIVE1_HA__SHIFT EQU 6
DRIVE1_HA__SLW EQU CYREG_PRT0_SLW
DRIVE1_HB__0__INTTYPE EQU CYREG_PICU1_INTTYPE4
DRIVE1_HB__0__MASK EQU 0x10
DRIVE1_HB__0__PC EQU CYREG_PRT1_PC4
DRIVE1_HB__0__PORT EQU 1
DRIVE1_HB__0__SHIFT EQU 4
DRIVE1_HB__AG EQU CYREG_PRT1_AG
DRIVE1_HB__AMUX EQU CYREG_PRT1_AMUX
DRIVE1_HB__BIE EQU CYREG_PRT1_BIE
DRIVE1_HB__BIT_MASK EQU CYREG_PRT1_BIT_MASK
DRIVE1_HB__BYP EQU CYREG_PRT1_BYP
DRIVE1_HB__CTL EQU CYREG_PRT1_CTL
DRIVE1_HB__DM0 EQU CYREG_PRT1_DM0
DRIVE1_HB__DM1 EQU CYREG_PRT1_DM1
DRIVE1_HB__DM2 EQU CYREG_PRT1_DM2
DRIVE1_HB__DR EQU CYREG_PRT1_DR
DRIVE1_HB__INP_DIS EQU CYREG_PRT1_INP_DIS
DRIVE1_HB__INTTYPE_BASE EQU CYDEV_PICU_INTTYPE_PICU1_BASE
DRIVE1_HB__LCD_COM_SEG EQU CYREG_PRT1_LCD_COM_SEG
DRIVE1_HB__LCD_EN EQU CYREG_PRT1_LCD_EN
DRIVE1_HB__MASK EQU 0x10
DRIVE1_HB__PORT EQU 1
DRIVE1_HB__PRT EQU CYREG_PRT1_PRT
DRIVE1_HB__PRTDSI__CAPS_SEL EQU CYREG_PRT1_CAPS_SEL
DRIVE1_HB__PRTDSI__DBL_SYNC_IN EQU CYREG_PRT1_DBL_SYNC_IN
DRIVE1_HB__PRTDSI__OE_SEL0 EQU CYREG_PRT1_OE_SEL0
DRIVE1_HB__PRTDSI__OE_SEL1 EQU CYREG_PRT1_OE_SEL1
DRIVE1_HB__PRTDSI__OUT_SEL0 EQU CYREG_PRT1_OUT_SEL0
DRIVE1_HB__PRTDSI__OUT_SEL1 EQU CYREG_PRT1_OUT_SEL1
DRIVE1_HB__PRTDSI__SYNC_OUT EQU CYREG_PRT1_SYNC_OUT
DRIVE1_HB__PS EQU CYREG_PRT1_PS
DRIVE1_HB__SHIFT EQU 4
DRIVE1_HB__SLW EQU CYREG_PRT1_SLW
DRIVE1_HC__0__INTTYPE EQU CYREG_PICU1_INTTYPE6
DRIVE1_HC__0__MASK EQU 0x40
DRIVE1_HC__0__PC EQU CYREG_PRT1_PC6
DRIVE1_HC__0__PORT EQU 1
DRIVE1_HC__0__SHIFT EQU 6
DRIVE1_HC__AG EQU CYREG_PRT1_AG
DRIVE1_HC__AMUX EQU CYREG_PRT1_AMUX
DRIVE1_HC__BIE EQU CYREG_PRT1_BIE
DRIVE1_HC__BIT_MASK EQU CYREG_PRT1_BIT_MASK
DRIVE1_HC__BYP EQU CYREG_PRT1_BYP
DRIVE1_HC__CTL EQU CYREG_PRT1_CTL
DRIVE1_HC__DM0 EQU CYREG_PRT1_DM0
DRIVE1_HC__DM1 EQU CYREG_PRT1_DM1
DRIVE1_HC__DM2 EQU CYREG_PRT1_DM2
DRIVE1_HC__DR EQU CYREG_PRT1_DR
DRIVE1_HC__INP_DIS EQU CYREG_PRT1_INP_DIS
DRIVE1_HC__INTTYPE_BASE EQU CYDEV_PICU_INTTYPE_PICU1_BASE
DRIVE1_HC__LCD_COM_SEG EQU CYREG_PRT1_LCD_COM_SEG
DRIVE1_HC__LCD_EN EQU CYREG_PRT1_LCD_EN
DRIVE1_HC__MASK EQU 0x40
DRIVE1_HC__PORT EQU 1
DRIVE1_HC__PRT EQU CYREG_PRT1_PRT
DRIVE1_HC__PRTDSI__CAPS_SEL EQU CYREG_PRT1_CAPS_SEL
DRIVE1_HC__PRTDSI__DBL_SYNC_IN EQU CYREG_PRT1_DBL_SYNC_IN
DRIVE1_HC__PRTDSI__OE_SEL0 EQU CYREG_PRT1_OE_SEL0
DRIVE1_HC__PRTDSI__OE_SEL1 EQU CYREG_PRT1_OE_SEL1
DRIVE1_HC__PRTDSI__OUT_SEL0 EQU CYREG_PRT1_OUT_SEL0
DRIVE1_HC__PRTDSI__OUT_SEL1 EQU CYREG_PRT1_OUT_SEL1
DRIVE1_HC__PRTDSI__SYNC_OUT EQU CYREG_PRT1_SYNC_OUT
DRIVE1_HC__PS EQU CYREG_PRT1_PS
DRIVE1_HC__SHIFT EQU 6
DRIVE1_HC__SLW EQU CYREG_PRT1_SLW
DRIVE1_LA__0__INTTYPE EQU CYREG_PICU1_INTTYPE2
DRIVE1_LA__0__MASK EQU 0x04
DRIVE1_LA__0__PC EQU CYREG_PRT1_PC2
DRIVE1_LA__0__PORT EQU 1
DRIVE1_LA__0__SHIFT EQU 2
DRIVE1_LA__AG EQU CYREG_PRT1_AG
DRIVE1_LA__AMUX EQU CYREG_PRT1_AMUX
DRIVE1_LA__BIE EQU CYREG_PRT1_BIE
DRIVE1_LA__BIT_MASK EQU CYREG_PRT1_BIT_MASK
DRIVE1_LA__BYP EQU CYREG_PRT1_BYP
DRIVE1_LA__CTL EQU CYREG_PRT1_CTL
DRIVE1_LA__DM0 EQU CYREG_PRT1_DM0
DRIVE1_LA__DM1 EQU CYREG_PRT1_DM1
DRIVE1_LA__DM2 EQU CYREG_PRT1_DM2
DRIVE1_LA__DR EQU CYREG_PRT1_DR
DRIVE1_LA__INP_DIS EQU CYREG_PRT1_INP_DIS
DRIVE1_LA__INTTYPE_BASE EQU CYDEV_PICU_INTTYPE_PICU1_BASE
DRIVE1_LA__LCD_COM_SEG EQU CYREG_PRT1_LCD_COM_SEG
DRIVE1_LA__LCD_EN EQU CYREG_PRT1_LCD_EN
DRIVE1_LA__MASK EQU 0x04
DRIVE1_LA__PORT EQU 1
DRIVE1_LA__PRT EQU CYREG_PRT1_PRT
DRIVE1_LA__PRTDSI__CAPS_SEL EQU CYREG_PRT1_CAPS_SEL
DRIVE1_LA__PRTDSI__DBL_SYNC_IN EQU CYREG_PRT1_DBL_SYNC_IN
DRIVE1_LA__PRTDSI__OE_SEL0 EQU CYREG_PRT1_OE_SEL0
DRIVE1_LA__PRTDSI__OE_SEL1 EQU CYREG_PRT1_OE_SEL1
DRIVE1_LA__PRTDSI__OUT_SEL0 EQU CYREG_PRT1_OUT_SEL0
DRIVE1_LA__PRTDSI__OUT_SEL1 EQU CYREG_PRT1_OUT_SEL1
DRIVE1_LA__PRTDSI__SYNC_OUT EQU CYREG_PRT1_SYNC_OUT
DRIVE1_LA__PS EQU CYREG_PRT1_PS
DRIVE1_LA__SHIFT EQU 2
DRIVE1_LA__SLW EQU CYREG_PRT1_SLW
DRIVE1_LB__0__INTTYPE EQU CYREG_PICU0_INTTYPE7
DRIVE1_LB__0__MASK EQU 0x80
DRIVE1_LB__0__PC EQU CYREG_PRT0_PC7
DRIVE1_LB__0__PORT EQU 0
DRIVE1_LB__0__SHIFT EQU 7
DRIVE1_LB__AG EQU CYREG_PRT0_AG
DRIVE1_LB__AMUX EQU CYREG_PRT0_AMUX
DRIVE1_LB__BIE EQU CYREG_PRT0_BIE
DRIVE1_LB__BIT_MASK EQU CYREG_PRT0_BIT_MASK
DRIVE1_LB__BYP EQU CYREG_PRT0_BYP
DRIVE1_LB__CTL EQU CYREG_PRT0_CTL
DRIVE1_LB__DM0 EQU CYREG_PRT0_DM0
DRIVE1_LB__DM1 EQU CYREG_PRT0_DM1
DRIVE1_LB__DM2 EQU CYREG_PRT0_DM2
DRIVE1_LB__DR EQU CYREG_PRT0_DR
DRIVE1_LB__INP_DIS EQU CYREG_PRT0_INP_DIS
DRIVE1_LB__INTTYPE_BASE EQU CYDEV_PICU_INTTYPE_PICU0_BASE
DRIVE1_LB__LCD_COM_SEG EQU CYREG_PRT0_LCD_COM_SEG
DRIVE1_LB__LCD_EN EQU CYREG_PRT0_LCD_EN
DRIVE1_LB__MASK EQU 0x80
DRIVE1_LB__PORT EQU 0
DRIVE1_LB__PRT EQU CYREG_PRT0_PRT
DRIVE1_LB__PRTDSI__CAPS_SEL EQU CYREG_PRT0_CAPS_SEL
DRIVE1_LB__PRTDSI__DBL_SYNC_IN EQU CYREG_PRT0_DBL_SYNC_IN
DRIVE1_LB__PRTDSI__OE_SEL0 EQU CYREG_PRT0_OE_SEL0
DRIVE1_LB__PRTDSI__OE_SEL1 EQU CYREG_PRT0_OE_SEL1
DRIVE1_LB__PRTDSI__OUT_SEL0 EQU CYREG_PRT0_OUT_SEL0
DRIVE1_LB__PRTDSI__OUT_SEL1 EQU CYREG_PRT0_OUT_SEL1
DRIVE1_LB__PRTDSI__SYNC_OUT EQU CYREG_PRT0_SYNC_OUT
DRIVE1_LB__PS EQU CYREG_PRT0_PS
DRIVE1_LB__SHIFT EQU 7
DRIVE1_LB__SLW EQU CYREG_PRT0_SLW
DRIVE1_LC__0__INTTYPE EQU CYREG_PICU1_INTTYPE5
DRIVE1_LC__0__MASK EQU 0x20
DRIVE1_LC__0__PC EQU CYREG_PRT1_PC5
DRIVE1_LC__0__PORT EQU 1
DRIVE1_LC__0__SHIFT EQU 5
DRIVE1_LC__AG EQU CYREG_PRT1_AG
DRIVE1_LC__AMUX EQU CYREG_PRT1_AMUX
DRIVE1_LC__BIE EQU CYREG_PRT1_BIE
DRIVE1_LC__BIT_MASK EQU CYREG_PRT1_BIT_MASK
DRIVE1_LC__BYP EQU CYREG_PRT1_BYP
DRIVE1_LC__CTL EQU CYREG_PRT1_CTL
DRIVE1_LC__DM0 EQU CYREG_PRT1_DM0
DRIVE1_LC__DM1 EQU CYREG_PRT1_DM1
DRIVE1_LC__DM2 EQU CYREG_PRT1_DM2
DRIVE1_LC__DR EQU CYREG_PRT1_DR
DRIVE1_LC__INP_DIS EQU CYREG_PRT1_INP_DIS
DRIVE1_LC__INTTYPE_BASE EQU CYDEV_PICU_INTTYPE_PICU1_BASE
DRIVE1_LC__LCD_COM_SEG EQU CYREG_PRT1_LCD_COM_SEG
DRIVE1_LC__LCD_EN EQU CYREG_PRT1_LCD_EN
DRIVE1_LC__MASK EQU 0x20
DRIVE1_LC__PORT EQU 1
DRIVE1_LC__PRT EQU CYREG_PRT1_PRT
DRIVE1_LC__PRTDSI__CAPS_SEL EQU CYREG_PRT1_CAPS_SEL
DRIVE1_LC__PRTDSI__DBL_SYNC_IN EQU CYREG_PRT1_DBL_SYNC_IN
DRIVE1_LC__PRTDSI__OE_SEL0 EQU CYREG_PRT1_OE_SEL0
DRIVE1_LC__PRTDSI__OE_SEL1 EQU CYREG_PRT1_OE_SEL1
DRIVE1_LC__PRTDSI__OUT_SEL0 EQU CYREG_PRT1_OUT_SEL0
DRIVE1_LC__PRTDSI__OUT_SEL1 EQU CYREG_PRT1_OUT_SEL1
DRIVE1_LC__PRTDSI__SYNC_OUT EQU CYREG_PRT1_SYNC_OUT
DRIVE1_LC__PS EQU CYREG_PRT1_PS
DRIVE1_LC__SHIFT EQU 5
DRIVE1_LC__SLW EQU CYREG_PRT1_SLW
DRIVE1_Sync_ctrl_reg__0__MASK EQU 0x01
DRIVE1_Sync_ctrl_reg__0__POS EQU 0
DRIVE1_Sync_ctrl_reg__1__MASK EQU 0x02
DRIVE1_Sync_ctrl_reg__1__POS EQU 1
DRIVE1_Sync_ctrl_reg__2__MASK EQU 0x04
DRIVE1_Sync_ctrl_reg__2__POS EQU 2
DRIVE1_Sync_ctrl_reg__3__MASK EQU 0x08
DRIVE1_Sync_ctrl_reg__3__POS EQU 3
DRIVE1_Sync_ctrl_reg__4__MASK EQU 0x10
DRIVE1_Sync_ctrl_reg__4__POS EQU 4
DRIVE1_Sync_ctrl_reg__5__MASK EQU 0x20
DRIVE1_Sync_ctrl_reg__5__POS EQU 5
DRIVE1_Sync_ctrl_reg__CONTROL_AUX_CTL_REG EQU CYREG_B1_UDB11_ACTL
DRIVE1_Sync_ctrl_reg__CONTROL_REG EQU CYREG_B1_UDB11_CTL
DRIVE1_Sync_ctrl_reg__CONTROL_ST_REG EQU CYREG_B1_UDB11_ST_CTL
DRIVE1_Sync_ctrl_reg__COUNT_REG EQU CYREG_B1_UDB11_CTL
DRIVE1_Sync_ctrl_reg__COUNT_ST_REG EQU CYREG_B1_UDB11_ST_CTL
DRIVE1_Sync_ctrl_reg__MASK EQU 0x3F
DRIVE1_Sync_ctrl_reg__MASK_CTL_AUX_CTL_REG EQU CYREG_B1_UDB11_MSK_ACTL
DRIVE1_Sync_ctrl_reg__PER_CTL_AUX_CTL_REG EQU CYREG_B1_UDB11_MSK_ACTL
DRIVE1_Sync_ctrl_reg__PERIOD_REG EQU CYREG_B1_UDB11_MSK

; DRIVE2
DRIVE2_HA__0__INTTYPE EQU CYREG_PICU2_INTTYPE4
DRIVE2_HA__0__MASK EQU 0x10
DRIVE2_HA__0__PC EQU CYREG_PRT2_PC4
DRIVE2_HA__0__PORT EQU 2
DRIVE2_HA__0__SHIFT EQU 4
DRIVE2_HA__AG EQU CYREG_PRT2_AG
DRIVE2_HA__AMUX EQU CYREG_PRT2_AMUX
DRIVE2_HA__BIE EQU CYREG_PRT2_BIE
DRIVE2_HA__BIT_MASK EQU CYREG_PRT2_BIT_MASK
DRIVE2_HA__BYP EQU CYREG_PRT2_BYP
DRIVE2_HA__CTL EQU CYREG_PRT2_CTL
DRIVE2_HA__DM0 EQU CYREG_PRT2_DM0
DRIVE2_HA__DM1 EQU CYREG_PRT2_DM1
DRIVE2_HA__DM2 EQU CYREG_PRT2_DM2
DRIVE2_HA__DR EQU CYREG_PRT2_DR
DRIVE2_HA__INP_DIS EQU CYREG_PRT2_INP_DIS
DRIVE2_HA__INTTYPE_BASE EQU CYDEV_PICU_INTTYPE_PICU2_BASE
DRIVE2_HA__LCD_COM_SEG EQU CYREG_PRT2_LCD_COM_SEG
DRIVE2_HA__LCD_EN EQU CYREG_PRT2_LCD_EN
DRIVE2_HA__MASK EQU 0x10
DRIVE2_HA__PORT EQU 2
DRIVE2_HA__PRT EQU CYREG_PRT2_PRT
DRIVE2_HA__PRTDSI__CAPS_SEL EQU CYREG_PRT2_CAPS_SEL
DRIVE2_HA__PRTDSI__DBL_SYNC_IN EQU CYREG_PRT2_DBL_SYNC_IN
DRIVE2_HA__PRTDSI__OE_SEL0 EQU CYREG_PRT2_OE_SEL0
DRIVE2_HA__PRTDSI__OE_SEL1 EQU CYREG_PRT2_OE_SEL1
DRIVE2_HA__PRTDSI__OUT_SEL0 EQU CYREG_PRT2_OUT_SEL0
DRIVE2_HA__PRTDSI__OUT_SEL1 EQU CYREG_PRT2_OUT_SEL1
DRIVE2_HA__PRTDSI__SYNC_OUT EQU CYREG_PRT2_SYNC_OUT
DRIVE2_HA__PS EQU CYREG_PRT2_PS
DRIVE2_HA__SHIFT EQU 4
DRIVE2_HA__SLW EQU CYREG_PRT2_SLW
DRIVE2_HB__0__INTTYPE EQU CYREG_PICU1_INTTYPE7
DRIVE2_HB__0__MASK EQU 0x80
DRIVE2_HB__0__PC EQU CYREG_PRT1_PC7
DRIVE2_HB__0__PORT EQU 1
DRIVE2_HB__0__SHIFT EQU 7
DRIVE2_HB__AG EQU CYREG_PRT1_AG
DRIVE2_HB__AMUX EQU CYREG_PRT1_AMUX
DRIVE2_HB__BIE EQU CYREG_PRT1_BIE
DRIVE2_HB__BIT_MASK EQU CYREG_PRT1_BIT_MASK
DRIVE2_HB__BYP EQU CYREG_PRT1_BYP
DRIVE2_HB__CTL EQU CYREG_PRT1_CTL
DRIVE2_HB__DM0 EQU CYREG_PRT1_DM0
DRIVE2_HB__DM1 EQU CYREG_PRT1_DM1
DRIVE2_HB__DM2 EQU CYREG_PRT1_DM2
DRIVE2_HB__DR EQU CYREG_PRT1_DR
DRIVE2_HB__INP_DIS EQU CYREG_PRT1_INP_DIS
DRIVE2_HB__INTTYPE_BASE EQU CYDEV_PICU_INTTYPE_PICU1_BASE
DRIVE2_HB__LCD_COM_SEG EQU CYREG_PRT1_LCD_COM_SEG
DRIVE2_HB__LCD_EN EQU CYREG_PRT1_LCD_EN
DRIVE2_HB__MASK EQU 0x80
DRIVE2_HB__PORT EQU 1
DRIVE2_HB__PRT EQU CYREG_PRT1_PRT
DRIVE2_HB__PRTDSI__CAPS_SEL EQU CYREG_PRT1_CAPS_SEL
DRIVE2_HB__PRTDSI__DBL_SYNC_IN EQU CYREG_PRT1_DBL_SYNC_IN
DRIVE2_HB__PRTDSI__OE_SEL0 EQU CYREG_PRT1_OE_SEL0
DRIVE2_HB__PRTDSI__OE_SEL1 EQU CYREG_PRT1_OE_SEL1
DRIVE2_HB__PRTDSI__OUT_SEL0 EQU CYREG_PRT1_OUT_SEL0
DRIVE2_HB__PRTDSI__OUT_SEL1 EQU CYREG_PRT1_OUT_SEL1
DRIVE2_HB__PRTDSI__SYNC_OUT EQU CYREG_PRT1_SYNC_OUT
DRIVE2_HB__PS EQU CYREG_PRT1_PS
DRIVE2_HB__SHIFT EQU 7
DRIVE2_HB__SLW EQU CYREG_PRT1_SLW
DRIVE2_HC__0__INTTYPE EQU CYREG_PICU2_INTTYPE1
DRIVE2_HC__0__MASK EQU 0x02
DRIVE2_HC__0__PC EQU CYREG_PRT2_PC1
DRIVE2_HC__0__PORT EQU 2
DRIVE2_HC__0__SHIFT EQU 1
DRIVE2_HC__AG EQU CYREG_PRT2_AG
DRIVE2_HC__AMUX EQU CYREG_PRT2_AMUX
DRIVE2_HC__BIE EQU CYREG_PRT2_BIE
DRIVE2_HC__BIT_MASK EQU CYREG_PRT2_BIT_MASK
DRIVE2_HC__BYP EQU CYREG_PRT2_BYP
DRIVE2_HC__CTL EQU CYREG_PRT2_CTL
DRIVE2_HC__DM0 EQU CYREG_PRT2_DM0
DRIVE2_HC__DM1 EQU CYREG_PRT2_DM1
DRIVE2_HC__DM2 EQU CYREG_PRT2_DM2
DRIVE2_HC__DR EQU CYREG_PRT2_DR
DRIVE2_HC__INP_DIS EQU CYREG_PRT2_INP_DIS
DRIVE2_HC__INTTYPE_BASE EQU CYDEV_PICU_INTTYPE_PICU2_BASE
DRIVE2_HC__LCD_COM_SEG EQU CYREG_PRT2_LCD_COM_SEG
DRIVE2_HC__LCD_EN EQU CYREG_PRT2_LCD_EN
DRIVE2_HC__MASK EQU 0x02
DRIVE2_HC__PORT EQU 2
DRIVE2_HC__PRT EQU CYREG_PRT2_PRT
DRIVE2_HC__PRTDSI__CAPS_SEL EQU CYREG_PRT2_CAPS_SEL
DRIVE2_HC__PRTDSI__DBL_SYNC_IN EQU CYREG_PRT2_DBL_SYNC_IN
DRIVE2_HC__PRTDSI__OE_SEL0 EQU CYREG_PRT2_OE_SEL0
DRIVE2_HC__PRTDSI__OE_SEL1 EQU CYREG_PRT2_OE_SEL1
DRIVE2_HC__PRTDSI__OUT_SEL0 EQU CYREG_PRT2_OUT_SEL0
DRIVE2_HC__PRTDSI__OUT_SEL1 EQU CYREG_PRT2_OUT_SEL1
DRIVE2_HC__PRTDSI__SYNC_OUT EQU CYREG_PRT2_SYNC_OUT
DRIVE2_HC__PS EQU CYREG_PRT2_PS
DRIVE2_HC__SHIFT EQU 1
DRIVE2_HC__SLW EQU CYREG_PRT2_SLW
DRIVE2_LA__0__INTTYPE EQU CYREG_PICU2_INTTYPE0
DRIVE2_LA__0__MASK EQU 0x01
DRIVE2_LA__0__PC EQU CYREG_PRT2_PC0
DRIVE2_LA__0__PORT EQU 2
DRIVE2_LA__0__SHIFT EQU 0
DRIVE2_LA__AG EQU CYREG_PRT2_AG
DRIVE2_LA__AMUX EQU CYREG_PRT2_AMUX
DRIVE2_LA__BIE EQU CYREG_PRT2_BIE
DRIVE2_LA__BIT_MASK EQU CYREG_PRT2_BIT_MASK
DRIVE2_LA__BYP EQU CYREG_PRT2_BYP
DRIVE2_LA__CTL EQU CYREG_PRT2_CTL
DRIVE2_LA__DM0 EQU CYREG_PRT2_DM0
DRIVE2_LA__DM1 EQU CYREG_PRT2_DM1
DRIVE2_LA__DM2 EQU CYREG_PRT2_DM2
DRIVE2_LA__DR EQU CYREG_PRT2_DR
DRIVE2_LA__INP_DIS EQU CYREG_PRT2_INP_DIS
DRIVE2_LA__INTTYPE_BASE EQU CYDEV_PICU_INTTYPE_PICU2_BASE
DRIVE2_LA__LCD_COM_SEG EQU CYREG_PRT2_LCD_COM_SEG
DRIVE2_LA__LCD_EN EQU CYREG_PRT2_LCD_EN
DRIVE2_LA__MASK EQU 0x01
DRIVE2_LA__PORT EQU 2
DRIVE2_LA__PRT EQU CYREG_PRT2_PRT
DRIVE2_LA__PRTDSI__CAPS_SEL EQU CYREG_PRT2_CAPS_SEL
DRIVE2_LA__PRTDSI__DBL_SYNC_IN EQU CYREG_PRT2_DBL_SYNC_IN
DRIVE2_LA__PRTDSI__OE_SEL0 EQU CYREG_PRT2_OE_SEL0
DRIVE2_LA__PRTDSI__OE_SEL1 EQU CYREG_PRT2_OE_SEL1
DRIVE2_LA__PRTDSI__OUT_SEL0 EQU CYREG_PRT2_OUT_SEL0
DRIVE2_LA__PRTDSI__OUT_SEL1 EQU CYREG_PRT2_OUT_SEL1
DRIVE2_LA__PRTDSI__SYNC_OUT EQU CYREG_PRT2_SYNC_OUT
DRIVE2_LA__PS EQU CYREG_PRT2_PS
DRIVE2_LA__SHIFT EQU 0
DRIVE2_LA__SLW EQU CYREG_PRT2_SLW
DRIVE2_LB__0__INTTYPE EQU CYREG_PICU2_INTTYPE2
DRIVE2_LB__0__MASK EQU 0x04
DRIVE2_LB__0__PC EQU CYREG_PRT2_PC2
DRIVE2_LB__0__PORT EQU 2
DRIVE2_LB__0__SHIFT EQU 2
DRIVE2_LB__AG EQU CYREG_PRT2_AG
DRIVE2_LB__AMUX EQU CYREG_PRT2_AMUX
DRIVE2_LB__BIE EQU CYREG_PRT2_BIE
DRIVE2_LB__BIT_MASK EQU CYREG_PRT2_BIT_MASK
DRIVE2_LB__BYP EQU CYREG_PRT2_BYP
DRIVE2_LB__CTL EQU CYREG_PRT2_CTL
DRIVE2_LB__DM0 EQU CYREG_PRT2_DM0
DRIVE2_LB__DM1 EQU CYREG_PRT2_DM1
DRIVE2_LB__DM2 EQU CYREG_PRT2_DM2
DRIVE2_LB__DR EQU CYREG_PRT2_DR
DRIVE2_LB__INP_DIS EQU CYREG_PRT2_INP_DIS
DRIVE2_LB__INTTYPE_BASE EQU CYDEV_PICU_INTTYPE_PICU2_BASE
DRIVE2_LB__LCD_COM_SEG EQU CYREG_PRT2_LCD_COM_SEG
DRIVE2_LB__LCD_EN EQU CYREG_PRT2_LCD_EN
DRIVE2_LB__MASK EQU 0x04
DRIVE2_LB__PORT EQU 2
DRIVE2_LB__PRT EQU CYREG_PRT2_PRT
DRIVE2_LB__PRTDSI__CAPS_SEL EQU CYREG_PRT2_CAPS_SEL
DRIVE2_LB__PRTDSI__DBL_SYNC_IN EQU CYREG_PRT2_DBL_SYNC_IN
DRIVE2_LB__PRTDSI__OE_SEL0 EQU CYREG_PRT2_OE_SEL0
DRIVE2_LB__PRTDSI__OE_SEL1 EQU CYREG_PRT2_OE_SEL1
DRIVE2_LB__PRTDSI__OUT_SEL0 EQU CYREG_PRT2_OUT_SEL0
DRIVE2_LB__PRTDSI__OUT_SEL1 EQU CYREG_PRT2_OUT_SEL1
DRIVE2_LB__PRTDSI__SYNC_OUT EQU CYREG_PRT2_SYNC_OUT
DRIVE2_LB__PS EQU CYREG_PRT2_PS
DRIVE2_LB__SHIFT EQU 2
DRIVE2_LB__SLW EQU CYREG_PRT2_SLW
DRIVE2_LC__0__INTTYPE EQU CYREG_PICU2_INTTYPE3
DRIVE2_LC__0__MASK EQU 0x08
DRIVE2_LC__0__PC EQU CYREG_PRT2_PC3
DRIVE2_LC__0__PORT EQU 2
DRIVE2_LC__0__SHIFT EQU 3
DRIVE2_LC__AG EQU CYREG_PRT2_AG
DRIVE2_LC__AMUX EQU CYREG_PRT2_AMUX
DRIVE2_LC__BIE EQU CYREG_PRT2_BIE
DRIVE2_LC__BIT_MASK EQU CYREG_PRT2_BIT_MASK
DRIVE2_LC__BYP EQU CYREG_PRT2_BYP
DRIVE2_LC__CTL EQU CYREG_PRT2_CTL
DRIVE2_LC__DM0 EQU CYREG_PRT2_DM0
DRIVE2_LC__DM1 EQU CYREG_PRT2_DM1
DRIVE2_LC__DM2 EQU CYREG_PRT2_DM2
DRIVE2_LC__DR EQU CYREG_PRT2_DR
DRIVE2_LC__INP_DIS EQU CYREG_PRT2_INP_DIS
DRIVE2_LC__INTTYPE_BASE EQU CYDEV_PICU_INTTYPE_PICU2_BASE
DRIVE2_LC__LCD_COM_SEG EQU CYREG_PRT2_LCD_COM_SEG
DRIVE2_LC__LCD_EN EQU CYREG_PRT2_LCD_EN
DRIVE2_LC__MASK EQU 0x08
DRIVE2_LC__PORT EQU 2
DRIVE2_LC__PRT EQU CYREG_PRT2_PRT
DRIVE2_LC__PRTDSI__CAPS_SEL EQU CYREG_PRT2_CAPS_SEL
DRIVE2_LC__PRTDSI__DBL_SYNC_IN EQU CYREG_PRT2_DBL_SYNC_IN
DRIVE2_LC__PRTDSI__OE_SEL0 EQU CYREG_PRT2_OE_SEL0
DRIVE2_LC__PRTDSI__OE_SEL1 EQU CYREG_PRT2_OE_SEL1
DRIVE2_LC__PRTDSI__OUT_SEL0 EQU CYREG_PRT2_OUT_SEL0
DRIVE2_LC__PRTDSI__OUT_SEL1 EQU CYREG_PRT2_OUT_SEL1
DRIVE2_LC__PRTDSI__SYNC_OUT EQU CYREG_PRT2_SYNC_OUT
DRIVE2_LC__PS EQU CYREG_PRT2_PS
DRIVE2_LC__SHIFT EQU 3
DRIVE2_LC__SLW EQU CYREG_PRT2_SLW
DRIVE2_Sync_ctrl_reg__0__MASK EQU 0x01
DRIVE2_Sync_ctrl_reg__0__POS EQU 0
DRIVE2_Sync_ctrl_reg__1__MASK EQU 0x02
DRIVE2_Sync_ctrl_reg__1__POS EQU 1
DRIVE2_Sync_ctrl_reg__16BIT_CONTROL_AUX_CTL_REG EQU CYREG_B1_UDB10_11_ACTL
DRIVE2_Sync_ctrl_reg__16BIT_CONTROL_CONTROL_REG EQU CYREG_B1_UDB10_11_CTL
DRIVE2_Sync_ctrl_reg__16BIT_CONTROL_COUNT_REG EQU CYREG_B1_UDB10_11_CTL
DRIVE2_Sync_ctrl_reg__16BIT_COUNT_CONTROL_REG EQU CYREG_B1_UDB10_11_CTL
DRIVE2_Sync_ctrl_reg__16BIT_COUNT_COUNT_REG EQU CYREG_B1_UDB10_11_CTL
DRIVE2_Sync_ctrl_reg__16BIT_MASK_MASK_REG EQU CYREG_B1_UDB10_11_MSK
DRIVE2_Sync_ctrl_reg__16BIT_MASK_PERIOD_REG EQU CYREG_B1_UDB10_11_MSK
DRIVE2_Sync_ctrl_reg__16BIT_PERIOD_MASK_REG EQU CYREG_B1_UDB10_11_MSK
DRIVE2_Sync_ctrl_reg__16BIT_PERIOD_PERIOD_REG EQU CYREG_B1_UDB10_11_MSK
DRIVE2_Sync_ctrl_reg__2__MASK EQU 0x04
DRIVE2_Sync_ctrl_reg__2__POS EQU 2
DRIVE2_Sync_ctrl_reg__3__MASK EQU 0x08
DRIVE2_Sync_ctrl_reg__3__POS EQU 3
DRIVE2_Sync_ctrl_reg__4__MASK EQU 0x10
DRIVE2_Sync_ctrl_reg__4__POS EQU 4
DRIVE2_Sync_ctrl_reg__5__MASK EQU 0x20
DRIVE2_Sync_ctrl_reg__5__POS EQU 5
DRIVE2_Sync_ctrl_reg__CONTROL_AUX_CTL_REG EQU CYREG_B1_UDB10_ACTL
DRIVE2_Sync_ctrl_reg__CONTROL_REG EQU CYREG_B1_UDB10_CTL
DRIVE2_Sync_ctrl_reg__CONTROL_ST_REG EQU CYREG_B1_UDB10_ST_CTL
DRIVE2_Sync_ctrl_reg__COUNT_REG EQU CYREG_B1_UDB10_CTL
DRIVE2_Sync_ctrl_reg__COUNT_ST_REG EQU CYREG_B1_UDB10_ST_CTL
DRIVE2_Sync_ctrl_reg__MASK EQU 0x3F
DRIVE2_Sync_ctrl_reg__MASK_CTL_AUX_CTL_REG EQU CYREG_B1_UDB10_MSK_ACTL
DRIVE2_Sync_ctrl_reg__PER_CTL_AUX_CTL_REG EQU CYREG_B1_UDB10_MSK_ACTL
DRIVE2_Sync_ctrl_reg__PERIOD_REG EQU CYREG_B1_UDB10_MSK

; HALL1_A
HALL1_A__0__INTTYPE EQU CYREG_PICU0_INTTYPE1
HALL1_A__0__MASK EQU 0x02
HALL1_A__0__PC EQU CYREG_PRT0_PC1
HALL1_A__0__PORT EQU 0
HALL1_A__0__SHIFT EQU 1
HALL1_A__AG EQU CYREG_PRT0_AG
HALL1_A__AMUX EQU CYREG_PRT0_AMUX
HALL1_A__BIE EQU CYREG_PRT0_BIE
HALL1_A__BIT_MASK EQU CYREG_PRT0_BIT_MASK
HALL1_A__BYP EQU CYREG_PRT0_BYP
HALL1_A__CTL EQU CYREG_PRT0_CTL
HALL1_A__DM0 EQU CYREG_PRT0_DM0
HALL1_A__DM1 EQU CYREG_PRT0_DM1
HALL1_A__DM2 EQU CYREG_PRT0_DM2
HALL1_A__DR EQU CYREG_PRT0_DR
HALL1_A__INP_DIS EQU CYREG_PRT0_INP_DIS
HALL1_A__INTTYPE_BASE EQU CYDEV_PICU_INTTYPE_PICU0_BASE
HALL1_A__LCD_COM_SEG EQU CYREG_PRT0_LCD_COM_SEG
HALL1_A__LCD_EN EQU CYREG_PRT0_LCD_EN
HALL1_A__MASK EQU 0x02
HALL1_A__PORT EQU 0
HALL1_A__PRT EQU CYREG_PRT0_PRT
HALL1_A__PRTDSI__CAPS_SEL EQU CYREG_PRT0_CAPS_SEL
HALL1_A__PRTDSI__DBL_SYNC_IN EQU CYREG_PRT0_DBL_SYNC_IN
HALL1_A__PRTDSI__OE_SEL0 EQU CYREG_PRT0_OE_SEL0
HALL1_A__PRTDSI__OE_SEL1 EQU CYREG_PRT0_OE_SEL1
HALL1_A__PRTDSI__OUT_SEL0 EQU CYREG_PRT0_OUT_SEL0
HALL1_A__PRTDSI__OUT_SEL1 EQU CYREG_PRT0_OUT_SEL1
HALL1_A__PRTDSI__SYNC_OUT EQU CYREG_PRT0_SYNC_OUT
HALL1_A__PS EQU CYREG_PRT0_PS
HALL1_A__SHIFT EQU 1
HALL1_A__SLW EQU CYREG_PRT0_SLW

; HALL1_B
HALL1_B__0__INTTYPE EQU CYREG_PICU0_INTTYPE4
HALL1_B__0__MASK EQU 0x10
HALL1_B__0__PC EQU CYREG_PRT0_PC4
HALL1_B__0__PORT EQU 0
HALL1_B__0__SHIFT EQU 4
HALL1_B__AG EQU CYREG_PRT0_AG
HALL1_B__AMUX EQU CYREG_PRT0_AMUX
HALL1_B__BIE EQU CYREG_PRT0_BIE
HALL1_B__BIT_MASK EQU CYREG_PRT0_BIT_MASK
HALL1_B__BYP EQU CYREG_PRT0_BYP
HALL1_B__CTL EQU CYREG_PRT0_CTL
HALL1_B__DM0 EQU CYREG_PRT0_DM0
HALL1_B__DM1 EQU CYREG_PRT0_DM1
HALL1_B__DM2 EQU CYREG_PRT0_DM2
HALL1_B__DR EQU CYREG_PRT0_DR
HALL1_B__INP_DIS EQU CYREG_PRT0_INP_DIS
HALL1_B__INTTYPE_BASE EQU CYDEV_PICU_INTTYPE_PICU0_BASE
HALL1_B__LCD_COM_SEG EQU CYREG_PRT0_LCD_COM_SEG
HALL1_B__LCD_EN EQU CYREG_PRT0_LCD_EN
HALL1_B__MASK EQU 0x10
HALL1_B__PORT EQU 0
HALL1_B__PRT EQU CYREG_PRT0_PRT
HALL1_B__PRTDSI__CAPS_SEL EQU CYREG_PRT0_CAPS_SEL
HALL1_B__PRTDSI__DBL_SYNC_IN EQU CYREG_PRT0_DBL_SYNC_IN
HALL1_B__PRTDSI__OE_SEL0 EQU CYREG_PRT0_OE_SEL0
HALL1_B__PRTDSI__OE_SEL1 EQU CYREG_PRT0_OE_SEL1
HALL1_B__PRTDSI__OUT_SEL0 EQU CYREG_PRT0_OUT_SEL0
HALL1_B__PRTDSI__OUT_SEL1 EQU CYREG_PRT0_OUT_SEL1
HALL1_B__PRTDSI__SYNC_OUT EQU CYREG_PRT0_SYNC_OUT
HALL1_B__PS EQU CYREG_PRT0_PS
HALL1_B__SHIFT EQU 4
HALL1_B__SLW EQU CYREG_PRT0_SLW

; HALL1_C
HALL1_C__0__INTTYPE EQU CYREG_PICU0_INTTYPE5
HALL1_C__0__MASK EQU 0x20
HALL1_C__0__PC EQU CYREG_PRT0_PC5
HALL1_C__0__PORT EQU 0
HALL1_C__0__SHIFT EQU 5
HALL1_C__AG EQU CYREG_PRT0_AG
HALL1_C__AMUX EQU CYREG_PRT0_AMUX
HALL1_C__BIE EQU CYREG_PRT0_BIE
HALL1_C__BIT_MASK EQU CYREG_PRT0_BIT_MASK
HALL1_C__BYP EQU CYREG_PRT0_BYP
HALL1_C__CTL EQU CYREG_PRT0_CTL
HALL1_C__DM0 EQU CYREG_PRT0_DM0
HALL1_C__DM1 EQU CYREG_PRT0_DM1
HALL1_C__DM2 EQU CYREG_PRT0_DM2
HALL1_C__DR EQU CYREG_PRT0_DR
HALL1_C__INP_DIS EQU CYREG_PRT0_INP_DIS
HALL1_C__INTTYPE_BASE EQU CYDEV_PICU_INTTYPE_PICU0_BASE
HALL1_C__LCD_COM_SEG EQU CYREG_PRT0_LCD_COM_SEG
HALL1_C__LCD_EN EQU CYREG_PRT0_LCD_EN
HALL1_C__MASK EQU 0x20
HALL1_C__PORT EQU 0
HALL1_C__PRT EQU CYREG_PRT0_PRT
HALL1_C__PRTDSI__CAPS_SEL EQU CYREG_PRT0_CAPS_SEL
HALL1_C__PRTDSI__DBL_SYNC_IN EQU CYREG_PRT0_DBL_SYNC_IN
HALL1_C__PRTDSI__OE_SEL0 EQU CYREG_PRT0_OE_SEL0
HALL1_C__PRTDSI__OE_SEL1 EQU CYREG_PRT0_OE_SEL1
HALL1_C__PRTDSI__OUT_SEL0 EQU CYREG_PRT0_OUT_SEL0
HALL1_C__PRTDSI__OUT_SEL1 EQU CYREG_PRT0_OUT_SEL1
HALL1_C__PRTDSI__SYNC_OUT EQU CYREG_PRT0_SYNC_OUT
HALL1_C__PS EQU CYREG_PRT0_PS
HALL1_C__SHIFT EQU 5
HALL1_C__SLW EQU CYREG_PRT0_SLW

; HALL2_A
HALL2_A__0__INTTYPE EQU CYREG_PICU0_INTTYPE0
HALL2_A__0__MASK EQU 0x01
HALL2_A__0__PC EQU CYREG_PRT0_PC0
HALL2_A__0__PORT EQU 0
HALL2_A__0__SHIFT EQU 0
HALL2_A__AG EQU CYREG_PRT0_AG
HALL2_A__AMUX EQU CYREG_PRT0_AMUX
HALL2_A__BIE EQU CYREG_PRT0_BIE
HALL2_A__BIT_MASK EQU CYREG_PRT0_BIT_MASK
HALL2_A__BYP EQU CYREG_PRT0_BYP
HALL2_A__CTL EQU CYREG_PRT0_CTL
HALL2_A__DM0 EQU CYREG_PRT0_DM0
HALL2_A__DM1 EQU CYREG_PRT0_DM1
HALL2_A__DM2 EQU CYREG_PRT0_DM2
HALL2_A__DR EQU CYREG_PRT0_DR
HALL2_A__INP_DIS EQU CYREG_PRT0_INP_DIS
HALL2_A__INTTYPE_BASE EQU CYDEV_PICU_INTTYPE_PICU0_BASE
HALL2_A__LCD_COM_SEG EQU CYREG_PRT0_LCD_COM_SEG
HALL2_A__LCD_EN EQU CYREG_PRT0_LCD_EN
HALL2_A__MASK EQU 0x01
HALL2_A__PORT EQU 0
HALL2_A__PRT EQU CYREG_PRT0_PRT
HALL2_A__PRTDSI__CAPS_SEL EQU CYREG_PRT0_CAPS_SEL
HALL2_A__PRTDSI__DBL_SYNC_IN EQU CYREG_PRT0_DBL_SYNC_IN
HALL2_A__PRTDSI__OE_SEL0 EQU CYREG_PRT0_OE_SEL0
HALL2_A__PRTDSI__OE_SEL1 EQU CYREG_PRT0_OE_SEL1
HALL2_A__PRTDSI__OUT_SEL0 EQU CYREG_PRT0_OUT_SEL0
HALL2_A__PRTDSI__OUT_SEL1 EQU CYREG_PRT0_OUT_SEL1
HALL2_A__PRTDSI__SYNC_OUT EQU CYREG_PRT0_SYNC_OUT
HALL2_A__PS EQU CYREG_PRT0_PS
HALL2_A__SHIFT EQU 0
HALL2_A__SLW EQU CYREG_PRT0_SLW

; HALL2_B
HALL2_B__0__INTTYPE EQU CYREG_PICU0_INTTYPE3
HALL2_B__0__MASK EQU 0x08
HALL2_B__0__PC EQU CYREG_PRT0_PC3
HALL2_B__0__PORT EQU 0
HALL2_B__0__SHIFT EQU 3
HALL2_B__AG EQU CYREG_PRT0_AG
HALL2_B__AMUX EQU CYREG_PRT0_AMUX
HALL2_B__BIE EQU CYREG_PRT0_BIE
HALL2_B__BIT_MASK EQU CYREG_PRT0_BIT_MASK
HALL2_B__BYP EQU CYREG_PRT0_BYP
HALL2_B__CTL EQU CYREG_PRT0_CTL
HALL2_B__DM0 EQU CYREG_PRT0_DM0
HALL2_B__DM1 EQU CYREG_PRT0_DM1
HALL2_B__DM2 EQU CYREG_PRT0_DM2
HALL2_B__DR EQU CYREG_PRT0_DR
HALL2_B__INP_DIS EQU CYREG_PRT0_INP_DIS
HALL2_B__INTTYPE_BASE EQU CYDEV_PICU_INTTYPE_PICU0_BASE
HALL2_B__LCD_COM_SEG EQU CYREG_PRT0_LCD_COM_SEG
HALL2_B__LCD_EN EQU CYREG_PRT0_LCD_EN
HALL2_B__MASK EQU 0x08
HALL2_B__PORT EQU 0
HALL2_B__PRT EQU CYREG_PRT0_PRT
HALL2_B__PRTDSI__CAPS_SEL EQU CYREG_PRT0_CAPS_SEL
HALL2_B__PRTDSI__DBL_SYNC_IN EQU CYREG_PRT0_DBL_SYNC_IN
HALL2_B__PRTDSI__OE_SEL0 EQU CYREG_PRT0_OE_SEL0
HALL2_B__PRTDSI__OE_SEL1 EQU CYREG_PRT0_OE_SEL1
HALL2_B__PRTDSI__OUT_SEL0 EQU CYREG_PRT0_OUT_SEL0
HALL2_B__PRTDSI__OUT_SEL1 EQU CYREG_PRT0_OUT_SEL1
HALL2_B__PRTDSI__SYNC_OUT EQU CYREG_PRT0_SYNC_OUT
HALL2_B__PS EQU CYREG_PRT0_PS
HALL2_B__SHIFT EQU 3
HALL2_B__SLW EQU CYREG_PRT0_SLW

; HALL2_C
HALL2_C__0__INTTYPE EQU CYREG_PICU0_INTTYPE2
HALL2_C__0__MASK EQU 0x04
HALL2_C__0__PC EQU CYREG_PRT0_PC2
HALL2_C__0__PORT EQU 0
HALL2_C__0__SHIFT EQU 2
HALL2_C__AG EQU CYREG_PRT0_AG
HALL2_C__AMUX EQU CYREG_PRT0_AMUX
HALL2_C__BIE EQU CYREG_PRT0_BIE
HALL2_C__BIT_MASK EQU CYREG_PRT0_BIT_MASK
HALL2_C__BYP EQU CYREG_PRT0_BYP
HALL2_C__CTL EQU CYREG_PRT0_CTL
HALL2_C__DM0 EQU CYREG_PRT0_DM0
HALL2_C__DM1 EQU CYREG_PRT0_DM1
HALL2_C__DM2 EQU CYREG_PRT0_DM2
HALL2_C__DR EQU CYREG_PRT0_DR
HALL2_C__INP_DIS EQU CYREG_PRT0_INP_DIS
HALL2_C__INTTYPE_BASE EQU CYDEV_PICU_INTTYPE_PICU0_BASE
HALL2_C__LCD_COM_SEG EQU CYREG_PRT0_LCD_COM_SEG
HALL2_C__LCD_EN EQU CYREG_PRT0_LCD_EN
HALL2_C__MASK EQU 0x04
HALL2_C__PORT EQU 0
HALL2_C__PRT EQU CYREG_PRT0_PRT
HALL2_C__PRTDSI__CAPS_SEL EQU CYREG_PRT0_CAPS_SEL
HALL2_C__PRTDSI__DBL_SYNC_IN EQU CYREG_PRT0_DBL_SYNC_IN
HALL2_C__PRTDSI__OE_SEL0 EQU CYREG_PRT0_OE_SEL0
HALL2_C__PRTDSI__OE_SEL1 EQU CYREG_PRT0_OE_SEL1
HALL2_C__PRTDSI__OUT_SEL0 EQU CYREG_PRT0_OUT_SEL0
HALL2_C__PRTDSI__OUT_SEL1 EQU CYREG_PRT0_OUT_SEL1
HALL2_C__PRTDSI__SYNC_OUT EQU CYREG_PRT0_SYNC_OUT
HALL2_C__PS EQU CYREG_PRT0_PS
HALL2_C__SHIFT EQU 2
HALL2_C__SLW EQU CYREG_PRT0_SLW

; Miscellaneous
BCLK__BUS_CLK__HZ EQU 24000000
BCLK__BUS_CLK__KHZ EQU 24000
BCLK__BUS_CLK__MHZ EQU 24
CYDEV_CHIP_DIE_LEOPARD EQU 1
CYDEV_CHIP_DIE_PSOC4A EQU 18
CYDEV_CHIP_DIE_PSOC5LP EQU 2
CYDEV_CHIP_DIE_PSOC5TM EQU 3
CYDEV_CHIP_DIE_TMA4 EQU 4
CYDEV_CHIP_DIE_UNKNOWN EQU 0
CYDEV_CHIP_FAMILY_FM0P EQU 5
CYDEV_CHIP_FAMILY_FM3 EQU 6
CYDEV_CHIP_FAMILY_FM4 EQU 7
CYDEV_CHIP_FAMILY_PSOC3 EQU 1
CYDEV_CHIP_FAMILY_PSOC4 EQU 2
CYDEV_CHIP_FAMILY_PSOC5 EQU 3
CYDEV_CHIP_FAMILY_PSOC6 EQU 4
CYDEV_CHIP_FAMILY_UNKNOWN EQU 0
CYDEV_CHIP_FAMILY_USED EQU CYDEV_CHIP_FAMILY_PSOC5
CYDEV_CHIP_JTAG_ID EQU 0x2E161069
CYDEV_CHIP_MEMBER_3A EQU 1
CYDEV_CHIP_MEMBER_4A EQU 18
CYDEV_CHIP_MEMBER_4D EQU 13
CYDEV_CHIP_MEMBER_4E EQU 6
CYDEV_CHIP_MEMBER_4F EQU 19
CYDEV_CHIP_MEMBER_4G EQU 4
CYDEV_CHIP_MEMBER_4H EQU 17
CYDEV_CHIP_MEMBER_4I EQU 23
CYDEV_CHIP_MEMBER_4J EQU 14
CYDEV_CHIP_MEMBER_4K EQU 15
CYDEV_CHIP_MEMBER_4L EQU 22
CYDEV_CHIP_MEMBER_4M EQU 21
CYDEV_CHIP_MEMBER_4N EQU 10
CYDEV_CHIP_MEMBER_4O EQU 7
CYDEV_CHIP_MEMBER_4P EQU 20
CYDEV_CHIP_MEMBER_4Q EQU 12
CYDEV_CHIP_MEMBER_4R EQU 8
CYDEV_CHIP_MEMBER_4S EQU 11
CYDEV_CHIP_MEMBER_4T EQU 9
CYDEV_CHIP_MEMBER_4U EQU 5
CYDEV_CHIP_MEMBER_4V EQU 16
CYDEV_CHIP_MEMBER_5A EQU 3
CYDEV_CHIP_MEMBER_5B EQU 2
CYDEV_CHIP_MEMBER_6A EQU 24
CYDEV_CHIP_MEMBER_FM3 EQU 28
CYDEV_CHIP_MEMBER_FM4 EQU 29
CYDEV_CHIP_MEMBER_PDL_FM0P_TYPE1 EQU 25
CYDEV_CHIP_MEMBER_PDL_FM0P_TYPE2 EQU 26
CYDEV_CHIP_MEMBER_PDL_FM0P_TYPE3 EQU 27
CYDEV_CHIP_MEMBER_UNKNOWN EQU 0
CYDEV_CHIP_MEMBER_USED EQU CYDEV_CHIP_MEMBER_5B
CYDEV_CHIP_DIE_EXPECT EQU CYDEV_CHIP_MEMBER_USED
CYDEV_CHIP_DIE_ACTUAL EQU CYDEV_CHIP_DIE_EXPECT
CYDEV_CHIP_REV_LEOPARD_ES1 EQU 0
CYDEV_CHIP_REV_LEOPARD_ES2 EQU 1
CYDEV_CHIP_REV_LEOPARD_ES3 EQU 3
CYDEV_CHIP_REV_LEOPARD_PRODUCTION EQU 3
CYDEV_CHIP_REV_PSOC4A_ES0 EQU 17
CYDEV_CHIP_REV_PSOC4A_PRODUCTION EQU 17
CYDEV_CHIP_REV_PSOC5LP_ES0 EQU 0
CYDEV_CHIP_REV_PSOC5LP_PRODUCTION EQU 0
CYDEV_CHIP_REV_PSOC5TM_ES0 EQU 0
CYDEV_CHIP_REV_PSOC5TM_ES1 EQU 1
CYDEV_CHIP_REV_PSOC5TM_PRODUCTION EQU 1
CYDEV_CHIP_REV_TMA4_ES EQU 17
CYDEV_CHIP_REV_TMA4_ES2 EQU 33
CYDEV_CHIP_REV_TMA4_PRODUCTION EQU 17
CYDEV_CHIP_REVISION_3A_ES1 EQU 0
CYDEV_CHIP_REVISION_3A_ES2 EQU 1
CYDEV_CHIP_REVISION_3A_ES3 EQU 3
CYDEV_CHIP_REVISION_3A_PRODUCTION EQU 3
CYDEV_CHIP_REVISION_4A_ES0 EQU 17
CYDEV_CHIP_REVISION_4A_PRODUCTION EQU 17
CYDEV_CHIP_REVISION_4D_PRODUCTION EQU 0
CYDEV_CHIP_REVISION_4E_CCG2_NO_USBPD EQU 0
CYDEV_CHIP_REVISION_4E_PRODUCTION EQU 0
CYDEV_CHIP_REVISION_4F_PRODUCTION EQU 0
CYDEV_CHIP_REVISION_4F_PRODUCTION_256DMA EQU 0
CYDEV_CHIP_REVISION_4F_PRODUCTION_256K EQU 0
CYDEV_CHIP_REVISION_4G_ES EQU 17
CYDEV_CHIP_REVISION_4G_ES2 EQU 33
CYDEV_CHIP_REVISION_4G_PRODUCTION EQU 17
CYDEV_CHIP_REVISION_4H_PRODUCTION EQU 0
CYDEV_CHIP_REVISION_4I_PRODUCTION EQU 0
CYDEV_CHIP_REVISION_4J_PRODUCTION EQU 0
CYDEV_CHIP_REVISION_4K_PRODUCTION EQU 0
CYDEV_CHIP_REVISION_4L_PRODUCTION EQU 0
CYDEV_CHIP_REVISION_4M_PRODUCTION EQU 0
CYDEV_CHIP_REVISION_4N_PRODUCTION EQU 0
CYDEV_CHIP_REVISION_4O_PRODUCTION EQU 0
CYDEV_CHIP_REVISION_4P_PRODUCTION EQU 0
CYDEV_CHIP_REVISION_4Q_PRODUCTION EQU 0
CYDEV_CHIP_REVISION_4R_PRODUCTION EQU 0
CYDEV_CHIP_REVISION_4S_PRODUCTION EQU 0
CYDEV_CHIP_REVISION_4T_PRODUCTION EQU 0
CYDEV_CHIP_REVISION_4U_PRODUCTION EQU 0
CYDEV_CHIP_REVISION_4V_PRODUCTION EQU 0
CYDEV_CHIP_REVISION_5A_ES0 EQU 0
CYDEV_CHIP_REVISION_5A_ES1 EQU 1
CYDEV_CHIP_REVISION_5A_PRODUCTION EQU 1
CYDEV_CHIP_REVISION_5B_ES0 EQU 0
CYDEV_CHIP_REVISION_5B_PRODUCTION EQU 0
CYDEV_CHIP_REVISION_6A_ES EQU 17
CYDEV_CHIP_REVISION_6A_NO_UDB EQU 33
CYDEV_CHIP_REVISION_6A_PRODUCTION EQU 33
CYDEV_CHIP_REVISION_FM3_PRODUCTION EQU 0
CYDEV_CHIP_REVISION_FM4_PRODUCTION EQU 0
CYDEV_CHIP_REVISION_PDL_FM0P_TYPE1_PRODUCTION EQU 0
CYDEV_CHIP_REVISION_PDL_FM0P_TYPE2_PRODUCTION EQU 0
CYDEV_CHIP_REVISION_PDL_FM0P_TYPE3_PRODUCTION EQU 0
CYDEV_CHIP_REVISION_USED EQU CYDEV_CHIP_REVISION_5B_PRODUCTION
CYDEV_CHIP_REV_EXPECT EQU CYDEV_CHIP_REVISION_USED
CYDEV_CONFIG_FASTBOOT_ENABLED EQU 1
CYDEV_CONFIG_UNUSED_IO_AllowButWarn EQU 0
CYDEV_CONFIG_UNUSED_IO EQU CYDEV_CONFIG_UNUSED_IO_AllowButWarn
CYDEV_CONFIG_UNUSED_IO_AllowWithInfo EQU 1
CYDEV_CONFIG_UNUSED_IO_Disallowed EQU 2
CYDEV_CONFIGURATION_COMPRESSED EQU 1
CYDEV_CONFIGURATION_DMA EQU 0
CYDEV_CONFIGURATION_ECC EQU 1
CYDEV_CONFIGURATION_IMOENABLED EQU CYDEV_CONFIG_FASTBOOT_ENABLED
CYDEV_CONFIGURATION_MODE_COMPRESSED EQU 0
CYDEV_CONFIGURATION_MODE EQU CYDEV_CONFIGURATION_MODE_COMPRESSED
CYDEV_CONFIGURATION_MODE_DMA EQU 2
CYDEV_CONFIGURATION_MODE_UNCOMPRESSED EQU 1
CYDEV_DEBUG_ENABLE_MASK EQU 0x20
CYDEV_DEBUG_ENABLE_REGISTER EQU CYREG_MLOGIC_DEBUG
CYDEV_DEBUGGING_DPS_Disable EQU 3
CYDEV_DEBUGGING_DPS_JTAG_4 EQU 1
CYDEV_DEBUGGING_DPS_JTAG_5 EQU 0
CYDEV_DEBUGGING_DPS_SWD EQU 2
CYDEV_DEBUGGING_DPS_SWD_SWV EQU 6
CYDEV_DEBUGGING_DPS EQU CYDEV_DEBUGGING_DPS_SWD_SWV
CYDEV_DEBUGGING_ENABLE EQU 1
CYDEV_DEBUGGING_XRES EQU 0
CYDEV_DMA_CHANNELS_AVAILABLE EQU 24
CYDEV_ECC_ENABLE EQU 0
CYDEV_HEAP_SIZE EQU 0x80
CYDEV_INSTRUCT_CACHE_ENABLED EQU 1
CYDEV_INTR_RISING EQU 0x00000000
CYDEV_IS_EXPORTING_CODE EQU 0
CYDEV_IS_IMPORTING_CODE EQU 0
CYDEV_PROJ_TYPE EQU 0
CYDEV_PROJ_TYPE_BOOTLOADER EQU 1
CYDEV_PROJ_TYPE_LAUNCHER EQU 5
CYDEV_PROJ_TYPE_LOADABLE EQU 2
CYDEV_PROJ_TYPE_LOADABLEANDBOOTLOADER EQU 4
CYDEV_PROJ_TYPE_MULTIAPPBOOTLOADER EQU 3
CYDEV_PROJ_TYPE_STANDARD EQU 0
CYDEV_PROTECTION_ENABLE EQU 0
CYDEV_STACK_SIZE EQU 0x0800
CYDEV_USE_BUNDLED_CMSIS EQU 1
CYDEV_VARIABLE_VDDA EQU 0
CYDEV_VDDA_MV EQU 5000
CYDEV_VDDD_MV EQU 5000
CYDEV_VDDIO0_MV EQU 5000
CYDEV_VDDIO1_MV EQU 5000
CYDEV_VDDIO2_MV EQU 5000
CYDEV_VDDIO3_MV EQU 5000
CYDEV_VIO0_MV EQU 5000
CYDEV_VIO1_MV EQU 5000
CYDEV_VIO2_MV EQU 5000
CYDEV_VIO3_MV EQU 5000
CYIPBLOCK_ARM_CM3_VERSION EQU 0
CYIPBLOCK_P3_ANAIF_VERSION EQU 0
CYIPBLOCK_P3_CAN_VERSION EQU 0
CYIPBLOCK_P3_CAPSENSE_VERSION EQU 0
CYIPBLOCK_P3_COMP_VERSION EQU 0
CYIPBLOCK_P3_DECIMATOR_VERSION EQU 0
CYIPBLOCK_P3_DFB_VERSION EQU 0
CYIPBLOCK_P3_DMA_VERSION EQU 0
CYIPBLOCK_P3_DRQ_VERSION EQU 0
CYIPBLOCK_P3_DSM_VERSION EQU 0
CYIPBLOCK_P3_EMIF_VERSION EQU 0
CYIPBLOCK_P3_I2C_VERSION EQU 0
CYIPBLOCK_P3_LCD_VERSION EQU 0
CYIPBLOCK_P3_LPF_VERSION EQU 0
CYIPBLOCK_P3_OPAMP_VERSION EQU 0
CYIPBLOCK_P3_PM_VERSION EQU 0
CYIPBLOCK_P3_SCCT_VERSION EQU 0
CYIPBLOCK_P3_TIMER_VERSION EQU 0
CYIPBLOCK_P3_USB_VERSION EQU 0
CYIPBLOCK_P3_VIDAC_VERSION EQU 0
CYIPBLOCK_P3_VREF_VERSION EQU 0
CYIPBLOCK_S8_GPIO_VERSION EQU 0
CYIPBLOCK_S8_IRQ_VERSION EQU 0
CYIPBLOCK_S8_SAR_VERSION EQU 0
CYIPBLOCK_S8_SIO_VERSION EQU 0
CYIPBLOCK_S8_UDB_VERSION EQU 0
DMA_CHANNELS_USED__MASK0 EQU 0x00000000
CYDEV_BOOTLOADER_ENABLE EQU 0
    ENDIF
    END
