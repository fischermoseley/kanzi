# CY8C5888LTI_LP097 register map
File version: 0.1
CY8C58LP
Registers are 8-bit, read-write, no defined reset value unless marked. A register's access mark holds for its fields unless they carry their own. Offsets are from the block's base; lines under a group give offsets from that group; [hi:lo] are bit positions; {n}, {i} and the like mark numbered series; 'fields as' and 'values as' point back to an identical list; <NAME> marks a mode.

## Memory map
0x00000000 DRIVE2
0x00000000 DRIVE1

## DRIVE2
Base 0x00000000
0x4000657A DRIVE2_CONTROL_REG

## DRIVE1
Base 0x00000000
0x4000657B DRIVE1_CONTROL_REG
