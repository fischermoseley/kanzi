/*******************************************************************************
* File Name: cyfittergnu.inc
* 
* PSoC Creator  4.2
*
* Description:
* 
* This file is automatically generated by PSoC Creator.
*
********************************************************************************
* Copyright (c) 2007-2018 Cypress Semiconductor.  All rights reserved.
* You may use this file only in accordance with the license, terms, conditions, 
* disclaimers, and limitations in the end user license agreement accompanying 
* the software package with which this file was provided.
********************************************************************************/

.ifndef INCLUDED_CYFITTERGNU_INC
.set INCLUDED_CYFITTERGNU_INC, 1
.include "cydevicegnu.inc"
.include "cydevicegnu_trm.inc"

/* DRIVE1 */
.set DRIVE1_HA__0__INTTYPE, CYREG_PICU0_INTTYPE6
.set DRIVE1_HA__0__MASK, 0x40
.set DRIVE1_HA__0__PC, CYREG_PRT0_PC6
.set DRIVE1_HA__0__PORT, 0
.set DRIVE1_HA__0__SHIFT, 6
.set DRIVE1_HA__AG, CYREG_PRT0_AG
.set DRIVE1_HA__AMUX, CYREG_PRT0_AMUX
.set DRIVE1_HA__BIE, CYREG_PRT0_BIE
.set DRIVE1_HA__BIT_MASK, CYREG_PRT0_BIT_MASK
.set DRIVE1_HA__BYP, CYREG_PRT0_BYP
.set DRIVE1_HA__CTL, CYREG_PRT0_CTL
.set DRIVE1_HA__DM0, CYREG_PRT0_DM0
.set DRIVE1_HA__DM1, CYREG_PRT0_DM1
.set DRIVE1_HA__DM2, CYREG_PRT0_DM2
.set DRIVE1_HA__DR, CYREG_PRT0_DR
.set DRIVE1_HA__INP_DIS, CYREG_PRT0_INP_DIS
.set DRIVE1_HA__INTTYPE_BASE, CYDEV_PICU_INTTYPE_PICU0_BASE
.set DRIVE1_HA__LCD_COM_SEG, CYREG_PRT0_LCD_COM_SEG
.set DRIVE1_HA__LCD_EN, CYREG_PRT0_LCD_EN
.set DRIVE1_HA__MASK, 0x40
.set DRIVE1_HA__PORT, 0
.set DRIVE1_HA__PRT, CYREG_PRT0_PRT
.set DRIVE1_HA__PRTDSI__CAPS_SEL, CYREG_PRT0_CAPS_SEL
.set DRIVE1_HA__PRTDSI__DBL_SYNC_IN, CYREG_PRT0_DBL_SYNC_IN
.set DRIVE1_HA__PRTDSI__OE_SEL0, CYREG_PRT0_OE_SEL0
.set DRIVE1_HA__PRTDSI__OE_SEL1, CYREG_PRT0_OE_SEL1
.set DRIVE1_HA__PRTDSI__OUT_SEL0, CYREG_PRT0_OUT_SEL0
.set DRIVE1_HA__PRTDSI__OUT_SEL1, CYREG_PRT0_OUT_SEL1
.set DRIVE1_HA__PRTDSI__SYNC_OUT, CYREG_PRT0_SYNC_OUT
.set DRIVE1_HA__PS, CYREG_PRT0_PS
.set DRIVE1_HA__SHIFT, 6
.set DRIVE1_HA__SLW, CYREG_PRT0_SLW
.set DRIVE1_HB__0__INTTYPE, CYREG_PICU1_INTTYPE4
.set DRIVE1_HB__0__MASK, 0x10
.set DRIVE1_HB__0__PC, CYREG_PRT1_PC4
.set DRIVE1_HB__0__PORT, 1
.set DRIVE1_HB__0__SHIFT, 4
.set DRIVE1_HB__AG, CYREG_PRT1_AG
.set DRIVE1_HB__AMUX, CYREG_PRT1_AMUX
.set DRIVE1_HB__BIE, CYREG_PRT1_BIE
.set DRIVE1_HB__BIT_MASK, CYREG_PRT1_BIT_MASK
.set DRIVE1_HB__BYP, CYREG_PRT1_BYP
.set DRIVE1_HB__CTL, CYREG_PRT1_CTL
.set DRIVE1_HB__DM0, CYREG_PRT1_DM0
.set DRIVE1_HB__DM1, CYREG_PRT1_DM1
.set DRIVE1_HB__DM2, CYREG_PRT1_DM2
.set DRIVE1_HB__DR, CYREG_PRT1_DR
.set DRIVE1_HB__INP_DIS, CYREG_PRT1_INP_DIS
.set DRIVE1_HB__INTTYPE_BASE, CYDEV_PICU_INTTYPE_PICU1_BASE
.set DRIVE1_HB__LCD_COM_SEG, CYREG_PRT1_LCD_COM_SEG
.set DRIVE1_HB__LCD_EN, CYREG_PRT1_LCD_EN
.set DRIVE1_HB__MASK, 0x10
.set DRIVE1_HB__PORT, 1
.set DRIVE1_HB__PRT, CYREG_PRT1_PRT
.set DRIVE1_HB__PRTDSI__CAPS_SEL, CYREG_PRT1_CAPS_SEL
.set DRIVE1_HB__PRTDSI__DBL_SYNC_IN, CYREG_PRT1_DBL_SYNC_IN
.set DRIVE1_HB__PRTDSI__OE_SEL0, CYREG_PRT1_OE_SEL0
.set DRIVE1_HB__PRTDSI__OE_SEL1, CYREG_PRT1_OE_SEL1
.set DRIVE1_HB__PRTDSI__OUT_SEL0, CYREG_PRT1_OUT_SEL0
.set DRIVE1_HB__PRTDSI__OUT_SEL1, CYREG_PRT1_OUT_SEL1
.set DRIVE1_HB__PRTDSI__SYNC_OUT, CYREG_PRT1_SYNC_OUT
.set DRIVE1_HB__PS, CYREG_PRT1_PS
.set DRIVE1_HB__SHIFT, 4
.set DRIVE1_HB__SLW, CYREG_PRT1_SLW
.set DRIVE1_HC__0__INTTYPE, CYREG_PICU1_INTTYPE6
.set DRIVE1_HC__0__MASK, 0x40
.set DRIVE1_HC__0__PC, CYREG_PRT1_PC6
.set DRIVE1_HC__0__PORT, 1
.set DRIVE1_HC__0__SHIFT, 6
.set DRIVE1_HC__AG, CYREG_PRT1_AG
.set DRIVE1_HC__AMUX, CYREG_PRT1_AMUX
.set DRIVE1_HC__BIE, CYREG_PRT1_BIE
.set DRIVE1_HC__BIT_MASK, CYREG_PRT1_BIT_MASK
.set DRIVE1_HC__BYP, CYREG_PRT1_BYP
.set DRIVE1_HC__CTL, CYREG_PRT1_CTL
.set DRIVE1_HC__DM0, CYREG_PRT1_DM0
.set DRIVE1_HC__DM1, CYREG_PRT1_DM1
.set DRIVE1_HC__DM2, CYREG_PRT1_DM2
.set DRIVE1_HC__DR, CYREG_PRT1_DR
.set DRIVE1_HC__INP_DIS, CYREG_PRT1_INP_DIS
.set DRIVE1_HC__INTTYPE_BASE, CYDEV_PICU_INTTYPE_PICU1_BASE
.set DRIVE1_HC__LCD_COM_SEG, CYREG_PRT1_LCD_COM_SEG
.set DRIVE1_HC__LCD_EN, CYREG_PRT1_LCD_EN
.set DRIVE1_HC__MASK, 0x40
.set DRIVE1_HC__PORT, 1
.set DRIVE1_HC__PRT, CYREG_PRT1_PRT
.set DRIVE1_HC__PRTDSI__CAPS_SEL, CYREG_PRT1_CAPS_SEL
.set DRIVE1_HC__PRTDSI__DBL_SYNC_IN, CYREG_PRT1_DBL_SYNC_IN
.set DRIVE1_HC__PRTDSI__OE_SEL0, CYREG_PRT1_OE_SEL0
.set DRIVE1_HC__PRTDSI__OE_SEL1, CYREG_PRT1_OE_SEL1
.set DRIVE1_HC__PRTDSI__OUT_SEL0, CYREG_PRT1_OUT_SEL0
.set DRIVE1_HC__PRTDSI__OUT_SEL1, CYREG_PRT1_OUT_SEL1
.set DRIVE1_HC__PRTDSI__SYNC_OUT, CYREG_PRT1_SYNC_OUT
.set DRIVE1_HC__PS, CYREG_PRT1_PS
.set DRIVE1_HC__SHIFT, 6
.set DRIVE1_HC__SLW, CYREG_PRT1_SLW
.set DRIVE1_LA__0__INTTYPE, CYREG_PICU1_INTTYPE2
.set DRIVE1_LA__0__MASK, 0x04
.set DRIVE1_LA__0__PC, CYREG_PRT1_PC2
.set DRIVE1_LA__0__PORT, 1
.set DRIVE1_LA__0__SHIFT, 2
.set DRIVE1_LA__AG, CYREG_PRT1_AG
.set DRIVE1_LA__AMUX, CYREG_PRT1_AMUX
.set DRIVE1_LA__BIE, CYREG_PRT1_BIE
.set DRIVE1_LA__BIT_MASK, CYREG_PRT1_BIT_MASK
.set DRIVE1_LA__BYP, CYREG_PRT1_BYP
.set DRIVE1_LA__CTL, CYREG_PRT1_CTL
.set DRIVE1_LA__DM0, CYREG_PRT1_DM0
.set DRIVE1_LA__DM1, CYREG_PRT1_DM1
.set DRIVE1_LA__DM2, CYREG_PRT1_DM2
.set DRIVE1_LA__DR, CYREG_PRT1_DR
.set DRIVE1_LA__INP_DIS, CYREG_PRT1_INP_DIS
.set DRIVE1_LA__INTTYPE_BASE, CYDEV_PICU_INTTYPE_PICU1_BASE
.set DRIVE1_LA__LCD_COM_SEG, CYREG_PRT1_LCD_COM_SEG
.set DRIVE1_LA__LCD_EN, CYREG_PRT1_LCD_EN
.set DRIVE1_LA__MASK, 0x04
.set DRIVE1_LA__PORT, 1
.set DRIVE1_LA__PRT, CYREG_PRT1_PRT
.set DRIVE1_LA__PRTDSI__CAPS_SEL, CYREG_PRT1_CAPS_SEL
.set DRIVE1_LA__PRTDSI__DBL_SYNC_IN, CYREG_PRT1_DBL_SYNC_IN
.set DRIVE1_LA__PRTDSI__OE_SEL0, CYREG_PRT1_OE_SEL0
.set DRIVE1_LA__PRTDSI__OE_SEL1, CYREG_PRT1_OE_SEL1
.set DRIVE1_LA__PRTDSI__OUT_SEL0, CYREG_PRT1_OUT_SEL0
.set DRIVE1_LA__PRTDSI__OUT_SEL1, CYREG_PRT1_OUT_SEL1
.set DRIVE1_LA__PRTDSI__SYNC_OUT, CYREG_PRT1_SYNC_OUT
.set DRIVE1_LA__PS, CYREG_PRT1_PS
.set DRIVE1_LA__SHIFT, 2
.set DRIVE1_LA__SLW, CYREG_PRT1_SLW
.set DRIVE1_LB__0__INTTYPE, CYREG_PICU0_INTTYPE7
.set DRIVE1_LB__0__MASK, 0x80
.set DRIVE1_LB__0__PC, CYREG_PRT0_PC7
.set DRIVE1_LB__0__PORT, 0
.set DRIVE1_LB__0__SHIFT, 7
.set DRIVE1_LB__AG, CYREG_PRT0_AG
.set DRIVE1_LB__AMUX, CYREG_PRT0_AMUX
.set DRIVE1_LB__BIE, CYREG_PRT0_BIE
.set DRIVE1_LB__BIT_MASK, CYREG_PRT0_BIT_MASK
.set DRIVE1_LB__BYP, CYREG_PRT0_BYP
.set DRIVE1_LB__CTL, CYREG_PRT0_CTL
.set DRIVE1_LB__DM0, CYREG_PRT0_DM0
.set DRIVE1_LB__DM1, CYREG_PRT0_DM1
.set DRIVE1_LB__DM2, CYREG_PRT0_DM2
.set DRIVE1_LB__DR, CYREG_PRT0_DR
.set DRIVE1_LB__INP_DIS, CYREG_PRT0_INP_DIS
.set DRIVE1_LB__INTTYPE_BASE, CYDEV_PICU_INTTYPE_PICU0_BASE
.set DRIVE1_LB__LCD_COM_SEG, CYREG_PRT0_LCD_COM_SEG
.set DRIVE1_LB__LCD_EN, CYREG_PRT0_LCD_EN
.set DRIVE1_LB__MASK, 0x80
.set DRIVE1_LB__PORT, 0
.set DRIVE1_LB__PRT, CYREG_PRT0_PRT
.set DRIVE1_LB__PRTDSI__CAPS_SEL, CYREG_PRT0_CAPS_SEL
.set DRIVE1_LB__PRTDSI__DBL_SYNC_IN, CYREG_PRT0_DBL_SYNC_IN
.set DRIVE1_LB__PRTDSI__OE_SEL0, CYREG_PRT0_OE_SEL0
.set DRIVE1_LB__PRTDSI__OE_SEL1, CYREG_PRT0_OE_SEL1
.set DRIVE1_LB__PRTDSI__OUT_SEL0, CYREG_PRT0_OUT_SEL0
.set DRIVE1_LB__PRTDSI__OUT_SEL1, CYREG_PRT0_OUT_SEL1
.set DRIVE1_LB__PRTDSI__SYNC_OUT, CYREG_PRT0_SYNC_OUT
.set DRIVE1_LB__PS, CYREG_PRT0_PS
.set DRIVE1_LB__SHIFT, 7
.set DRIVE1_LB__SLW, CYREG_PRT0_SLW
.set DRIVE1_LC__0__INTTYPE, CYREG_PICU1_INTTYPE5
.set DRIVE1_LC__0__MASK, 0x20
.set DRIVE1_LC__0__PC, CYREG_PRT1_PC5
.set DRIVE1_LC__0__PORT, 1
.set DRIVE1_LC__0__SHIFT, 5
.set DRIVE1_LC__AG, CYREG_PRT1_AG
.set DRIVE1_LC__AMUX, CYREG_PRT1_AMUX
.set DRIVE1_LC__BIE, CYREG_PRT1_BIE
.set DRIVE1_LC__BIT_MASK, CYREG_PRT1_BIT_MASK
.set DRIVE1_LC__BYP, CYREG_PRT1_BYP
.set DRIVE1_LC__CTL, CYREG_PRT1_CTL
.set DRIVE1_LC__DM0, CYREG_PRT1_DM0
.set DRIVE1_LC__DM1, CYREG_PRT1_DM1
.set DRIVE1_LC__DM2, CYREG_PRT1_DM2
.set DRIVE1_LC__DR, CYREG_PRT1_DR
.set DRIVE1_LC__INP_DIS, CYREG_PRT1_INP_DIS
.set DRIVE1_LC__INTTYPE_BASE, CYDEV_PICU_INTTYPE_PICU1_BASE
.set DRIVE1_LC__LCD_COM_SEG, CYREG_PRT1_LCD_COM_SEG
.set DRIVE1_LC__LCD_EN, CYREG_PRT1_LCD_EN
.set DRIVE1_LC__MASK, 0x20
.set DRIVE1_LC__PORT, 1
.set DRIVE1_LC__PRT, CYREG_PRT1_PRT
.set DRIVE1_LC__PRTDSI__CAPS_SEL, CYREG_PRT1_CAPS_SEL
.set DRIVE1_LC__PRTDSI__DBL_SYNC_IN, CYREG_PRT1_DBL_SYNC_IN
.set DRIVE1_LC__PRTDSI__OE_SEL0, CYREG_PRT1_OE_SEL0
.set DRIVE1_LC__PRTDSI__OE_SEL1, CYREG_PRT1_OE_SEL1
.set DRIVE1_LC__PRTDSI__OUT_SEL0, CYREG_PRT1_OUT_SEL0
.set DRIVE1_LC__PRTDSI__OUT_SEL1, CYREG_PRT1_OUT_SEL1
.set DRIVE1_LC__PRTDSI__SYNC_OUT, CYREG_PRT1_SYNC_OUT
.set DRIVE1_LC__PS, CYREG_PRT1_PS
.set DRIVE1_LC__SHIFT, 5
.set DRIVE1_LC__SLW, CYREG_PRT1_SLW
.set DRIVE1_Sync_ctrl_reg__0__MASK, 0x01
.set DRIVE1_Sync_ctrl_reg__0__POS, 0
.set DRIVE1_Sync_ctrl_reg__1__MASK, 0x02
.set DRIVE1_Sync_ctrl_reg__1__POS, 1
.set DRIVE1_Sync_ctrl_reg__2__MASK, 0x04
.set DRIVE1_Sync_ctrl_reg__2__POS, 2
.set DRIVE1_Sync_ctrl_reg__3__MASK, 0x08
.set DRIVE1_Sync_ctrl_reg__3__POS, 3
.set DRIVE1_Sync_ctrl_reg__4__MASK, 0x10
.set DRIVE1_Sync_ctrl_reg__4__POS, 4
.set DRIVE1_Sync_ctrl_reg__5__MASK, 0x20
.set DRIVE1_Sync_ctrl_reg__5__POS, 5
.set DRIVE1_Sync_ctrl_reg__CONTROL_AUX_CTL_REG, CYREG_B1_UDB11_ACTL
.set DRIVE1_Sync_ctrl_reg__CONTROL_REG, CYREG_B1_UDB11_CTL
.set DRIVE1_Sync_ctrl_reg__CONTROL_ST_REG, CYREG_B1_UDB11_ST_CTL
.set DRIVE1_Sync_ctrl_reg__COUNT_REG, CYREG_B1_UDB11_CTL
.set DRIVE1_Sync_ctrl_reg__COUNT_ST_REG, CYREG_B1_UDB11_ST_CTL
.set DRIVE1_Sync_ctrl_reg__MASK, 0x3F
.set DRIVE1_Sync_ctrl_reg__MASK_CTL_AUX_CTL_REG, CYREG_B1_UDB11_MSK_ACTL
.set DRIVE1_Sync_ctrl_reg__PER_CTL_AUX_CTL_REG, CYREG_B1_UDB11_MSK_ACTL
.set DRIVE1_Sync_ctrl_reg__PERIOD_REG, CYREG_B1_UDB11_MSK

/* DRIVE2 */
.set DRIVE2_HA__0__INTTYPE, CYREG_PICU2_INTTYPE4
.set DRIVE2_HA__0__MASK, 0x10
.set DRIVE2_HA__0__PC, CYREG_PRT2_PC4
.set DRIVE2_HA__0__PORT, 2
.set DRIVE2_HA__0__SHIFT, 4
.set DRIVE2_HA__AG, CYREG_PRT2_AG
.set DRIVE2_HA__AMUX, CYREG_PRT2_AMUX
.set DRIVE2_HA__BIE, CYREG_PRT2_BIE
.set DRIVE2_HA__BIT_MASK, CYREG_PRT2_BIT_MASK
.set DRIVE2_HA__BYP, CYREG_PRT2_BYP
.set DRIVE2_HA__CTL, CYREG_PRT2_CTL
.set DRIVE2_HA__DM0, CYREG_PRT2_DM0
.set DRIVE2_HA__DM1, CYREG_PRT2_DM1
.set DRIVE2_HA__DM2, CYREG_PRT2_DM2
.set DRIVE2_HA__DR, CYREG_PRT2_DR
.set DRIVE2_HA__INP_DIS, CYREG_PRT2_INP_DIS
.set DRIVE2_HA__INTTYPE_BASE, CYDEV_PICU_INTTYPE_PICU2_BASE
.set DRIVE2_HA__LCD_COM_SEG, CYREG_PRT2_LCD_COM_SEG
.set DRIVE2_HA__LCD_EN, CYREG_PRT2_LCD_EN
.set DRIVE2_HA__MASK, 0x10
.set DRIVE2_HA__PORT, 2
.set DRIVE2_HA__PRT, CYREG_PRT2_PRT
.set DRIVE2_HA__PRTDSI__CAPS_SEL, CYREG_PRT2_CAPS_SEL
.set DRIVE2_HA__PRTDSI__DBL_SYNC_IN, CYREG_PRT2_DBL_SYNC_IN
.set DRIVE2_HA__PRTDSI__OE_SEL0, CYREG_PRT2_OE_SEL0
.set DRIVE2_HA__PRTDSI__OE_SEL1, CYREG_PRT2_OE_SEL1
.set DRIVE2_HA__PRTDSI__OUT_SEL0, CYREG_PRT2_OUT_SEL0
.set DRIVE2_HA__PRTDSI__OUT_SEL1, CYREG_PRT2_OUT_SEL1
.set DRIVE2_HA__PRTDSI__SYNC_OUT, CYREG_PRT2_SYNC_OUT
.set DRIVE2_HA__PS, CYREG_PRT2_PS
.set DRIVE2_HA__SHIFT, 4
.set DRIVE2_HA__SLW, CYREG_PRT2_SLW
.set DRIVE2_HB__0__INTTYPE, CYREG_PICU1_INTTYPE7
.set DRIVE2_HB__0__MASK, 0x80
.set DRIVE2_HB__0__PC, CYREG_PRT1_PC7
.set DRIVE2_HB__0__PORT, 1
.set DRIVE2_HB__0__SHIFT, 7
.set DRIVE2_HB__AG, CYREG_PRT1_AG
.set DRIVE2_HB__AMUX, CYREG_PRT1_AMUX
.set DRIVE2_HB__BIE, CYREG_PRT1_BIE
.set DRIVE2_HB__BIT_MASK, CYREG_PRT1_BIT_MASK
.set DRIVE2_HB__BYP, CYREG_PRT1_BYP
.set DRIVE2_HB__CTL, CYREG_PRT1_CTL
.set DRIVE2_HB__DM0, CYREG_PRT1_DM0
.set DRIVE2_HB__DM1, CYREG_PRT1_DM1
.set DRIVE2_HB__DM2, CYREG_PRT1_DM2
.set DRIVE2_HB__DR, CYREG_PRT1_DR
.set DRIVE2_HB__INP_DIS, CYREG_PRT1_INP_DIS
.set DRIVE2_HB__INTTYPE_BASE, CYDEV_PICU_INTTYPE_PICU1_BASE
.set DRIVE2_HB__LCD_COM_SEG, CYREG_PRT1_LCD_COM_SEG
.set DRIVE2_HB__LCD_EN, CYREG_PRT1_LCD_EN
.set DRIVE2_HB__MASK, 0x80
.set DRIVE2_HB__PORT, 1
.set DRIVE2_HB__PRT, CYREG_PRT1_PRT
.set DRIVE2_HB__PRTDSI__CAPS_SEL, CYREG_PRT1_CAPS_SEL
.set DRIVE2_HB__PRTDSI__DBL_SYNC_IN, CYREG_PRT1_DBL_SYNC_IN
.set DRIVE2_HB__PRTDSI__OE_SEL0, CYREG_PRT1_OE_SEL0
.set DRIVE2_HB__PRTDSI__OE_SEL1, CYREG_PRT1_OE_SEL1
.set DRIVE2_HB__PRTDSI__OUT_SEL0, CYREG_PRT1_OUT_SEL0
.set DRIVE2_HB__PRTDSI__OUT_SEL1, CYREG_PRT1_OUT_SEL1
.set DRIVE2_HB__PRTDSI__SYNC_OUT, CYREG_PRT1_SYNC_OUT
.set DRIVE2_HB__PS, CYREG_PRT1_PS
.set DRIVE2_HB__SHIFT, 7
.set DRIVE2_HB__SLW, CYREG_PRT1_SLW
.set DRIVE2_HC__0__INTTYPE, CYREG_PICU2_INTTYPE1
.set DRIVE2_HC__0__MASK, 0x02
.set DRIVE2_HC__0__PC, CYREG_PRT2_PC1
.set DRIVE2_HC__0__PORT, 2
.set DRIVE2_HC__0__SHIFT, 1
.set DRIVE2_HC__AG, CYREG_PRT2_AG
.set DRIVE2_HC__AMUX, CYREG_PRT2_AMUX
.set DRIVE2_HC__BIE, CYREG_PRT2_BIE
.set DRIVE2_HC__BIT_MASK, CYREG_PRT2_BIT_MASK
.set DRIVE2_HC__BYP, CYREG_PRT2_BYP
.set DRIVE2_HC__CTL, CYREG_PRT2_CTL
.set DRIVE2_HC__DM0, CYREG_PRT2_DM0
.set DRIVE2_HC__DM1, CYREG_PRT2_DM1
.set DRIVE2_HC__DM2, CYREG_PRT2_DM2
.set DRIVE2_HC__DR, CYREG_PRT2_DR
.set DRIVE2_HC__INP_DIS, CYREG_PRT2_INP_DIS
.set DRIVE2_HC__INTTYPE_BASE, CYDEV_PICU_INTTYPE_PICU2_BASE
.set DRIVE2_HC__LCD_COM_SEG, CYREG_PRT2_LCD_COM_SEG
.set DRIVE2_HC__LCD_EN, CYREG_PRT2_LCD_EN
.set DRIVE2_HC__MASK, 0x02
.set DRIVE2_HC__PORT, 2
.set DRIVE2_HC__PRT, CYREG_PRT2_PRT
.set DRIVE2_HC__PRTDSI__CAPS_SEL, CYREG_PRT2_CAPS_SEL
.set DRIVE2_HC__PRTDSI__DBL_SYNC_IN, CYREG_PRT2_DBL_SYNC_IN
.set DRIVE2_HC__PRTDSI__OE_SEL0, CYREG_PRT2_OE_SEL0
.set DRIVE2_HC__PRTDSI__OE_SEL1, CYREG_PRT2_OE_SEL1
.set DRIVE2_HC__PRTDSI__OUT_SEL0, CYREG_PRT2_OUT_SEL0
.set DRIVE2_HC__PRTDSI__OUT_SEL1, CYREG_PRT2_OUT_SEL1
.set DRIVE2_HC__PRTDSI__SYNC_OUT, CYREG_PRT2_SYNC_OUT
.set DRIVE2_HC__PS, CYREG_PRT2_PS
.set DRIVE2_HC__SHIFT, 1
.set DRIVE2_HC__SLW, CYREG_PRT2_SLW
.set DRIVE2_LA__0__INTTYPE, CYREG_PICU2_INTTYPE0
.set DRIVE2_LA__0__MASK, 0x01
.set DRIVE2_LA__0__PC, CYREG_PRT2_PC0
.set DRIVE2_LA__0__PORT, 2
.set DRIVE2_LA__0__SHIFT, 0
.set DRIVE2_LA__AG, CYREG_PRT2_AG
.set DRIVE2_LA__AMUX, CYREG_PRT2_AMUX
.set DRIVE2_LA__BIE, CYREG_PRT2_BIE
.set DRIVE2_LA__BIT_MASK, CYREG_PRT2_BIT_MASK
.set DRIVE2_LA__BYP, CYREG_PRT2_BYP
.set DRIVE2_LA__CTL, CYREG_PRT2_CTL
.set DRIVE2_LA__DM0, CYREG_PRT2_DM0
.set DRIVE2_LA__DM1, CYREG_PRT2_DM1
.set DRIVE2_LA__DM2, CYREG_PRT2_DM2
.set DRIVE2_LA__DR, CYREG_PRT2_DR
.set DRIVE2_LA__INP_DIS, CYREG_PRT2_INP_DIS
.set DRIVE2_LA__INTTYPE_BASE, CYDEV_PICU_INTTYPE_PICU2_BASE
.set DRIVE2_LA__LCD_COM_SEG, CYREG_PRT2_LCD_COM_SEG
.set DRIVE2_LA__LCD_EN, CYREG_PRT2_LCD_EN
.set DRIVE2_LA__MASK, 0x01
.set DRIVE2_LA__PORT, 2
.set DRIVE2_LA__PRT, CYREG_PRT2_PRT
.set DRIVE2_LA__PRTDSI__CAPS_SEL, CYREG_PRT2_CAPS_SEL
.set DRIVE2_LA__PRTDSI__DBL_SYNC_IN, CYREG_PRT2_DBL_SYNC_IN
.set DRIVE2_LA__PRTDSI__OE_SEL0, CYREG_PRT2_OE_SEL0
.set DRIVE2_LA__PRTDSI__OE_SEL1, CYREG_PRT2_OE_SEL1
.set DRIVE2_LA__PRTDSI__OUT_SEL0, CYREG_PRT2_OUT_SEL0
.set DRIVE2_LA__PRTDSI__OUT_SEL1, CYREG_PRT2_OUT_SEL1
.set DRIVE2_LA__PRTDSI__SYNC_OUT, CYREG_PRT2_SYNC_OUT
.set DRIVE2_LA__PS, CYREG_PRT2_PS
.set DRIVE2_LA__SHIFT, 0
.set DRIVE2_LA__SLW, CYREG_PRT2_SLW
.set DRIVE2_LB__0__INTTYPE, CYREG_PICU2_INTTYPE2
.set DRIVE2_LB__0__MASK, 0x04
.set DRIVE2_LB__0__PC, CYREG_PRT2_PC2
.set DRIVE2_LB__0__PORT, 2
.set DRIVE2_LB__0__SHIFT, 2
.set DRIVE2_LB__AG, CYREG_PRT2_AG
.set DRIVE2_LB__AMUX, CYREG_PRT2_AMUX
.set DRIVE2_LB__BIE, CYREG_PRT2_BIE
.set DRIVE2_LB__BIT_MASK, CYREG_PRT2_BIT_MASK
.set DRIVE2_LB__BYP, CYREG_PRT2_BYP
.set DRIVE2_LB__CTL, CYREG_PRT2_CTL
.set DRIVE2_LB__DM0, CYREG_PRT2_DM0
.set DRIVE2_LB__DM1, CYREG_PRT2_DM1
.set DRIVE2_LB__DM2, CYREG_PRT2_DM2
.set DRIVE2_LB__DR, CYREG_PRT2_DR
.set DRIVE2_LB__INP_DIS, CYREG_PRT2_INP_DIS
.set DRIVE2_LB__INTTYPE_BASE, CYDEV_PICU_INTTYPE_PICU2_BASE
.set DRIVE2_LB__LCD_COM_SEG, CYREG_PRT2_LCD_COM_SEG
.set DRIVE2_LB__LCD_EN, CYREG_PRT2_LCD_EN
.set DRIVE2_LB__MASK, 0x04
.set DRIVE2_LB__PORT, 2
.set DRIVE2_LB__PRT, CYREG_PRT2_PRT
.set DRIVE2_LB__PRTDSI__CAPS_SEL, CYREG_PRT2_CAPS_SEL
.set DRIVE2_LB__PRTDSI__DBL_SYNC_IN, CYREG_PRT2_DBL_SYNC_IN
.set DRIVE2_LB__PRTDSI__OE_SEL0, CYREG_PRT2_OE_SEL0
.set DRIVE2_LB__PRTDSI__OE_SEL1, CYREG_PRT2_OE_SEL1
.set DRIVE2_LB__PRTDSI__OUT_SEL0, CYREG_PRT2_OUT_SEL0
.set DRIVE2_LB__PRTDSI__OUT_SEL1, CYREG_PRT2_OUT_SEL1
.set DRIVE2_LB__PRTDSI__SYNC_OUT, CYREG_PRT2_SYNC_OUT
.set DRIVE2_LB__PS, CYREG_PRT2_PS
.set DRIVE2_LB__SHIFT, 2
.set DRIVE2_LB__SLW, CYREG_PRT2_SLW
.set DRIVE2_LC__0__INTTYPE, CYREG_PICU2_INTTYPE3
.set DRIVE2_LC__0__MASK, 0x08
.set DRIVE2_LC__0__PC, CYREG_PRT2_PC3
.set DRIVE2_LC__0__PORT, 2
.set DRIVE2_LC__0__SHIFT, 3
.set DRIVE2_LC__AG, CYREG_PRT2_AG
.set DRIVE2_LC__AMUX, CYREG_PRT2_AMUX
.set DRIVE2_LC__BIE, CYREG_PRT2_BIE
.set DRIVE2_LC__BIT_MASK, CYREG_PRT2_BIT_MASK
.set DRIVE2_LC__BYP, CYREG_PRT2_BYP
.set DRIVE2_LC__CTL, CYREG_PRT2_CTL
.set DRIVE2_LC__DM0, CYREG_PRT2_DM0
.set DRIVE2_LC__DM1, CYREG_PRT2_DM1
.set DRIVE2_LC__DM2, CYREG_PRT2_DM2
.set DRIVE2_LC__DR, CYREG_PRT2_DR
.set DRIVE2_LC__INP_DIS, CYREG_PRT2_INP_DIS
.set DRIVE2_LC__INTTYPE_BASE, CYDEV_PICU_INTTYPE_PICU2_BASE
.set DRIVE2_LC__LCD_COM_SEG, CYREG_PRT2_LCD_COM_SEG
.set DRIVE2_LC__LCD_EN, CYREG_PRT2_LCD_EN
.set DRIVE2_LC__MASK, 0x08
.set DRIVE2_LC__PORT, 2
.set DRIVE2_LC__PRT, CYREG_PRT2_PRT
.set DRIVE2_LC__PRTDSI__CAPS_SEL, CYREG_PRT2_CAPS_SEL
.set DRIVE2_LC__PRTDSI__DBL_SYNC_IN, CYREG_PRT2_DBL_SYNC_IN
.set DRIVE2_LC__PRTDSI__OE_SEL0, CYREG_PRT2_OE_SEL0
.set DRIVE2_LC__PRTDSI__OE_SEL1, CYREG_PRT2_OE_SEL1
.set DRIVE2_LC__PRTDSI__OUT_SEL0, CYREG_PRT2_OUT_SEL0
.set DRIVE2_LC__PRTDSI__OUT_SEL1, CYREG_PRT2_OUT_SEL1
.set DRIVE2_LC__PRTDSI__SYNC_OUT, CYREG_PRT2_SYNC_OUT
.set DRIVE2_LC__PS, CYREG_PRT2_PS
.set DRIVE2_LC__SHIFT, 3
.set DRIVE2_LC__SLW, CYREG_PRT2_SLW
.set DRIVE2_Sync_ctrl_reg__0__MASK, 0x01
.set DRIVE2_Sync_ctrl_reg__0__POS, 0
.set DRIVE2_Sync_ctrl_reg__1__MASK, 0x02
.set DRIVE2_Sync_ctrl_reg__1__POS, 1
.set DRIVE2_Sync_ctrl_reg__16BIT_CONTROL_AUX_CTL_REG, CYREG_B1_UDB10_11_ACTL
.set DRIVE2_Sync_ctrl_reg__16BIT_CONTROL_CONTROL_REG, CYREG_B1_UDB10_11_CTL
.set DRIVE2_Sync_ctrl_reg__16BIT_CONTROL_COUNT_REG, CYREG_B1_UDB10_11_CTL
.set DRIVE2_Sync_ctrl_reg__16BIT_COUNT_CONTROL_REG, CYREG_B1_UDB10_11_CTL
.set DRIVE2_Sync_ctrl_reg__16BIT_COUNT_COUNT_REG, CYREG_B1_UDB10_11_CTL
.set DRIVE2_Sync_ctrl_reg__16BIT_MASK_MASK_REG, CYREG_B1_UDB10_11_MSK
.set DRIVE2_Sync_ctrl_reg__16BIT_MASK_PERIOD_REG, CYREG_B1_UDB10_11_MSK
.set DRIVE2_Sync_ctrl_reg__16BIT_PERIOD_MASK_REG, CYREG_B1_UDB10_11_MSK
.set DRIVE2_Sync_ctrl_reg__16BIT_PERIOD_PERIOD_REG, CYREG_B1_UDB10_11_MSK
.set DRIVE2_Sync_ctrl_reg__2__MASK, 0x04
.set DRIVE2_Sync_ctrl_reg__2__POS, 2
.set DRIVE2_Sync_ctrl_reg__3__MASK, 0x08
.set DRIVE2_Sync_ctrl_reg__3__POS, 3
.set DRIVE2_Sync_ctrl_reg__4__MASK, 0x10
.set DRIVE2_Sync_ctrl_reg__4__POS, 4
.set DRIVE2_Sync_ctrl_reg__5__MASK, 0x20
.set DRIVE2_Sync_ctrl_reg__5__POS, 5
.set DRIVE2_Sync_ctrl_reg__CONTROL_AUX_CTL_REG, CYREG_B1_UDB10_ACTL
.set DRIVE2_Sync_ctrl_reg__CONTROL_REG, CYREG_B1_UDB10_CTL
.set DRIVE2_Sync_ctrl_reg__CONTROL_ST_REG, CYREG_B1_UDB10_ST_CTL
.set DRIVE2_Sync_ctrl_reg__COUNT_REG, CYREG_B1_UDB10_CTL
.set DRIVE2_Sync_ctrl_reg__COUNT_ST_REG, CYREG_B1_UDB10_ST_CTL
.set DRIVE2_Sync_ctrl_reg__MASK, 0x3F
.set DRIVE2_Sync_ctrl_reg__MASK_CTL_AUX_CTL_REG, CYREG_B1_UDB10_MSK_ACTL
.set DRIVE2_Sync_ctrl_reg__PER_CTL_AUX_CTL_REG, CYREG_B1_UDB10_MSK_ACTL
.set DRIVE2_Sync_ctrl_reg__PERIOD_REG, CYREG_B1_UDB10_MSK

/* HALL1_A */
.set HALL1_A__0__INTTYPE, CYREG_PICU0_INTTYPE1
.set HALL1_A__0__MASK, 0x02
.set HALL1_A__0__PC, CYREG_PRT0_PC1
.set HALL1_A__0__PORT, 0
.set HALL1_A__0__SHIFT, 1
.set HALL1_A__AG, CYREG_PRT0_AG
.set HALL1_A__AMUX, CYREG_PRT0_AMUX
.set HALL1_A__BIE, CYREG_PRT0_BIE
.set HALL1_A__BIT_MASK, CYREG_PRT0_BIT_MASK
.set HALL1_A__BYP, CYREG_PRT0_BYP
.set HALL1_A__CTL, CYREG_PRT0_CTL
.set HALL1_A__DM0, CYREG_PRT0_DM0
.set HALL1_A__DM1, CYREG_PRT0_DM1
.set HALL1_A__DM2, CYREG_PRT0_DM2
.set HALL1_A__DR, CYREG_PRT0_DR
.set HALL1_A__INP_DIS, CYREG_PRT0_INP_DIS
.set HALL1_A__INTTYPE_BASE, CYDEV_PICU_INTTYPE_PICU0_BASE
.set HALL1_A__LCD_COM_SEG, CYREG_PRT0_LCD_COM_SEG
.set HALL1_A__LCD_EN, CYREG_PRT0_LCD_EN
.set HALL1_A__MASK, 0x02
.set HALL1_A__PORT, 0
.set HALL1_A__PRT, CYREG_PRT0_PRT
.set HALL1_A__PRTDSI__CAPS_SEL, CYREG_PRT0_CAPS_SEL
.set HALL1_A__PRTDSI__DBL_SYNC_IN, CYREG_PRT0_DBL_SYNC_IN
.set HALL1_A__PRTDSI__OE_SEL0, CYREG_PRT0_OE_SEL0
.set HALL1_A__PRTDSI__OE_SEL1, CYREG_PRT0_OE_SEL1
.set HALL1_A__PRTDSI__OUT_SEL0, CYREG_PRT0_OUT_SEL0
.set HALL1_A__PRTDSI__OUT_SEL1, CYREG_PRT0_OUT_SEL1
.set HALL1_A__PRTDSI__SYNC_OUT, CYREG_PRT0_SYNC_OUT
.set HALL1_A__PS, CYREG_PRT0_PS
.set HALL1_A__SHIFT, 1
.set HALL1_A__SLW, CYREG_PRT0_SLW

/* HALL1_B */
.set HALL1_B__0__INTTYPE, CYREG_PICU0_INTTYPE4
.set HALL1_B__0__MASK, 0x10
.set HALL1_B__0__PC, CYREG_PRT0_PC4
.set HALL1_B__0__PORT, 0
.set HALL1_B__0__SHIFT, 4
.set HALL1_B__AG, CYREG_PRT0_AG
.set HALL1_B__AMUX, CYREG_PRT0_AMUX
.set HALL1_B__BIE, CYREG_PRT0_BIE
.set HALL1_B__BIT_MASK, CYREG_PRT0_BIT_MASK
.set HALL1_B__BYP, CYREG_PRT0_BYP
.set HALL1_B__CTL, CYREG_PRT0_CTL
.set HALL1_B__DM0, CYREG_PRT0_DM0
.set HALL1_B__DM1, CYREG_PRT0_DM1
.set HALL1_B__DM2, CYREG_PRT0_DM2
.set HALL1_B__DR, CYREG_PRT0_DR
.set HALL1_B__INP_DIS, CYREG_PRT0_INP_DIS
.set HALL1_B__INTTYPE_BASE, CYDEV_PICU_INTTYPE_PICU0_BASE
.set HALL1_B__LCD_COM_SEG, CYREG_PRT0_LCD_COM_SEG
.set HALL1_B__LCD_EN, CYREG_PRT0_LCD_EN
.set HALL1_B__MASK, 0x10
.set HALL1_B__PORT, 0
.set HALL1_B__PRT, CYREG_PRT0_PRT
.set HALL1_B__PRTDSI__CAPS_SEL, CYREG_PRT0_CAPS_SEL
.set HALL1_B__PRTDSI__DBL_SYNC_IN, CYREG_PRT0_DBL_SYNC_IN
.set HALL1_B__PRTDSI__OE_SEL0, CYREG_PRT0_OE_SEL0
.set HALL1_B__PRTDSI__OE_SEL1, CYREG_PRT0_OE_SEL1
.set HALL1_B__PRTDSI__OUT_SEL0, CYREG_PRT0_OUT_SEL0
.set HALL1_B__PRTDSI__OUT_SEL1, CYREG_PRT0_OUT_SEL1
.set HALL1_B__PRTDSI__SYNC_OUT, CYREG_PRT0_SYNC_OUT
.set HALL1_B__PS, CYREG_PRT0_PS
.set HALL1_B__SHIFT, 4
.set HALL1_B__SLW, CYREG_PRT0_SLW

/* HALL1_C */
.set HALL1_C__0__INTTYPE, CYREG_PICU0_INTTYPE5
.set HALL1_C__0__MASK, 0x20
.set HALL1_C__0__PC, CYREG_PRT0_PC5
.set HALL1_C__0__PORT, 0
.set HALL1_C__0__SHIFT, 5
.set HALL1_C__AG, CYREG_PRT0_AG
.set HALL1_C__AMUX, CYREG_PRT0_AMUX
.set HALL1_C__BIE, CYREG_PRT0_BIE
.set HALL1_C__BIT_MASK, CYREG_PRT0_BIT_MASK
.set HALL1_C__BYP, CYREG_PRT0_BYP
.set HALL1_C__CTL, CYREG_PRT0_CTL
.set HALL1_C__DM0, CYREG_PRT0_DM0
.set HALL1_C__DM1, CYREG_PRT0_DM1
.set HALL1_C__DM2, CYREG_PRT0_DM2
.set HALL1_C__DR, CYREG_PRT0_DR
.set HALL1_C__INP_DIS, CYREG_PRT0_INP_DIS
.set HALL1_C__INTTYPE_BASE, CYDEV_PICU_INTTYPE_PICU0_BASE
.set HALL1_C__LCD_COM_SEG, CYREG_PRT0_LCD_COM_SEG
.set HALL1_C__LCD_EN, CYREG_PRT0_LCD_EN
.set HALL1_C__MASK, 0x20
.set HALL1_C__PORT, 0
.set HALL1_C__PRT, CYREG_PRT0_PRT
.set HALL1_C__PRTDSI__CAPS_SEL, CYREG_PRT0_CAPS_SEL
.set HALL1_C__PRTDSI__DBL_SYNC_IN, CYREG_PRT0_DBL_SYNC_IN
.set HALL1_C__PRTDSI__OE_SEL0, CYREG_PRT0_OE_SEL0
.set HALL1_C__PRTDSI__OE_SEL1, CYREG_PRT0_OE_SEL1
.set HALL1_C__PRTDSI__OUT_SEL0, CYREG_PRT0_OUT_SEL0
.set HALL1_C__PRTDSI__OUT_SEL1, CYREG_PRT0_OUT_SEL1
.set HALL1_C__PRTDSI__SYNC_OUT, CYREG_PRT0_SYNC_OUT
.set HALL1_C__PS, CYREG_PRT0_PS
.set HALL1_C__SHIFT, 5
.set HALL1_C__SLW, CYREG_PRT0_SLW

/* HALL2_A */
.set HALL2_A__0__INTTYPE, CYREG_PICU0_INTTYPE0
.set HALL2_A__0__MASK, 0x01
.set HALL2_A__0__PC, CYREG_PRT0_PC0
.set HALL2_A__0__PORT, 0
.set HALL2_A__0__SHIFT, 0
.set HALL2_A__AG, CYREG_PRT0_AG
.set HALL2_A__AMUX, CYREG_PRT0_AMUX
.set HALL2_A__BIE, CYREG_PRT0_BIE
.set HALL2_A__BIT_MASK, CYREG_PRT0_BIT_MASK
.set HALL2_A__BYP, CYREG_PRT0_BYP
.set HALL2_A__CTL, CYREG_PRT0_CTL
.set HALL2_A__DM0, CYREG_PRT0_DM0
.set HALL2_A__DM1, CYREG_PRT0_DM1
.set HALL2_A__DM2, CYREG_PRT0_DM2
.set HALL2_A__DR, CYREG_PRT0_DR
.set HALL2_A__INP_DIS, CYREG_PRT0_INP_DIS
.set HALL2_A__INTTYPE_BASE, CYDEV_PICU_INTTYPE_PICU0_BASE
.set HALL2_A__LCD_COM_SEG, CYREG_PRT0_LCD_COM_SEG
.set HALL2_A__LCD_EN, CYREG_PRT0_LCD_EN
.set HALL2_A__MASK, 0x01
.set HALL2_A__PORT, 0
.set HALL2_A__PRT, CYREG_PRT0_PRT
.set HALL2_A__PRTDSI__CAPS_SEL, CYREG_PRT0_CAPS_SEL
.set HALL2_A__PRTDSI__DBL_SYNC_IN, CYREG_PRT0_DBL_SYNC_IN
.set HALL2_A__PRTDSI__OE_SEL0, CYREG_PRT0_OE_SEL0
.set HALL2_A__PRTDSI__OE_SEL1, CYREG_PRT0_OE_SEL1
.set HALL2_A__PRTDSI__OUT_SEL0, CYREG_PRT0_OUT_SEL0
.set HALL2_A__PRTDSI__OUT_SEL1, CYREG_PRT0_OUT_SEL1
.set HALL2_A__PRTDSI__SYNC_OUT, CYREG_PRT0_SYNC_OUT
.set HALL2_A__PS, CYREG_PRT0_PS
.set HALL2_A__SHIFT, 0
.set HALL2_A__SLW, CYREG_PRT0_SLW

/* HALL2_B */
.set HALL2_B__0__INTTYPE, CYREG_PICU0_INTTYPE3
.set HALL2_B__0__MASK, 0x08
.set HALL2_B__0__PC, CYREG_PRT0_PC3
.set HALL2_B__0__PORT, 0
.set HALL2_B__0__SHIFT, 3
.set HALL2_B__AG, CYREG_PRT0_AG
.set HALL2_B__AMUX, CYREG_PRT0_AMUX
.set HALL2_B__BIE, CYREG_PRT0_BIE
.set HALL2_B__BIT_MASK, CYREG_PRT0_BIT_MASK
.set HALL2_B__BYP, CYREG_PRT0_BYP
.set HALL2_B__CTL, CYREG_PRT0_CTL
.set HALL2_B__DM0, CYREG_PRT0_DM0
.set HALL2_B__DM1, CYREG_PRT0_DM1
.set HALL2_B__DM2, CYREG_PRT0_DM2
.set HALL2_B__DR, CYREG_PRT0_DR
.set HALL2_B__INP_DIS, CYREG_PRT0_INP_DIS
.set HALL2_B__INTTYPE_BASE, CYDEV_PICU_INTTYPE_PICU0_BASE
.set HALL2_B__LCD_COM_SEG, CYREG_PRT0_LCD_COM_SEG
.set HALL2_B__LCD_EN, CYREG_PRT0_LCD_EN
.set HALL2_B__MASK, 0x08
.set HALL2_B__PORT, 0
.set HALL2_B__PRT, CYREG_PRT0_PRT
.set HALL2_B__PRTDSI__CAPS_SEL, CYREG_PRT0_CAPS_SEL
.set HALL2_B__PRTDSI__DBL_SYNC_IN, CYREG_PRT0_DBL_SYNC_IN
.set HALL2_B__PRTDSI__OE_SEL0, CYREG_PRT0_OE_SEL0
.set HALL2_B__PRTDSI__OE_SEL1, CYREG_PRT0_OE_SEL1
.set HALL2_B__PRTDSI__OUT_SEL0, CYREG_PRT0_OUT_SEL0
.set HALL2_B__PRTDSI__OUT_SEL1, CYREG_PRT0_OUT_SEL1
.set HALL2_B__PRTDSI__SYNC_OUT, CYREG_PRT0_SYNC_OUT
.set HALL2_B__PS, CYREG_PRT0_PS
.set HALL2_B__SHIFT, 3
.set HALL2_B__SLW, CYREG_PRT0_SLW

/* HALL2_C */
.set HALL2_C__0__INTTYPE, CYREG_PICU0_INTTYPE2
.set HALL2_C__0__MASK, 0x04
.set HALL2_C__0__PC, CYREG_PRT0_PC2
.set HALL2_C__0__PORT, 0
.set HALL2_C__0__SHIFT, 2
.set HALL2_C__AG, CYREG_PRT0_AG
.set HALL2_C__AMUX, CYREG_PRT0_AMUX
.set HALL2_C__BIE, CYREG_PRT0_BIE
.set HALL2_C__BIT_MASK, CYREG_PRT0_BIT_MASK
.set HALL2_C__BYP, CYREG_PRT0_BYP
.set HALL2_C__CTL, CYREG_PRT0_CTL
.set HALL2_C__DM0, CYREG_PRT0_DM0
.set HALL2_C__DM1, CYREG_PRT0_DM1
.set HALL2_C__DM2, CYREG_PRT0_DM2
.set HALL2_C__DR, CYREG_PRT0_DR
.set HALL2_C__INP_DIS, CYREG_PRT0_INP_DIS
.set HALL2_C__INTTYPE_BASE, CYDEV_PICU_INTTYPE_PICU0_BASE
.set HALL2_C__LCD_COM_SEG, CYREG_PRT0_LCD_COM_SEG
.set HALL2_C__LCD_EN, CYREG_PRT0_LCD_EN
.set HALL2_C__MASK, 0x04
.set HALL2_C__PORT, 0
.set HALL2_C__PRT, CYREG_PRT0_PRT
.set HALL2_C__PRTDSI__CAPS_SEL, CYREG_PRT0_CAPS_SEL
.set HALL2_C__PRTDSI__DBL_SYNC_IN, CYREG_PRT0_DBL_SYNC_IN
.set HALL2_C__PRTDSI__OE_SEL0, CYREG_PRT0_OE_SEL0
.set HALL2_C__PRTDSI__OE_SEL1, CYREG_PRT0_OE_SEL1
.set HALL2_C__PRTDSI__OUT_SEL0, CYREG_PRT0_OUT_SEL0
.set HALL2_C__PRTDSI__OUT_SEL1, CYREG_PRT0_OUT_SEL1
.set HALL2_C__PRTDSI__SYNC_OUT, CYREG_PRT0_SYNC_OUT
.set HALL2_C__PS, CYREG_PRT0_PS
.set HALL2_C__SHIFT, 2
.set HALL2_C__SLW, CYREG_PRT0_SLW

/* Miscellaneous */
.set BCLK__BUS_CLK__HZ, 24000000
.set BCLK__BUS_CLK__KHZ, 24000
.set BCLK__BUS_CLK__MHZ, 24
.set CYDEV_CHIP_DIE_LEOPARD, 1
.set CYDEV_CHIP_DIE_PSOC4A, 18
.set CYDEV_CHIP_DIE_PSOC5LP, 2
.set CYDEV_CHIP_DIE_PSOC5TM, 3
.set CYDEV_CHIP_DIE_TMA4, 4
.set CYDEV_CHIP_DIE_UNKNOWN, 0
.set CYDEV_CHIP_FAMILY_FM0P, 5
.set CYDEV_CHIP_FAMILY_FM3, 6
.set CYDEV_CHIP_FAMILY_FM4, 7
.set CYDEV_CHIP_FAMILY_PSOC3, 1
.set CYDEV_CHIP_FAMILY_PSOC4, 2
.set CYDEV_CHIP_FAMILY_PSOC5, 3
.set CYDEV_CHIP_FAMILY_PSOC6, 4
.set CYDEV_CHIP_FAMILY_UNKNOWN, 0
.set CYDEV_CHIP_FAMILY_USED, CYDEV_CHIP_FAMILY_PSOC5
.set CYDEV_CHIP_JTAG_ID, 0x2E161069
.set CYDEV_CHIP_MEMBER_3A, 1
.set CYDEV_CHIP_MEMBER_4A, 18
.set CYDEV_CHIP_MEMBER_4D, 13
.set CYDEV_CHIP_MEMBER_4E, 6
.set CYDEV_CHIP_MEMBER_4F, 19
.set CYDEV_CHIP_MEMBER_4G, 4
.set CYDEV_CHIP_MEMBER_4H, 17
.set CYDEV_CHIP_MEMBER_4I, 23
.set CYDEV_CHIP_MEMBER_4J, 14
.set CYDEV_CHIP_MEMBER_4K, 15
.set CYDEV_CHIP_MEMBER_4L, 22
.set CYDEV_CHIP_MEMBER_4M, 21
.set CYDEV_CHIP_MEMBER_4N, 10
.set CYDEV_CHIP_MEMBER_4O, 7
.set CYDEV_CHIP_MEMBER_4P, 20
.set CYDEV_CHIP_MEMBER_4Q, 12
.set CYDEV_CHIP_MEMBER_4R, 8
.set CYDEV_CHIP_MEMBER_4S, 11
.set CYDEV_CHIP_MEMBER_4T, 9
.set CYDEV_CHIP_MEMBER_4U, 5
.set CYDEV_CHIP_MEMBER_4V, 16
.set CYDEV_CHIP_MEMBER_5A, 3
.set CYDEV_CHIP_MEMBER_5B, 2
.set CYDEV_CHIP_MEMBER_6A, 24
.set CYDEV_CHIP_MEMBER_FM3, 28
.set CYDEV_CHIP_MEMBER_FM4, 29
.set CYDEV_CHIP_MEMBER_PDL_FM0P_TYPE1, 25
.set CYDEV_CHIP_MEMBER_PDL_FM0P_TYPE2, 26
.set CYDEV_CHIP_MEMBER_PDL_FM0P_TYPE3, 27
.set CYDEV_CHIP_MEMBER_UNKNOWN, 0
.set CYDEV_CHIP_MEMBER_USED, CYDEV_CHIP_MEMBER_5B
.set CYDEV_CHIP_DIE_EXPECT, CYDEV_CHIP_MEMBER_USED
.set CYDEV_CHIP_DIE_ACTUAL, CYDEV_CHIP_DIE_EXPECT
.set CYDEV_CHIP_REV_LEOPARD_ES1, 0
.set CYDEV_CHIP_REV_LEOPARD_ES2, 1
.set CYDEV_CHIP_REV_LEOPARD_ES3, 3
.set CYDEV_CHIP_REV_LEOPARD_PRODUCTION, 3
.set CYDEV_CHIP_REV_PSOC4A_ES0, 17
.set CYDEV_CHIP_REV_PSOC4A_PRODUCTION, 17
.set CYDEV_CHIP_REV_PSOC5LP_ES0, 0
.set CYDEV_CHIP_REV_PSOC5LP_PRODUCTION, 0
.set CYDEV_CHIP_REV_PSOC5TM_ES0, 0
.set CYDEV_CHIP_REV_PSOC5TM_ES1, 1
.set CYDEV_CHIP_REV_PSOC5TM_PRODUCTION, 1
.set CYDEV_CHIP_REV_TMA4_ES, 17
.set CYDEV_CHIP_REV_TMA4_ES2, 33
.set CYDEV_CHIP_REV_TMA4_PRODUCTION, 17
.set CYDEV_CHIP_REVISION_3A_ES1, 0
.set CYDEV_CHIP_REVISION_3A_ES2, 1
.set CYDEV_CHIP_REVISION_3A_ES3, 3
.set CYDEV_CHIP_REVISION_3A_PRODUCTION, 3
.set CYDEV_CHIP_REVISION_4A_ES0, 17
.set CYDEV_CHIP_REVISION_4A_PRODUCTION, 17
.set CYDEV_CHIP_REVISION_4D_PRODUCTION, 0
.set CYDEV_CHIP_REVISION_4E_CCG2_NO_USBPD, 0
.set CYDEV_CHIP_REVISION_4E_PRODUCTION, 0
.set CYDEV_CHIP_REVISION_4F_PRODUCTION, 0
.set CYDEV_CHIP_REVISION_4F_PRODUCTION_256DMA, 0
.set CYDEV_CHIP_REVISION_4F_PRODUCTION_256K, 0
.set CYDEV_CHIP_REVISION_4G_ES, 17
.set CYDEV_CHIP_REVISION_4G_ES2, 33
.set CYDEV_CHIP_REVISION_4G_PRODUCTION, 17
.set CYDEV_CHIP_REVISION_4H_PRODUCTION, 0
.set CYDEV_CHIP_REVISION_4I_PRODUCTION, 0
.set CYDEV_CHIP_REVISION_4J_PRODUCTION, 0
.set CYDEV_CHIP_REVISION_4K_PRODUCTION, 0
.set CYDEV_CHIP_REVISION_4L_PRODUCTION, 0
.set CYDEV_CHIP_REVISION_4M_PRODUCTION, 0
.set CYDEV_CHIP_REVISION_4N_PRODUCTION, 0
.set CYDEV_CHIP_REVISION_4O_PRODUCTION, 0
.set CYDEV_CHIP_REVISION_4P_PRODUCTION, 0
.set CYDEV_CHIP_REVISION_4Q_PRODUCTION, 0
.set CYDEV_CHIP_REVISION_4R_PRODUCTION, 0
.set CYDEV_CHIP_REVISION_4S_PRODUCTION, 0
.set CYDEV_CHIP_REVISION_4T_PRODUCTION, 0
.set CYDEV_CHIP_REVISION_4U_PRODUCTION, 0
.set CYDEV_CHIP_REVISION_4V_PRODUCTION, 0
.set CYDEV_CHIP_REVISION_5A_ES0, 0
.set CYDEV_CHIP_REVISION_5A_ES1, 1
.set CYDEV_CHIP_REVISION_5A_PRODUCTION, 1
.set CYDEV_CHIP_REVISION_5B_ES0, 0
.set CYDEV_CHIP_REVISION_5B_PRODUCTION, 0
.set CYDEV_CHIP_REVISION_6A_ES, 17
.set CYDEV_CHIP_REVISION_6A_NO_UDB, 33
.set CYDEV_CHIP_REVISION_6A_PRODUCTION, 33
.set CYDEV_CHIP_REVISION_FM3_PRODUCTION, 0
.set CYDEV_CHIP_REVISION_FM4_PRODUCTION, 0
.set CYDEV_CHIP_REVISION_PDL_FM0P_TYPE1_PRODUCTION, 0
.set CYDEV_CHIP_REVISION_PDL_FM0P_TYPE2_PRODUCTION, 0
.set CYDEV_CHIP_REVISION_PDL_FM0P_TYPE3_PRODUCTION, 0
.set CYDEV_CHIP_REVISION_USED, CYDEV_CHIP_REVISION_5B_PRODUCTION
.set CYDEV_CHIP_REV_EXPECT, CYDEV_CHIP_REVISION_USED
.set CYDEV_CONFIG_FASTBOOT_ENABLED, 1
.set CYDEV_CONFIG_UNUSED_IO_AllowButWarn, 0
.set CYDEV_CONFIG_UNUSED_IO, CYDEV_CONFIG_UNUSED_IO_AllowButWarn
.set CYDEV_CONFIG_UNUSED_IO_AllowWithInfo, 1
.set CYDEV_CONFIG_UNUSED_IO_Disallowed, 2
.set CYDEV_CONFIGURATION_COMPRESSED, 1
.set CYDEV_CONFIGURATION_DMA, 0
.set CYDEV_CONFIGURATION_ECC, 1
.set CYDEV_CONFIGURATION_IMOENABLED, CYDEV_CONFIG_FASTBOOT_ENABLED
.set CYDEV_CONFIGURATION_MODE_COMPRESSED, 0
.set CYDEV_CONFIGURATION_MODE, CYDEV_CONFIGURATION_MODE_COMPRESSED
.set CYDEV_CONFIGURATION_MODE_DMA, 2
.set CYDEV_CONFIGURATION_MODE_UNCOMPRESSED, 1
.set CYDEV_DEBUG_ENABLE_MASK, 0x20
.set CYDEV_DEBUG_ENABLE_REGISTER, CYREG_MLOGIC_DEBUG
.set CYDEV_DEBUGGING_DPS_Disable, 3
.set CYDEV_DEBUGGING_DPS_JTAG_4, 1
.set CYDEV_DEBUGGING_DPS_JTAG_5, 0
.set CYDEV_DEBUGGING_DPS_SWD, 2
.set CYDEV_DEBUGGING_DPS_SWD_SWV, 6
.set CYDEV_DEBUGGING_DPS, CYDEV_DEBUGGING_DPS_SWD_SWV
.set CYDEV_DEBUGGING_ENABLE, 1
.set CYDEV_DEBUGGING_XRES, 0
.set CYDEV_DMA_CHANNELS_AVAILABLE, 24
.set CYDEV_ECC_ENABLE, 0
.set CYDEV_HEAP_SIZE, 0x80
.set CYDEV_INSTRUCT_CACHE_ENABLED, 1
.set CYDEV_INTR_RISING, 0x00000000
.set CYDEV_IS_EXPORTING_CODE, 0
.set CYDEV_IS_IMPORTING_CODE, 0
.set CYDEV_PROJ_TYPE, 0
.set CYDEV_PROJ_TYPE_BOOTLOADER, 1
.set CYDEV_PROJ_TYPE_LAUNCHER, 5
.set CYDEV_PROJ_TYPE_LOADABLE, 2
.set CYDEV_PROJ_TYPE_LOADABLEANDBOOTLOADER, 4
.set CYDEV_PROJ_TYPE_MULTIAPPBOOTLOADER, 3
.set CYDEV_PROJ_TYPE_STANDARD, 0
.set CYDEV_PROTECTION_ENABLE, 0
.set CYDEV_STACK_SIZE, 0x0800
.set CYDEV_USE_BUNDLED_CMSIS, 1
.set CYDEV_VARIABLE_VDDA, 0
.set CYDEV_VDDA_MV, 5000
.set CYDEV_VDDD_MV, 5000
.set CYDEV_VDDIO0_MV, 5000
.set CYDEV_VDDIO1_MV, 5000
.set CYDEV_VDDIO2_MV, 5000
.set CYDEV_VDDIO3_MV, 5000
.set CYDEV_VIO0_MV, 5000
.set CYDEV_VIO1_MV, 5000
.set CYDEV_VIO2_MV, 5000
.set CYDEV_VIO3_MV, 5000
.set CYIPBLOCK_ARM_CM3_VERSION, 0
.set CYIPBLOCK_P3_ANAIF_VERSION, 0
.set CYIPBLOCK_P3_CAN_VERSION, 0
.set CYIPBLOCK_P3_CAPSENSE_VERSION, 0
.set CYIPBLOCK_P3_COMP_VERSION, 0
.set CYIPBLOCK_P3_DECIMATOR_VERSION, 0
.set CYIPBLOCK_P3_DFB_VERSION, 0
.set CYIPBLOCK_P3_DMA_VERSION, 0
.set CYIPBLOCK_P3_DRQ_VERSION, 0
.set CYIPBLOCK_P3_DSM_VERSION, 0
.set CYIPBLOCK_P3_EMIF_VERSION, 0
.set CYIPBLOCK_P3_I2C_VERSION, 0
.set CYIPBLOCK_P3_LCD_VERSION, 0
.set CYIPBLOCK_P3_LPF_VERSION, 0
.set CYIPBLOCK_P3_OPAMP_VERSION, 0
.set CYIPBLOCK_P3_PM_VERSION, 0
.set CYIPBLOCK_P3_SCCT_VERSION, 0
.set CYIPBLOCK_P3_TIMER_VERSION, 0
.set CYIPBLOCK_P3_USB_VERSION, 0
.set CYIPBLOCK_P3_VIDAC_VERSION, 0
.set CYIPBLOCK_P3_VREF_VERSION, 0
.set CYIPBLOCK_S8_GPIO_VERSION, 0
.set CYIPBLOCK_S8_IRQ_VERSION, 0
.set CYIPBLOCK_S8_SAR_VERSION, 0
.set CYIPBLOCK_S8_SIO_VERSION, 0
.set CYIPBLOCK_S8_UDB_VERSION, 0
.set DMA_CHANNELS_USED__MASK0, 0x00000000
.set CYDEV_BOOTLOADER_ENABLE, 0
.endif
