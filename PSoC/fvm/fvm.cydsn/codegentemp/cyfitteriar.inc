;
; File Name: cyfitteriar.inc
; 
; PSoC Creator  4.2
;
; Description:
; 
;
;-------------------------------------------------------------------------------
; Copyright (c) 2007-2018 Cypress Semiconductor.  All rights reserved.
; You may use this file only in accordance with the license, terms, conditions, 
; disclaimers, and limitations in the end user license agreement accompanying 
; the software package with which this file was provided.
;-------------------------------------------------------------------------------

#ifndef INCLUDED_CYFITTERIAR_INC
#define INCLUDED_CYFITTERIAR_INC
    INCLUDE cydeviceiar.inc
    INCLUDE cydeviceiar_trm.inc

/* HA1 */
HA1__0__INTTYPE EQU CYREG_PICU0_INTTYPE1
HA1__0__MASK EQU 0x02
HA1__0__PC EQU CYREG_PRT0_PC1
HA1__0__PORT EQU 0
HA1__0__SHIFT EQU 1
HA1__AG EQU CYREG_PRT0_AG
HA1__AMUX EQU CYREG_PRT0_AMUX
HA1__BIE EQU CYREG_PRT0_BIE
HA1__BIT_MASK EQU CYREG_PRT0_BIT_MASK
HA1__BYP EQU CYREG_PRT0_BYP
HA1__CTL EQU CYREG_PRT0_CTL
HA1__DM0 EQU CYREG_PRT0_DM0
HA1__DM1 EQU CYREG_PRT0_DM1
HA1__DM2 EQU CYREG_PRT0_DM2
HA1__DR EQU CYREG_PRT0_DR
HA1__INP_DIS EQU CYREG_PRT0_INP_DIS
HA1__INTTYPE_BASE EQU CYDEV_PICU_INTTYPE_PICU0_BASE
HA1__LCD_COM_SEG EQU CYREG_PRT0_LCD_COM_SEG
HA1__LCD_EN EQU CYREG_PRT0_LCD_EN
HA1__MASK EQU 0x02
HA1__PORT EQU 0
HA1__PRT EQU CYREG_PRT0_PRT
HA1__PRTDSI__CAPS_SEL EQU CYREG_PRT0_CAPS_SEL
HA1__PRTDSI__DBL_SYNC_IN EQU CYREG_PRT0_DBL_SYNC_IN
HA1__PRTDSI__OE_SEL0 EQU CYREG_PRT0_OE_SEL0
HA1__PRTDSI__OE_SEL1 EQU CYREG_PRT0_OE_SEL1
HA1__PRTDSI__OUT_SEL0 EQU CYREG_PRT0_OUT_SEL0
HA1__PRTDSI__OUT_SEL1 EQU CYREG_PRT0_OUT_SEL1
HA1__PRTDSI__SYNC_OUT EQU CYREG_PRT0_SYNC_OUT
HA1__PS EQU CYREG_PRT0_PS
HA1__SHIFT EQU 1
HA1__SLW EQU CYREG_PRT0_SLW

/* HA2 */
HA2__0__INTTYPE EQU CYREG_PICU3_INTTYPE0
HA2__0__MASK EQU 0x01
HA2__0__PC EQU CYREG_PRT3_PC0
HA2__0__PORT EQU 3
HA2__0__SHIFT EQU 0
HA2__AG EQU CYREG_PRT3_AG
HA2__AMUX EQU CYREG_PRT3_AMUX
HA2__BIE EQU CYREG_PRT3_BIE
HA2__BIT_MASK EQU CYREG_PRT3_BIT_MASK
HA2__BYP EQU CYREG_PRT3_BYP
HA2__CTL EQU CYREG_PRT3_CTL
HA2__DM0 EQU CYREG_PRT3_DM0
HA2__DM1 EQU CYREG_PRT3_DM1
HA2__DM2 EQU CYREG_PRT3_DM2
HA2__DR EQU CYREG_PRT3_DR
HA2__INP_DIS EQU CYREG_PRT3_INP_DIS
HA2__INTTYPE_BASE EQU CYDEV_PICU_INTTYPE_PICU3_BASE
HA2__LCD_COM_SEG EQU CYREG_PRT3_LCD_COM_SEG
HA2__LCD_EN EQU CYREG_PRT3_LCD_EN
HA2__MASK EQU 0x01
HA2__PORT EQU 3
HA2__PRT EQU CYREG_PRT3_PRT
HA2__PRTDSI__CAPS_SEL EQU CYREG_PRT3_CAPS_SEL
HA2__PRTDSI__DBL_SYNC_IN EQU CYREG_PRT3_DBL_SYNC_IN
HA2__PRTDSI__OE_SEL0 EQU CYREG_PRT3_OE_SEL0
HA2__PRTDSI__OE_SEL1 EQU CYREG_PRT3_OE_SEL1
HA2__PRTDSI__OUT_SEL0 EQU CYREG_PRT3_OUT_SEL0
HA2__PRTDSI__OUT_SEL1 EQU CYREG_PRT3_OUT_SEL1
HA2__PRTDSI__SYNC_OUT EQU CYREG_PRT3_SYNC_OUT
HA2__PS EQU CYREG_PRT3_PS
HA2__SHIFT EQU 0
HA2__SLW EQU CYREG_PRT3_SLW

/* HB1 */
HB1__0__INTTYPE EQU CYREG_PICU0_INTTYPE3
HB1__0__MASK EQU 0x08
HB1__0__PC EQU CYREG_PRT0_PC3
HB1__0__PORT EQU 0
HB1__0__SHIFT EQU 3
HB1__AG EQU CYREG_PRT0_AG
HB1__AMUX EQU CYREG_PRT0_AMUX
HB1__BIE EQU CYREG_PRT0_BIE
HB1__BIT_MASK EQU CYREG_PRT0_BIT_MASK
HB1__BYP EQU CYREG_PRT0_BYP
HB1__CTL EQU CYREG_PRT0_CTL
HB1__DM0 EQU CYREG_PRT0_DM0
HB1__DM1 EQU CYREG_PRT0_DM1
HB1__DM2 EQU CYREG_PRT0_DM2
HB1__DR EQU CYREG_PRT0_DR
HB1__INP_DIS EQU CYREG_PRT0_INP_DIS
HB1__INTTYPE_BASE EQU CYDEV_PICU_INTTYPE_PICU0_BASE
HB1__LCD_COM_SEG EQU CYREG_PRT0_LCD_COM_SEG
HB1__LCD_EN EQU CYREG_PRT0_LCD_EN
HB1__MASK EQU 0x08
HB1__PORT EQU 0
HB1__PRT EQU CYREG_PRT0_PRT
HB1__PRTDSI__CAPS_SEL EQU CYREG_PRT0_CAPS_SEL
HB1__PRTDSI__DBL_SYNC_IN EQU CYREG_PRT0_DBL_SYNC_IN
HB1__PRTDSI__OE_SEL0 EQU CYREG_PRT0_OE_SEL0
HB1__PRTDSI__OE_SEL1 EQU CYREG_PRT0_OE_SEL1
HB1__PRTDSI__OUT_SEL0 EQU CYREG_PRT0_OUT_SEL0
HB1__PRTDSI__OUT_SEL1 EQU CYREG_PRT0_OUT_SEL1
HB1__PRTDSI__SYNC_OUT EQU CYREG_PRT0_SYNC_OUT
HB1__PS EQU CYREG_PRT0_PS
HB1__SHIFT EQU 3
HB1__SLW EQU CYREG_PRT0_SLW

/* HB2 */
HB2__0__INTTYPE EQU CYREG_PICU3_INTTYPE2
HB2__0__MASK EQU 0x04
HB2__0__PC EQU CYREG_PRT3_PC2
HB2__0__PORT EQU 3
HB2__0__SHIFT EQU 2
HB2__AG EQU CYREG_PRT3_AG
HB2__AMUX EQU CYREG_PRT3_AMUX
HB2__BIE EQU CYREG_PRT3_BIE
HB2__BIT_MASK EQU CYREG_PRT3_BIT_MASK
HB2__BYP EQU CYREG_PRT3_BYP
HB2__CTL EQU CYREG_PRT3_CTL
HB2__DM0 EQU CYREG_PRT3_DM0
HB2__DM1 EQU CYREG_PRT3_DM1
HB2__DM2 EQU CYREG_PRT3_DM2
HB2__DR EQU CYREG_PRT3_DR
HB2__INP_DIS EQU CYREG_PRT3_INP_DIS
HB2__INTTYPE_BASE EQU CYDEV_PICU_INTTYPE_PICU3_BASE
HB2__LCD_COM_SEG EQU CYREG_PRT3_LCD_COM_SEG
HB2__LCD_EN EQU CYREG_PRT3_LCD_EN
HB2__MASK EQU 0x04
HB2__PORT EQU 3
HB2__PRT EQU CYREG_PRT3_PRT
HB2__PRTDSI__CAPS_SEL EQU CYREG_PRT3_CAPS_SEL
HB2__PRTDSI__DBL_SYNC_IN EQU CYREG_PRT3_DBL_SYNC_IN
HB2__PRTDSI__OE_SEL0 EQU CYREG_PRT3_OE_SEL0
HB2__PRTDSI__OE_SEL1 EQU CYREG_PRT3_OE_SEL1
HB2__PRTDSI__OUT_SEL0 EQU CYREG_PRT3_OUT_SEL0
HB2__PRTDSI__OUT_SEL1 EQU CYREG_PRT3_OUT_SEL1
HB2__PRTDSI__SYNC_OUT EQU CYREG_PRT3_SYNC_OUT
HB2__PS EQU CYREG_PRT3_PS
HB2__SHIFT EQU 2
HB2__SLW EQU CYREG_PRT3_SLW

/* HC1 */
HC1__0__INTTYPE EQU CYREG_PICU0_INTTYPE5
HC1__0__MASK EQU 0x20
HC1__0__PC EQU CYREG_PRT0_PC5
HC1__0__PORT EQU 0
HC1__0__SHIFT EQU 5
HC1__AG EQU CYREG_PRT0_AG
HC1__AMUX EQU CYREG_PRT0_AMUX
HC1__BIE EQU CYREG_PRT0_BIE
HC1__BIT_MASK EQU CYREG_PRT0_BIT_MASK
HC1__BYP EQU CYREG_PRT0_BYP
HC1__CTL EQU CYREG_PRT0_CTL
HC1__DM0 EQU CYREG_PRT0_DM0
HC1__DM1 EQU CYREG_PRT0_DM1
HC1__DM2 EQU CYREG_PRT0_DM2
HC1__DR EQU CYREG_PRT0_DR
HC1__INP_DIS EQU CYREG_PRT0_INP_DIS
HC1__INTTYPE_BASE EQU CYDEV_PICU_INTTYPE_PICU0_BASE
HC1__LCD_COM_SEG EQU CYREG_PRT0_LCD_COM_SEG
HC1__LCD_EN EQU CYREG_PRT0_LCD_EN
HC1__MASK EQU 0x20
HC1__PORT EQU 0
HC1__PRT EQU CYREG_PRT0_PRT
HC1__PRTDSI__CAPS_SEL EQU CYREG_PRT0_CAPS_SEL
HC1__PRTDSI__DBL_SYNC_IN EQU CYREG_PRT0_DBL_SYNC_IN
HC1__PRTDSI__OE_SEL0 EQU CYREG_PRT0_OE_SEL0
HC1__PRTDSI__OE_SEL1 EQU CYREG_PRT0_OE_SEL1
HC1__PRTDSI__OUT_SEL0 EQU CYREG_PRT0_OUT_SEL0
HC1__PRTDSI__OUT_SEL1 EQU CYREG_PRT0_OUT_SEL1
HC1__PRTDSI__SYNC_OUT EQU CYREG_PRT0_SYNC_OUT
HC1__PS EQU CYREG_PRT0_PS
HC1__SHIFT EQU 5
HC1__SLW EQU CYREG_PRT0_SLW

/* HC2 */
HC2__0__INTTYPE EQU CYREG_PICU3_INTTYPE4
HC2__0__MASK EQU 0x10
HC2__0__PC EQU CYREG_PRT3_PC4
HC2__0__PORT EQU 3
HC2__0__SHIFT EQU 4
HC2__AG EQU CYREG_PRT3_AG
HC2__AMUX EQU CYREG_PRT3_AMUX
HC2__BIE EQU CYREG_PRT3_BIE
HC2__BIT_MASK EQU CYREG_PRT3_BIT_MASK
HC2__BYP EQU CYREG_PRT3_BYP
HC2__CTL EQU CYREG_PRT3_CTL
HC2__DM0 EQU CYREG_PRT3_DM0
HC2__DM1 EQU CYREG_PRT3_DM1
HC2__DM2 EQU CYREG_PRT3_DM2
HC2__DR EQU CYREG_PRT3_DR
HC2__INP_DIS EQU CYREG_PRT3_INP_DIS
HC2__INTTYPE_BASE EQU CYDEV_PICU_INTTYPE_PICU3_BASE
HC2__LCD_COM_SEG EQU CYREG_PRT3_LCD_COM_SEG
HC2__LCD_EN EQU CYREG_PRT3_LCD_EN
HC2__MASK EQU 0x10
HC2__PORT EQU 3
HC2__PRT EQU CYREG_PRT3_PRT
HC2__PRTDSI__CAPS_SEL EQU CYREG_PRT3_CAPS_SEL
HC2__PRTDSI__DBL_SYNC_IN EQU CYREG_PRT3_DBL_SYNC_IN
HC2__PRTDSI__OE_SEL0 EQU CYREG_PRT3_OE_SEL0
HC2__PRTDSI__OE_SEL1 EQU CYREG_PRT3_OE_SEL1
HC2__PRTDSI__OUT_SEL0 EQU CYREG_PRT3_OUT_SEL0
HC2__PRTDSI__OUT_SEL1 EQU CYREG_PRT3_OUT_SEL1
HC2__PRTDSI__SYNC_OUT EQU CYREG_PRT3_SYNC_OUT
HC2__PS EQU CYREG_PRT3_PS
HC2__SHIFT EQU 4
HC2__SLW EQU CYREG_PRT3_SLW

/* LA1 */
LA1__0__INTTYPE EQU CYREG_PICU0_INTTYPE2
LA1__0__MASK EQU 0x04
LA1__0__PC EQU CYREG_PRT0_PC2
LA1__0__PORT EQU 0
LA1__0__SHIFT EQU 2
LA1__AG EQU CYREG_PRT0_AG
LA1__AMUX EQU CYREG_PRT0_AMUX
LA1__BIE EQU CYREG_PRT0_BIE
LA1__BIT_MASK EQU CYREG_PRT0_BIT_MASK
LA1__BYP EQU CYREG_PRT0_BYP
LA1__CTL EQU CYREG_PRT0_CTL
LA1__DM0 EQU CYREG_PRT0_DM0
LA1__DM1 EQU CYREG_PRT0_DM1
LA1__DM2 EQU CYREG_PRT0_DM2
LA1__DR EQU CYREG_PRT0_DR
LA1__INP_DIS EQU CYREG_PRT0_INP_DIS
LA1__INTTYPE_BASE EQU CYDEV_PICU_INTTYPE_PICU0_BASE
LA1__LCD_COM_SEG EQU CYREG_PRT0_LCD_COM_SEG
LA1__LCD_EN EQU CYREG_PRT0_LCD_EN
LA1__MASK EQU 0x04
LA1__PORT EQU 0
LA1__PRT EQU CYREG_PRT0_PRT
LA1__PRTDSI__CAPS_SEL EQU CYREG_PRT0_CAPS_SEL
LA1__PRTDSI__DBL_SYNC_IN EQU CYREG_PRT0_DBL_SYNC_IN
LA1__PRTDSI__OE_SEL0 EQU CYREG_PRT0_OE_SEL0
LA1__PRTDSI__OE_SEL1 EQU CYREG_PRT0_OE_SEL1
LA1__PRTDSI__OUT_SEL0 EQU CYREG_PRT0_OUT_SEL0
LA1__PRTDSI__OUT_SEL1 EQU CYREG_PRT0_OUT_SEL1
LA1__PRTDSI__SYNC_OUT EQU CYREG_PRT0_SYNC_OUT
LA1__PS EQU CYREG_PRT0_PS
LA1__SHIFT EQU 2
LA1__SLW EQU CYREG_PRT0_SLW

/* LA2 */
LA2__0__INTTYPE EQU CYREG_PICU3_INTTYPE1
LA2__0__MASK EQU 0x02
LA2__0__PC EQU CYREG_PRT3_PC1
LA2__0__PORT EQU 3
LA2__0__SHIFT EQU 1
LA2__AG EQU CYREG_PRT3_AG
LA2__AMUX EQU CYREG_PRT3_AMUX
LA2__BIE EQU CYREG_PRT3_BIE
LA2__BIT_MASK EQU CYREG_PRT3_BIT_MASK
LA2__BYP EQU CYREG_PRT3_BYP
LA2__CTL EQU CYREG_PRT3_CTL
LA2__DM0 EQU CYREG_PRT3_DM0
LA2__DM1 EQU CYREG_PRT3_DM1
LA2__DM2 EQU CYREG_PRT3_DM2
LA2__DR EQU CYREG_PRT3_DR
LA2__INP_DIS EQU CYREG_PRT3_INP_DIS
LA2__INTTYPE_BASE EQU CYDEV_PICU_INTTYPE_PICU3_BASE
LA2__LCD_COM_SEG EQU CYREG_PRT3_LCD_COM_SEG
LA2__LCD_EN EQU CYREG_PRT3_LCD_EN
LA2__MASK EQU 0x02
LA2__PORT EQU 3
LA2__PRT EQU CYREG_PRT3_PRT
LA2__PRTDSI__CAPS_SEL EQU CYREG_PRT3_CAPS_SEL
LA2__PRTDSI__DBL_SYNC_IN EQU CYREG_PRT3_DBL_SYNC_IN
LA2__PRTDSI__OE_SEL0 EQU CYREG_PRT3_OE_SEL0
LA2__PRTDSI__OE_SEL1 EQU CYREG_PRT3_OE_SEL1
LA2__PRTDSI__OUT_SEL0 EQU CYREG_PRT3_OUT_SEL0
LA2__PRTDSI__OUT_SEL1 EQU CYREG_PRT3_OUT_SEL1
LA2__PRTDSI__SYNC_OUT EQU CYREG_PRT3_SYNC_OUT
LA2__PS EQU CYREG_PRT3_PS
LA2__SHIFT EQU 1
LA2__SLW EQU CYREG_PRT3_SLW

/* LB1 */
LB1__0__INTTYPE EQU CYREG_PICU0_INTTYPE4
LB1__0__MASK EQU 0x10
LB1__0__PC EQU CYREG_PRT0_PC4
LB1__0__PORT EQU 0
LB1__0__SHIFT EQU 4
LB1__AG EQU CYREG_PRT0_AG
LB1__AMUX EQU CYREG_PRT0_AMUX
LB1__BIE EQU CYREG_PRT0_BIE
LB1__BIT_MASK EQU CYREG_PRT0_BIT_MASK
LB1__BYP EQU CYREG_PRT0_BYP
LB1__CTL EQU CYREG_PRT0_CTL
LB1__DM0 EQU CYREG_PRT0_DM0
LB1__DM1 EQU CYREG_PRT0_DM1
LB1__DM2 EQU CYREG_PRT0_DM2
LB1__DR EQU CYREG_PRT0_DR
LB1__INP_DIS EQU CYREG_PRT0_INP_DIS
LB1__INTTYPE_BASE EQU CYDEV_PICU_INTTYPE_PICU0_BASE
LB1__LCD_COM_SEG EQU CYREG_PRT0_LCD_COM_SEG
LB1__LCD_EN EQU CYREG_PRT0_LCD_EN
LB1__MASK EQU 0x10
LB1__PORT EQU 0
LB1__PRT EQU CYREG_PRT0_PRT
LB1__PRTDSI__CAPS_SEL EQU CYREG_PRT0_CAPS_SEL
LB1__PRTDSI__DBL_SYNC_IN EQU CYREG_PRT0_DBL_SYNC_IN
LB1__PRTDSI__OE_SEL0 EQU CYREG_PRT0_OE_SEL0
LB1__PRTDSI__OE_SEL1 EQU CYREG_PRT0_OE_SEL1
LB1__PRTDSI__OUT_SEL0 EQU CYREG_PRT0_OUT_SEL0
LB1__PRTDSI__OUT_SEL1 EQU CYREG_PRT0_OUT_SEL1
LB1__PRTDSI__SYNC_OUT EQU CYREG_PRT0_SYNC_OUT
LB1__PS EQU CYREG_PRT0_PS
LB1__SHIFT EQU 4
LB1__SLW EQU CYREG_PRT0_SLW

/* LB2 */
LB2__0__INTTYPE EQU CYREG_PICU3_INTTYPE3
LB2__0__MASK EQU 0x08
LB2__0__PC EQU CYREG_PRT3_PC3
LB2__0__PORT EQU 3
LB2__0__SHIFT EQU 3
LB2__AG EQU CYREG_PRT3_AG
LB2__AMUX EQU CYREG_PRT3_AMUX
LB2__BIE EQU CYREG_PRT3_BIE
LB2__BIT_MASK EQU CYREG_PRT3_BIT_MASK
LB2__BYP EQU CYREG_PRT3_BYP
LB2__CTL EQU CYREG_PRT3_CTL
LB2__DM0 EQU CYREG_PRT3_DM0
LB2__DM1 EQU CYREG_PRT3_DM1
LB2__DM2 EQU CYREG_PRT3_DM2
LB2__DR EQU CYREG_PRT3_DR
LB2__INP_DIS EQU CYREG_PRT3_INP_DIS
LB2__INTTYPE_BASE EQU CYDEV_PICU_INTTYPE_PICU3_BASE
LB2__LCD_COM_SEG EQU CYREG_PRT3_LCD_COM_SEG
LB2__LCD_EN EQU CYREG_PRT3_LCD_EN
LB2__MASK EQU 0x08
LB2__PORT EQU 3
LB2__PRT EQU CYREG_PRT3_PRT
LB2__PRTDSI__CAPS_SEL EQU CYREG_PRT3_CAPS_SEL
LB2__PRTDSI__DBL_SYNC_IN EQU CYREG_PRT3_DBL_SYNC_IN
LB2__PRTDSI__OE_SEL0 EQU CYREG_PRT3_OE_SEL0
LB2__PRTDSI__OE_SEL1 EQU CYREG_PRT3_OE_SEL1
LB2__PRTDSI__OUT_SEL0 EQU CYREG_PRT3_OUT_SEL0
LB2__PRTDSI__OUT_SEL1 EQU CYREG_PRT3_OUT_SEL1
LB2__PRTDSI__SYNC_OUT EQU CYREG_PRT3_SYNC_OUT
LB2__PS EQU CYREG_PRT3_PS
LB2__SHIFT EQU 3
LB2__SLW EQU CYREG_PRT3_SLW

/* LC1 */
LC1__0__INTTYPE EQU CYREG_PICU0_INTTYPE6
LC1__0__MASK EQU 0x40
LC1__0__PC EQU CYREG_PRT0_PC6
LC1__0__PORT EQU 0
LC1__0__SHIFT EQU 6
LC1__AG EQU CYREG_PRT0_AG
LC1__AMUX EQU CYREG_PRT0_AMUX
LC1__BIE EQU CYREG_PRT0_BIE
LC1__BIT_MASK EQU CYREG_PRT0_BIT_MASK
LC1__BYP EQU CYREG_PRT0_BYP
LC1__CTL EQU CYREG_PRT0_CTL
LC1__DM0 EQU CYREG_PRT0_DM0
LC1__DM1 EQU CYREG_PRT0_DM1
LC1__DM2 EQU CYREG_PRT0_DM2
LC1__DR EQU CYREG_PRT0_DR
LC1__INP_DIS EQU CYREG_PRT0_INP_DIS
LC1__INTTYPE_BASE EQU CYDEV_PICU_INTTYPE_PICU0_BASE
LC1__LCD_COM_SEG EQU CYREG_PRT0_LCD_COM_SEG
LC1__LCD_EN EQU CYREG_PRT0_LCD_EN
LC1__MASK EQU 0x40
LC1__PORT EQU 0
LC1__PRT EQU CYREG_PRT0_PRT
LC1__PRTDSI__CAPS_SEL EQU CYREG_PRT0_CAPS_SEL
LC1__PRTDSI__DBL_SYNC_IN EQU CYREG_PRT0_DBL_SYNC_IN
LC1__PRTDSI__OE_SEL0 EQU CYREG_PRT0_OE_SEL0
LC1__PRTDSI__OE_SEL1 EQU CYREG_PRT0_OE_SEL1
LC1__PRTDSI__OUT_SEL0 EQU CYREG_PRT0_OUT_SEL0
LC1__PRTDSI__OUT_SEL1 EQU CYREG_PRT0_OUT_SEL1
LC1__PRTDSI__SYNC_OUT EQU CYREG_PRT0_SYNC_OUT
LC1__PS EQU CYREG_PRT0_PS
LC1__SHIFT EQU 6
LC1__SLW EQU CYREG_PRT0_SLW

/* LC2 */
LC2__0__INTTYPE EQU CYREG_PICU3_INTTYPE5
LC2__0__MASK EQU 0x20
LC2__0__PC EQU CYREG_PRT3_PC5
LC2__0__PORT EQU 3
LC2__0__SHIFT EQU 5
LC2__AG EQU CYREG_PRT3_AG
LC2__AMUX EQU CYREG_PRT3_AMUX
LC2__BIE EQU CYREG_PRT3_BIE
LC2__BIT_MASK EQU CYREG_PRT3_BIT_MASK
LC2__BYP EQU CYREG_PRT3_BYP
LC2__CTL EQU CYREG_PRT3_CTL
LC2__DM0 EQU CYREG_PRT3_DM0
LC2__DM1 EQU CYREG_PRT3_DM1
LC2__DM2 EQU CYREG_PRT3_DM2
LC2__DR EQU CYREG_PRT3_DR
LC2__INP_DIS EQU CYREG_PRT3_INP_DIS
LC2__INTTYPE_BASE EQU CYDEV_PICU_INTTYPE_PICU3_BASE
LC2__LCD_COM_SEG EQU CYREG_PRT3_LCD_COM_SEG
LC2__LCD_EN EQU CYREG_PRT3_LCD_EN
LC2__MASK EQU 0x20
LC2__PORT EQU 3
LC2__PRT EQU CYREG_PRT3_PRT
LC2__PRTDSI__CAPS_SEL EQU CYREG_PRT3_CAPS_SEL
LC2__PRTDSI__DBL_SYNC_IN EQU CYREG_PRT3_DBL_SYNC_IN
LC2__PRTDSI__OE_SEL0 EQU CYREG_PRT3_OE_SEL0
LC2__PRTDSI__OE_SEL1 EQU CYREG_PRT3_OE_SEL1
LC2__PRTDSI__OUT_SEL0 EQU CYREG_PRT3_OUT_SEL0
LC2__PRTDSI__OUT_SEL1 EQU CYREG_PRT3_OUT_SEL1
LC2__PRTDSI__SYNC_OUT EQU CYREG_PRT3_SYNC_OUT
LC2__PS EQU CYREG_PRT3_PS
LC2__SHIFT EQU 5
LC2__SLW EQU CYREG_PRT3_SLW

/* PWM1 */
PWM1__0__INTTYPE EQU CYREG_PICU3_INTTYPE6
PWM1__0__MASK EQU 0x40
PWM1__0__PC EQU CYREG_PRT3_PC6
PWM1__0__PORT EQU 3
PWM1__0__SHIFT EQU 6
PWM1__AG EQU CYREG_PRT3_AG
PWM1__AMUX EQU CYREG_PRT3_AMUX
PWM1__BIE EQU CYREG_PRT3_BIE
PWM1__BIT_MASK EQU CYREG_PRT3_BIT_MASK
PWM1__BYP EQU CYREG_PRT3_BYP
PWM1__CTL EQU CYREG_PRT3_CTL
PWM1__DM0 EQU CYREG_PRT3_DM0
PWM1__DM1 EQU CYREG_PRT3_DM1
PWM1__DM2 EQU CYREG_PRT3_DM2
PWM1__DR EQU CYREG_PRT3_DR
PWM1__INP_DIS EQU CYREG_PRT3_INP_DIS
PWM1__INTTYPE_BASE EQU CYDEV_PICU_INTTYPE_PICU3_BASE
PWM1__LCD_COM_SEG EQU CYREG_PRT3_LCD_COM_SEG
PWM1__LCD_EN EQU CYREG_PRT3_LCD_EN
PWM1__MASK EQU 0x40
PWM1__PORT EQU 3
PWM1__PRT EQU CYREG_PRT3_PRT
PWM1__PRTDSI__CAPS_SEL EQU CYREG_PRT3_CAPS_SEL
PWM1__PRTDSI__DBL_SYNC_IN EQU CYREG_PRT3_DBL_SYNC_IN
PWM1__PRTDSI__OE_SEL0 EQU CYREG_PRT3_OE_SEL0
PWM1__PRTDSI__OE_SEL1 EQU CYREG_PRT3_OE_SEL1
PWM1__PRTDSI__OUT_SEL0 EQU CYREG_PRT3_OUT_SEL0
PWM1__PRTDSI__OUT_SEL1 EQU CYREG_PRT3_OUT_SEL1
PWM1__PRTDSI__SYNC_OUT EQU CYREG_PRT3_SYNC_OUT
PWM1__PS EQU CYREG_PRT3_PS
PWM1__SHIFT EQU 6
PWM1__SLW EQU CYREG_PRT3_SLW

/* PWM2 */
PWM2__0__INTTYPE EQU CYREG_PICU3_INTTYPE7
PWM2__0__MASK EQU 0x80
PWM2__0__PC EQU CYREG_PRT3_PC7
PWM2__0__PORT EQU 3
PWM2__0__SHIFT EQU 7
PWM2__AG EQU CYREG_PRT3_AG
PWM2__AMUX EQU CYREG_PRT3_AMUX
PWM2__BIE EQU CYREG_PRT3_BIE
PWM2__BIT_MASK EQU CYREG_PRT3_BIT_MASK
PWM2__BYP EQU CYREG_PRT3_BYP
PWM2__CTL EQU CYREG_PRT3_CTL
PWM2__DM0 EQU CYREG_PRT3_DM0
PWM2__DM1 EQU CYREG_PRT3_DM1
PWM2__DM2 EQU CYREG_PRT3_DM2
PWM2__DR EQU CYREG_PRT3_DR
PWM2__INP_DIS EQU CYREG_PRT3_INP_DIS
PWM2__INTTYPE_BASE EQU CYDEV_PICU_INTTYPE_PICU3_BASE
PWM2__LCD_COM_SEG EQU CYREG_PRT3_LCD_COM_SEG
PWM2__LCD_EN EQU CYREG_PRT3_LCD_EN
PWM2__MASK EQU 0x80
PWM2__PORT EQU 3
PWM2__PRT EQU CYREG_PRT3_PRT
PWM2__PRTDSI__CAPS_SEL EQU CYREG_PRT3_CAPS_SEL
PWM2__PRTDSI__DBL_SYNC_IN EQU CYREG_PRT3_DBL_SYNC_IN
PWM2__PRTDSI__OE_SEL0 EQU CYREG_PRT3_OE_SEL0
PWM2__PRTDSI__OE_SEL1 EQU CYREG_PRT3_OE_SEL1
PWM2__PRTDSI__OUT_SEL0 EQU CYREG_PRT3_OUT_SEL0
PWM2__PRTDSI__OUT_SEL1 EQU CYREG_PRT3_OUT_SEL1
PWM2__PRTDSI__SYNC_OUT EQU CYREG_PRT3_SYNC_OUT
PWM2__PS EQU CYREG_PRT3_PS
PWM2__SHIFT EQU 7
PWM2__SLW EQU CYREG_PRT3_SLW

/* HALL_A1 */
HALL_A1__0__INTTYPE EQU CYREG_PICU1_INTTYPE5
HALL_A1__0__MASK EQU 0x20
HALL_A1__0__PC EQU CYREG_PRT1_PC5
HALL_A1__0__PORT EQU 1
HALL_A1__0__SHIFT EQU 5
HALL_A1__AG EQU CYREG_PRT1_AG
HALL_A1__AMUX EQU CYREG_PRT1_AMUX
HALL_A1__BIE EQU CYREG_PRT1_BIE
HALL_A1__BIT_MASK EQU CYREG_PRT1_BIT_MASK
HALL_A1__BYP EQU CYREG_PRT1_BYP
HALL_A1__CTL EQU CYREG_PRT1_CTL
HALL_A1__DM0 EQU CYREG_PRT1_DM0
HALL_A1__DM1 EQU CYREG_PRT1_DM1
HALL_A1__DM2 EQU CYREG_PRT1_DM2
HALL_A1__DR EQU CYREG_PRT1_DR
HALL_A1__INP_DIS EQU CYREG_PRT1_INP_DIS
HALL_A1__INTTYPE_BASE EQU CYDEV_PICU_INTTYPE_PICU1_BASE
HALL_A1__LCD_COM_SEG EQU CYREG_PRT1_LCD_COM_SEG
HALL_A1__LCD_EN EQU CYREG_PRT1_LCD_EN
HALL_A1__MASK EQU 0x20
HALL_A1__PORT EQU 1
HALL_A1__PRT EQU CYREG_PRT1_PRT
HALL_A1__PRTDSI__CAPS_SEL EQU CYREG_PRT1_CAPS_SEL
HALL_A1__PRTDSI__DBL_SYNC_IN EQU CYREG_PRT1_DBL_SYNC_IN
HALL_A1__PRTDSI__OE_SEL0 EQU CYREG_PRT1_OE_SEL0
HALL_A1__PRTDSI__OE_SEL1 EQU CYREG_PRT1_OE_SEL1
HALL_A1__PRTDSI__OUT_SEL0 EQU CYREG_PRT1_OUT_SEL0
HALL_A1__PRTDSI__OUT_SEL1 EQU CYREG_PRT1_OUT_SEL1
HALL_A1__PRTDSI__SYNC_OUT EQU CYREG_PRT1_SYNC_OUT
HALL_A1__PS EQU CYREG_PRT1_PS
HALL_A1__SHIFT EQU 5
HALL_A1__SLW EQU CYREG_PRT1_SLW

/* HALL_A2 */
HALL_A2__0__INTTYPE EQU CYREG_PICU12_INTTYPE2
HALL_A2__0__MASK EQU 0x04
HALL_A2__0__PC EQU CYREG_PRT12_PC2
HALL_A2__0__PORT EQU 12
HALL_A2__0__SHIFT EQU 2
HALL_A2__AG EQU CYREG_PRT12_AG
HALL_A2__BIE EQU CYREG_PRT12_BIE
HALL_A2__BIT_MASK EQU CYREG_PRT12_BIT_MASK
HALL_A2__BYP EQU CYREG_PRT12_BYP
HALL_A2__DM0 EQU CYREG_PRT12_DM0
HALL_A2__DM1 EQU CYREG_PRT12_DM1
HALL_A2__DM2 EQU CYREG_PRT12_DM2
HALL_A2__DR EQU CYREG_PRT12_DR
HALL_A2__INP_DIS EQU CYREG_PRT12_INP_DIS
HALL_A2__INTTYPE_BASE EQU CYDEV_PICU_INTTYPE_PICU12_BASE
HALL_A2__MASK EQU 0x04
HALL_A2__PORT EQU 12
HALL_A2__PRT EQU CYREG_PRT12_PRT
HALL_A2__PRTDSI__DBL_SYNC_IN EQU CYREG_PRT12_DBL_SYNC_IN
HALL_A2__PRTDSI__OE_SEL0 EQU CYREG_PRT12_OE_SEL0
HALL_A2__PRTDSI__OE_SEL1 EQU CYREG_PRT12_OE_SEL1
HALL_A2__PRTDSI__OUT_SEL0 EQU CYREG_PRT12_OUT_SEL0
HALL_A2__PRTDSI__OUT_SEL1 EQU CYREG_PRT12_OUT_SEL1
HALL_A2__PRTDSI__SYNC_OUT EQU CYREG_PRT12_SYNC_OUT
HALL_A2__PS EQU CYREG_PRT12_PS
HALL_A2__SHIFT EQU 2
HALL_A2__SIO_CFG EQU CYREG_PRT12_SIO_CFG
HALL_A2__SIO_DIFF EQU CYREG_PRT12_SIO_DIFF
HALL_A2__SIO_HYST_EN EQU CYREG_PRT12_SIO_HYST_EN
HALL_A2__SIO_REG_HIFREQ EQU CYREG_PRT12_SIO_REG_HIFREQ
HALL_A2__SLW EQU CYREG_PRT12_SLW

/* HALL_B1 */
HALL_B1__0__INTTYPE EQU CYREG_PICU1_INTTYPE6
HALL_B1__0__MASK EQU 0x40
HALL_B1__0__PC EQU CYREG_PRT1_PC6
HALL_B1__0__PORT EQU 1
HALL_B1__0__SHIFT EQU 6
HALL_B1__AG EQU CYREG_PRT1_AG
HALL_B1__AMUX EQU CYREG_PRT1_AMUX
HALL_B1__BIE EQU CYREG_PRT1_BIE
HALL_B1__BIT_MASK EQU CYREG_PRT1_BIT_MASK
HALL_B1__BYP EQU CYREG_PRT1_BYP
HALL_B1__CTL EQU CYREG_PRT1_CTL
HALL_B1__DM0 EQU CYREG_PRT1_DM0
HALL_B1__DM1 EQU CYREG_PRT1_DM1
HALL_B1__DM2 EQU CYREG_PRT1_DM2
HALL_B1__DR EQU CYREG_PRT1_DR
HALL_B1__INP_DIS EQU CYREG_PRT1_INP_DIS
HALL_B1__INTTYPE_BASE EQU CYDEV_PICU_INTTYPE_PICU1_BASE
HALL_B1__LCD_COM_SEG EQU CYREG_PRT1_LCD_COM_SEG
HALL_B1__LCD_EN EQU CYREG_PRT1_LCD_EN
HALL_B1__MASK EQU 0x40
HALL_B1__PORT EQU 1
HALL_B1__PRT EQU CYREG_PRT1_PRT
HALL_B1__PRTDSI__CAPS_SEL EQU CYREG_PRT1_CAPS_SEL
HALL_B1__PRTDSI__DBL_SYNC_IN EQU CYREG_PRT1_DBL_SYNC_IN
HALL_B1__PRTDSI__OE_SEL0 EQU CYREG_PRT1_OE_SEL0
HALL_B1__PRTDSI__OE_SEL1 EQU CYREG_PRT1_OE_SEL1
HALL_B1__PRTDSI__OUT_SEL0 EQU CYREG_PRT1_OUT_SEL0
HALL_B1__PRTDSI__OUT_SEL1 EQU CYREG_PRT1_OUT_SEL1
HALL_B1__PRTDSI__SYNC_OUT EQU CYREG_PRT1_SYNC_OUT
HALL_B1__PS EQU CYREG_PRT1_PS
HALL_B1__SHIFT EQU 6
HALL_B1__SLW EQU CYREG_PRT1_SLW

/* HALL_B2 */
HALL_B2__0__INTTYPE EQU CYREG_PICU12_INTTYPE3
HALL_B2__0__MASK EQU 0x08
HALL_B2__0__PC EQU CYREG_PRT12_PC3
HALL_B2__0__PORT EQU 12
HALL_B2__0__SHIFT EQU 3
HALL_B2__AG EQU CYREG_PRT12_AG
HALL_B2__BIE EQU CYREG_PRT12_BIE
HALL_B2__BIT_MASK EQU CYREG_PRT12_BIT_MASK
HALL_B2__BYP EQU CYREG_PRT12_BYP
HALL_B2__DM0 EQU CYREG_PRT12_DM0
HALL_B2__DM1 EQU CYREG_PRT12_DM1
HALL_B2__DM2 EQU CYREG_PRT12_DM2
HALL_B2__DR EQU CYREG_PRT12_DR
HALL_B2__INP_DIS EQU CYREG_PRT12_INP_DIS
HALL_B2__INTTYPE_BASE EQU CYDEV_PICU_INTTYPE_PICU12_BASE
HALL_B2__MASK EQU 0x08
HALL_B2__PORT EQU 12
HALL_B2__PRT EQU CYREG_PRT12_PRT
HALL_B2__PRTDSI__DBL_SYNC_IN EQU CYREG_PRT12_DBL_SYNC_IN
HALL_B2__PRTDSI__OE_SEL0 EQU CYREG_PRT12_OE_SEL0
HALL_B2__PRTDSI__OE_SEL1 EQU CYREG_PRT12_OE_SEL1
HALL_B2__PRTDSI__OUT_SEL0 EQU CYREG_PRT12_OUT_SEL0
HALL_B2__PRTDSI__OUT_SEL1 EQU CYREG_PRT12_OUT_SEL1
HALL_B2__PRTDSI__SYNC_OUT EQU CYREG_PRT12_SYNC_OUT
HALL_B2__PS EQU CYREG_PRT12_PS
HALL_B2__SHIFT EQU 3
HALL_B2__SIO_CFG EQU CYREG_PRT12_SIO_CFG
HALL_B2__SIO_DIFF EQU CYREG_PRT12_SIO_DIFF
HALL_B2__SIO_HYST_EN EQU CYREG_PRT12_SIO_HYST_EN
HALL_B2__SIO_REG_HIFREQ EQU CYREG_PRT12_SIO_REG_HIFREQ
HALL_B2__SLW EQU CYREG_PRT12_SLW

/* HALL_C1 */
HALL_C1__0__INTTYPE EQU CYREG_PICU1_INTTYPE7
HALL_C1__0__MASK EQU 0x80
HALL_C1__0__PC EQU CYREG_PRT1_PC7
HALL_C1__0__PORT EQU 1
HALL_C1__0__SHIFT EQU 7
HALL_C1__AG EQU CYREG_PRT1_AG
HALL_C1__AMUX EQU CYREG_PRT1_AMUX
HALL_C1__BIE EQU CYREG_PRT1_BIE
HALL_C1__BIT_MASK EQU CYREG_PRT1_BIT_MASK
HALL_C1__BYP EQU CYREG_PRT1_BYP
HALL_C1__CTL EQU CYREG_PRT1_CTL
HALL_C1__DM0 EQU CYREG_PRT1_DM0
HALL_C1__DM1 EQU CYREG_PRT1_DM1
HALL_C1__DM2 EQU CYREG_PRT1_DM2
HALL_C1__DR EQU CYREG_PRT1_DR
HALL_C1__INP_DIS EQU CYREG_PRT1_INP_DIS
HALL_C1__INTTYPE_BASE EQU CYDEV_PICU_INTTYPE_PICU1_BASE
HALL_C1__LCD_COM_SEG EQU CYREG_PRT1_LCD_COM_SEG
HALL_C1__LCD_EN EQU CYREG_PRT1_LCD_EN
HALL_C1__MASK EQU 0x80
HALL_C1__PORT EQU 1
HALL_C1__PRT EQU CYREG_PRT1_PRT
HALL_C1__PRTDSI__CAPS_SEL EQU CYREG_PRT1_CAPS_SEL
HALL_C1__PRTDSI__DBL_SYNC_IN EQU CYREG_PRT1_DBL_SYNC_IN
HALL_C1__PRTDSI__OE_SEL0 EQU CYREG_PRT1_OE_SEL0
HALL_C1__PRTDSI__OE_SEL1 EQU CYREG_PRT1_OE_SEL1
HALL_C1__PRTDSI__OUT_SEL0 EQU CYREG_PRT1_OUT_SEL0
HALL_C1__PRTDSI__OUT_SEL1 EQU CYREG_PRT1_OUT_SEL1
HALL_C1__PRTDSI__SYNC_OUT EQU CYREG_PRT1_SYNC_OUT
HALL_C1__PS EQU CYREG_PRT1_PS
HALL_C1__SHIFT EQU 7
HALL_C1__SLW EQU CYREG_PRT1_SLW

/* HALL_C2 */
HALL_C2__0__INTTYPE EQU CYREG_PICU12_INTTYPE4
HALL_C2__0__MASK EQU 0x10
HALL_C2__0__PC EQU CYREG_PRT12_PC4
HALL_C2__0__PORT EQU 12
HALL_C2__0__SHIFT EQU 4
HALL_C2__AG EQU CYREG_PRT12_AG
HALL_C2__BIE EQU CYREG_PRT12_BIE
HALL_C2__BIT_MASK EQU CYREG_PRT12_BIT_MASK
HALL_C2__BYP EQU CYREG_PRT12_BYP
HALL_C2__DM0 EQU CYREG_PRT12_DM0
HALL_C2__DM1 EQU CYREG_PRT12_DM1
HALL_C2__DM2 EQU CYREG_PRT12_DM2
HALL_C2__DR EQU CYREG_PRT12_DR
HALL_C2__INP_DIS EQU CYREG_PRT12_INP_DIS
HALL_C2__INTTYPE_BASE EQU CYDEV_PICU_INTTYPE_PICU12_BASE
HALL_C2__MASK EQU 0x10
HALL_C2__PORT EQU 12
HALL_C2__PRT EQU CYREG_PRT12_PRT
HALL_C2__PRTDSI__DBL_SYNC_IN EQU CYREG_PRT12_DBL_SYNC_IN
HALL_C2__PRTDSI__OE_SEL0 EQU CYREG_PRT12_OE_SEL0
HALL_C2__PRTDSI__OE_SEL1 EQU CYREG_PRT12_OE_SEL1
HALL_C2__PRTDSI__OUT_SEL0 EQU CYREG_PRT12_OUT_SEL0
HALL_C2__PRTDSI__OUT_SEL1 EQU CYREG_PRT12_OUT_SEL1
HALL_C2__PRTDSI__SYNC_OUT EQU CYREG_PRT12_SYNC_OUT
HALL_C2__PS EQU CYREG_PRT12_PS
HALL_C2__SHIFT EQU 4
HALL_C2__SIO_CFG EQU CYREG_PRT12_SIO_CFG
HALL_C2__SIO_DIFF EQU CYREG_PRT12_SIO_DIFF
HALL_C2__SIO_HYST_EN EQU CYREG_PRT12_SIO_HYST_EN
HALL_C2__SIO_REG_HIFREQ EQU CYREG_PRT12_SIO_REG_HIFREQ
HALL_C2__SLW EQU CYREG_PRT12_SLW

/* REVERSE1 */
REVERSE1__0__INTTYPE EQU CYREG_PICU15_INTTYPE0
REVERSE1__0__MASK EQU 0x01
REVERSE1__0__PC EQU CYREG_IO_PC_PRT15_PC0
REVERSE1__0__PORT EQU 15
REVERSE1__0__SHIFT EQU 0
REVERSE1__AG EQU CYREG_PRT15_AG
REVERSE1__AMUX EQU CYREG_PRT15_AMUX
REVERSE1__BIE EQU CYREG_PRT15_BIE
REVERSE1__BIT_MASK EQU CYREG_PRT15_BIT_MASK
REVERSE1__BYP EQU CYREG_PRT15_BYP
REVERSE1__CTL EQU CYREG_PRT15_CTL
REVERSE1__DM0 EQU CYREG_PRT15_DM0
REVERSE1__DM1 EQU CYREG_PRT15_DM1
REVERSE1__DM2 EQU CYREG_PRT15_DM2
REVERSE1__DR EQU CYREG_PRT15_DR
REVERSE1__INP_DIS EQU CYREG_PRT15_INP_DIS
REVERSE1__INTTYPE_BASE EQU CYDEV_PICU_INTTYPE_PICU15_BASE
REVERSE1__LCD_COM_SEG EQU CYREG_PRT15_LCD_COM_SEG
REVERSE1__LCD_EN EQU CYREG_PRT15_LCD_EN
REVERSE1__MASK EQU 0x01
REVERSE1__PORT EQU 15
REVERSE1__PRT EQU CYREG_PRT15_PRT
REVERSE1__PRTDSI__CAPS_SEL EQU CYREG_PRT15_CAPS_SEL
REVERSE1__PRTDSI__DBL_SYNC_IN EQU CYREG_PRT15_DBL_SYNC_IN
REVERSE1__PRTDSI__OE_SEL0 EQU CYREG_PRT15_OE_SEL0
REVERSE1__PRTDSI__OE_SEL1 EQU CYREG_PRT15_OE_SEL1
REVERSE1__PRTDSI__OUT_SEL0 EQU CYREG_PRT15_OUT_SEL0
REVERSE1__PRTDSI__OUT_SEL1 EQU CYREG_PRT15_OUT_SEL1
REVERSE1__PRTDSI__SYNC_OUT EQU CYREG_PRT15_SYNC_OUT
REVERSE1__PS EQU CYREG_PRT15_PS
REVERSE1__SHIFT EQU 0
REVERSE1__SLW EQU CYREG_PRT15_SLW

/* REVERSE2 */
REVERSE2__0__INTTYPE EQU CYREG_PICU15_INTTYPE1
REVERSE2__0__MASK EQU 0x02
REVERSE2__0__PC EQU CYREG_IO_PC_PRT15_PC1
REVERSE2__0__PORT EQU 15
REVERSE2__0__SHIFT EQU 1
REVERSE2__AG EQU CYREG_PRT15_AG
REVERSE2__AMUX EQU CYREG_PRT15_AMUX
REVERSE2__BIE EQU CYREG_PRT15_BIE
REVERSE2__BIT_MASK EQU CYREG_PRT15_BIT_MASK
REVERSE2__BYP EQU CYREG_PRT15_BYP
REVERSE2__CTL EQU CYREG_PRT15_CTL
REVERSE2__DM0 EQU CYREG_PRT15_DM0
REVERSE2__DM1 EQU CYREG_PRT15_DM1
REVERSE2__DM2 EQU CYREG_PRT15_DM2
REVERSE2__DR EQU CYREG_PRT15_DR
REVERSE2__INP_DIS EQU CYREG_PRT15_INP_DIS
REVERSE2__INTTYPE_BASE EQU CYDEV_PICU_INTTYPE_PICU15_BASE
REVERSE2__LCD_COM_SEG EQU CYREG_PRT15_LCD_COM_SEG
REVERSE2__LCD_EN EQU CYREG_PRT15_LCD_EN
REVERSE2__MASK EQU 0x02
REVERSE2__PORT EQU 15
REVERSE2__PRT EQU CYREG_PRT15_PRT
REVERSE2__PRTDSI__CAPS_SEL EQU CYREG_PRT15_CAPS_SEL
REVERSE2__PRTDSI__DBL_SYNC_IN EQU CYREG_PRT15_DBL_SYNC_IN
REVERSE2__PRTDSI__OE_SEL0 EQU CYREG_PRT15_OE_SEL0
REVERSE2__PRTDSI__OE_SEL1 EQU CYREG_PRT15_OE_SEL1
REVERSE2__PRTDSI__OUT_SEL0 EQU CYREG_PRT15_OUT_SEL0
REVERSE2__PRTDSI__OUT_SEL1 EQU CYREG_PRT15_OUT_SEL1
REVERSE2__PRTDSI__SYNC_OUT EQU CYREG_PRT15_SYNC_OUT
REVERSE2__PS EQU CYREG_PRT15_PS
REVERSE2__SHIFT EQU 1
REVERSE2__SLW EQU CYREG_PRT15_SLW

/* Miscellaneous */
BCLK__BUS_CLK__HZ EQU 24000000
BCLK__BUS_CLK__KHZ EQU 24000
BCLK__BUS_CLK__MHZ EQU 24
CYDEV_CHIP_DIE_LEOPARD EQU 1
CYDEV_CHIP_DIE_PSOC4A EQU 18
CYDEV_CHIP_DIE_PSOC5LP EQU 2
CYDEV_CHIP_DIE_PSOC5TM EQU 3
CYDEV_CHIP_DIE_TMA4 EQU 4
CYDEV_CHIP_DIE_UNKNOWN EQU 0
CYDEV_CHIP_FAMILY_FM0P EQU 5
CYDEV_CHIP_FAMILY_FM3 EQU 6
CYDEV_CHIP_FAMILY_FM4 EQU 7
CYDEV_CHIP_FAMILY_PSOC3 EQU 1
CYDEV_CHIP_FAMILY_PSOC4 EQU 2
CYDEV_CHIP_FAMILY_PSOC5 EQU 3
CYDEV_CHIP_FAMILY_PSOC6 EQU 4
CYDEV_CHIP_FAMILY_UNKNOWN EQU 0
CYDEV_CHIP_FAMILY_USED EQU CYDEV_CHIP_FAMILY_PSOC5
CYDEV_CHIP_JTAG_ID EQU 0x2E161069
CYDEV_CHIP_MEMBER_3A EQU 1
CYDEV_CHIP_MEMBER_4A EQU 18
CYDEV_CHIP_MEMBER_4D EQU 13
CYDEV_CHIP_MEMBER_4E EQU 6
CYDEV_CHIP_MEMBER_4F EQU 19
CYDEV_CHIP_MEMBER_4G EQU 4
CYDEV_CHIP_MEMBER_4H EQU 17
CYDEV_CHIP_MEMBER_4I EQU 23
CYDEV_CHIP_MEMBER_4J EQU 14
CYDEV_CHIP_MEMBER_4K EQU 15
CYDEV_CHIP_MEMBER_4L EQU 22
CYDEV_CHIP_MEMBER_4M EQU 21
CYDEV_CHIP_MEMBER_4N EQU 10
CYDEV_CHIP_MEMBER_4O EQU 7
CYDEV_CHIP_MEMBER_4P EQU 20
CYDEV_CHIP_MEMBER_4Q EQU 12
CYDEV_CHIP_MEMBER_4R EQU 8
CYDEV_CHIP_MEMBER_4S EQU 11
CYDEV_CHIP_MEMBER_4T EQU 9
CYDEV_CHIP_MEMBER_4U EQU 5
CYDEV_CHIP_MEMBER_4V EQU 16
CYDEV_CHIP_MEMBER_5A EQU 3
CYDEV_CHIP_MEMBER_5B EQU 2
CYDEV_CHIP_MEMBER_6A EQU 24
CYDEV_CHIP_MEMBER_FM3 EQU 28
CYDEV_CHIP_MEMBER_FM4 EQU 29
CYDEV_CHIP_MEMBER_PDL_FM0P_TYPE1 EQU 25
CYDEV_CHIP_MEMBER_PDL_FM0P_TYPE2 EQU 26
CYDEV_CHIP_MEMBER_PDL_FM0P_TYPE3 EQU 27
CYDEV_CHIP_MEMBER_UNKNOWN EQU 0
CYDEV_CHIP_MEMBER_USED EQU CYDEV_CHIP_MEMBER_5B
CYDEV_CHIP_DIE_EXPECT EQU CYDEV_CHIP_MEMBER_USED
CYDEV_CHIP_DIE_ACTUAL EQU CYDEV_CHIP_DIE_EXPECT
CYDEV_CHIP_REV_LEOPARD_ES1 EQU 0
CYDEV_CHIP_REV_LEOPARD_ES2 EQU 1
CYDEV_CHIP_REV_LEOPARD_ES3 EQU 3
CYDEV_CHIP_REV_LEOPARD_PRODUCTION EQU 3
CYDEV_CHIP_REV_PSOC4A_ES0 EQU 17
CYDEV_CHIP_REV_PSOC4A_PRODUCTION EQU 17
CYDEV_CHIP_REV_PSOC5LP_ES0 EQU 0
CYDEV_CHIP_REV_PSOC5LP_PRODUCTION EQU 0
CYDEV_CHIP_REV_PSOC5TM_ES0 EQU 0
CYDEV_CHIP_REV_PSOC5TM_ES1 EQU 1
CYDEV_CHIP_REV_PSOC5TM_PRODUCTION EQU 1
CYDEV_CHIP_REV_TMA4_ES EQU 17
CYDEV_CHIP_REV_TMA4_ES2 EQU 33
CYDEV_CHIP_REV_TMA4_PRODUCTION EQU 17
CYDEV_CHIP_REVISION_3A_ES1 EQU 0
CYDEV_CHIP_REVISION_3A_ES2 EQU 1
CYDEV_CHIP_REVISION_3A_ES3 EQU 3
CYDEV_CHIP_REVISION_3A_PRODUCTION EQU 3
CYDEV_CHIP_REVISION_4A_ES0 EQU 17
CYDEV_CHIP_REVISION_4A_PRODUCTION EQU 17
CYDEV_CHIP_REVISION_4D_PRODUCTION EQU 0
CYDEV_CHIP_REVISION_4E_CCG2_NO_USBPD EQU 0
CYDEV_CHIP_REVISION_4E_PRODUCTION EQU 0
CYDEV_CHIP_REVISION_4F_PRODUCTION EQU 0
CYDEV_CHIP_REVISION_4F_PRODUCTION_256DMA EQU 0
CYDEV_CHIP_REVISION_4F_PRODUCTION_256K EQU 0
CYDEV_CHIP_REVISION_4G_ES EQU 17
CYDEV_CHIP_REVISION_4G_ES2 EQU 33
CYDEV_CHIP_REVISION_4G_PRODUCTION EQU 17
CYDEV_CHIP_REVISION_4H_PRODUCTION EQU 0
CYDEV_CHIP_REVISION_4I_PRODUCTION EQU 0
CYDEV_CHIP_REVISION_4J_PRODUCTION EQU 0
CYDEV_CHIP_REVISION_4K_PRODUCTION EQU 0
CYDEV_CHIP_REVISION_4L_PRODUCTION EQU 0
CYDEV_CHIP_REVISION_4M_PRODUCTION EQU 0
CYDEV_CHIP_REVISION_4N_PRODUCTION EQU 0
CYDEV_CHIP_REVISION_4O_PRODUCTION EQU 0
CYDEV_CHIP_REVISION_4P_PRODUCTION EQU 0
CYDEV_CHIP_REVISION_4Q_PRODUCTION EQU 0
CYDEV_CHIP_REVISION_4R_PRODUCTION EQU 0
CYDEV_CHIP_REVISION_4S_PRODUCTION EQU 0
CYDEV_CHIP_REVISION_4T_PRODUCTION EQU 0
CYDEV_CHIP_REVISION_4U_PRODUCTION EQU 0
CYDEV_CHIP_REVISION_4V_PRODUCTION EQU 0
CYDEV_CHIP_REVISION_5A_ES0 EQU 0
CYDEV_CHIP_REVISION_5A_ES1 EQU 1
CYDEV_CHIP_REVISION_5A_PRODUCTION EQU 1
CYDEV_CHIP_REVISION_5B_ES0 EQU 0
CYDEV_CHIP_REVISION_5B_PRODUCTION EQU 0
CYDEV_CHIP_REVISION_6A_ES EQU 17
CYDEV_CHIP_REVISION_6A_NO_UDB EQU 33
CYDEV_CHIP_REVISION_6A_PRODUCTION EQU 33
CYDEV_CHIP_REVISION_FM3_PRODUCTION EQU 0
CYDEV_CHIP_REVISION_FM4_PRODUCTION EQU 0
CYDEV_CHIP_REVISION_PDL_FM0P_TYPE1_PRODUCTION EQU 0
CYDEV_CHIP_REVISION_PDL_FM0P_TYPE2_PRODUCTION EQU 0
CYDEV_CHIP_REVISION_PDL_FM0P_TYPE3_PRODUCTION EQU 0
CYDEV_CHIP_REVISION_USED EQU CYDEV_CHIP_REVISION_5B_PRODUCTION
CYDEV_CHIP_REV_EXPECT EQU CYDEV_CHIP_REVISION_USED
CYDEV_CONFIG_FASTBOOT_ENABLED EQU 1
CYDEV_CONFIG_UNUSED_IO_AllowButWarn EQU 0
CYDEV_CONFIG_UNUSED_IO EQU CYDEV_CONFIG_UNUSED_IO_AllowButWarn
CYDEV_CONFIG_UNUSED_IO_AllowWithInfo EQU 1
CYDEV_CONFIG_UNUSED_IO_Disallowed EQU 2
CYDEV_CONFIGURATION_COMPRESSED EQU 1
CYDEV_CONFIGURATION_DMA EQU 0
CYDEV_CONFIGURATION_ECC EQU 1
CYDEV_CONFIGURATION_IMOENABLED EQU CYDEV_CONFIG_FASTBOOT_ENABLED
CYDEV_CONFIGURATION_MODE_COMPRESSED EQU 0
CYDEV_CONFIGURATION_MODE EQU CYDEV_CONFIGURATION_MODE_COMPRESSED
CYDEV_CONFIGURATION_MODE_DMA EQU 2
CYDEV_CONFIGURATION_MODE_UNCOMPRESSED EQU 1
CYDEV_DEBUG_ENABLE_MASK EQU 0x20
CYDEV_DEBUG_ENABLE_REGISTER EQU CYREG_MLOGIC_DEBUG
CYDEV_DEBUGGING_DPS_Disable EQU 3
CYDEV_DEBUGGING_DPS_JTAG_4 EQU 1
CYDEV_DEBUGGING_DPS_JTAG_5 EQU 0
CYDEV_DEBUGGING_DPS_SWD EQU 2
CYDEV_DEBUGGING_DPS_SWD_SWV EQU 6
CYDEV_DEBUGGING_DPS EQU CYDEV_DEBUGGING_DPS_SWD_SWV
CYDEV_DEBUGGING_ENABLE EQU 1
CYDEV_DEBUGGING_XRES EQU 0
CYDEV_DMA_CHANNELS_AVAILABLE EQU 24
CYDEV_ECC_ENABLE EQU 0
CYDEV_HEAP_SIZE EQU 0x80
CYDEV_INSTRUCT_CACHE_ENABLED EQU 1
CYDEV_INTR_RISING EQU 0x00000000
CYDEV_IS_EXPORTING_CODE EQU 0
CYDEV_IS_IMPORTING_CODE EQU 0
CYDEV_PROJ_TYPE EQU 0
CYDEV_PROJ_TYPE_BOOTLOADER EQU 1
CYDEV_PROJ_TYPE_LAUNCHER EQU 5
CYDEV_PROJ_TYPE_LOADABLE EQU 2
CYDEV_PROJ_TYPE_LOADABLEANDBOOTLOADER EQU 4
CYDEV_PROJ_TYPE_MULTIAPPBOOTLOADER EQU 3
CYDEV_PROJ_TYPE_STANDARD EQU 0
CYDEV_PROTECTION_ENABLE EQU 0
CYDEV_STACK_SIZE EQU 0x0800
CYDEV_USE_BUNDLED_CMSIS EQU 1
CYDEV_VARIABLE_VDDA EQU 0
CYDEV_VDDA_MV EQU 5000
CYDEV_VDDD_MV EQU 5000
CYDEV_VDDIO0_MV EQU 5000
CYDEV_VDDIO1_MV EQU 5000
CYDEV_VDDIO2_MV EQU 5000
CYDEV_VDDIO3_MV EQU 5000
CYDEV_VIO0_MV EQU 5000
CYDEV_VIO1_MV EQU 5000
CYDEV_VIO2_MV EQU 5000
CYDEV_VIO3_MV EQU 5000
CYIPBLOCK_ARM_CM3_VERSION EQU 0
CYIPBLOCK_P3_ANAIF_VERSION EQU 0
CYIPBLOCK_P3_CAN_VERSION EQU 0
CYIPBLOCK_P3_CAPSENSE_VERSION EQU 0
CYIPBLOCK_P3_COMP_VERSION EQU 0
CYIPBLOCK_P3_DECIMATOR_VERSION EQU 0
CYIPBLOCK_P3_DFB_VERSION EQU 0
CYIPBLOCK_P3_DMA_VERSION EQU 0
CYIPBLOCK_P3_DRQ_VERSION EQU 0
CYIPBLOCK_P3_DSM_VERSION EQU 0
CYIPBLOCK_P3_EMIF_VERSION EQU 0
CYIPBLOCK_P3_I2C_VERSION EQU 0
CYIPBLOCK_P3_LCD_VERSION EQU 0
CYIPBLOCK_P3_LPF_VERSION EQU 0
CYIPBLOCK_P3_OPAMP_VERSION EQU 0
CYIPBLOCK_P3_PM_VERSION EQU 0
CYIPBLOCK_P3_SCCT_VERSION EQU 0
CYIPBLOCK_P3_TIMER_VERSION EQU 0
CYIPBLOCK_P3_USB_VERSION EQU 0
CYIPBLOCK_P3_VIDAC_VERSION EQU 0
CYIPBLOCK_P3_VREF_VERSION EQU 0
CYIPBLOCK_S8_GPIO_VERSION EQU 0
CYIPBLOCK_S8_IRQ_VERSION EQU 0
CYIPBLOCK_S8_SAR_VERSION EQU 0
CYIPBLOCK_S8_SIO_VERSION EQU 0
CYIPBLOCK_S8_UDB_VERSION EQU 0
DMA_CHANNELS_USED__MASK0 EQU 0x00000000
CYDEV_BOOTLOADER_ENABLE EQU 0

#endif /* INCLUDED_CYFITTERIAR_INC */
