/*******************************************************************************
* File Name: cyfittergnu.inc
* 
* PSoC Creator  4.2
*
* Description:
* 
* This file is automatically generated by PSoC Creator.
*
********************************************************************************
* Copyright (c) 2007-2018 Cypress Semiconductor.  All rights reserved.
* You may use this file only in accordance with the license, terms, conditions, 
* disclaimers, and limitations in the end user license agreement accompanying 
* the software package with which this file was provided.
********************************************************************************/

.ifndef INCLUDED_CYFITTERGNU_INC
.set INCLUDED_CYFITTERGNU_INC, 1
.include "cydevicegnu.inc"
.include "cydevicegnu_trm.inc"

/* HA1 */
.set HA1__0__INTTYPE, CYREG_PICU0_INTTYPE1
.set HA1__0__MASK, 0x02
.set HA1__0__PC, CYREG_PRT0_PC1
.set HA1__0__PORT, 0
.set HA1__0__SHIFT, 1
.set HA1__AG, CYREG_PRT0_AG
.set HA1__AMUX, CYREG_PRT0_AMUX
.set HA1__BIE, CYREG_PRT0_BIE
.set HA1__BIT_MASK, CYREG_PRT0_BIT_MASK
.set HA1__BYP, CYREG_PRT0_BYP
.set HA1__CTL, CYREG_PRT0_CTL
.set HA1__DM0, CYREG_PRT0_DM0
.set HA1__DM1, CYREG_PRT0_DM1
.set HA1__DM2, CYREG_PRT0_DM2
.set HA1__DR, CYREG_PRT0_DR
.set HA1__INP_DIS, CYREG_PRT0_INP_DIS
.set HA1__INTTYPE_BASE, CYDEV_PICU_INTTYPE_PICU0_BASE
.set HA1__LCD_COM_SEG, CYREG_PRT0_LCD_COM_SEG
.set HA1__LCD_EN, CYREG_PRT0_LCD_EN
.set HA1__MASK, 0x02
.set HA1__PORT, 0
.set HA1__PRT, CYREG_PRT0_PRT
.set HA1__PRTDSI__CAPS_SEL, CYREG_PRT0_CAPS_SEL
.set HA1__PRTDSI__DBL_SYNC_IN, CYREG_PRT0_DBL_SYNC_IN
.set HA1__PRTDSI__OE_SEL0, CYREG_PRT0_OE_SEL0
.set HA1__PRTDSI__OE_SEL1, CYREG_PRT0_OE_SEL1
.set HA1__PRTDSI__OUT_SEL0, CYREG_PRT0_OUT_SEL0
.set HA1__PRTDSI__OUT_SEL1, CYREG_PRT0_OUT_SEL1
.set HA1__PRTDSI__SYNC_OUT, CYREG_PRT0_SYNC_OUT
.set HA1__PS, CYREG_PRT0_PS
.set HA1__SHIFT, 1
.set HA1__SLW, CYREG_PRT0_SLW

/* HA2 */
.set HA2__0__INTTYPE, CYREG_PICU3_INTTYPE0
.set HA2__0__MASK, 0x01
.set HA2__0__PC, CYREG_PRT3_PC0
.set HA2__0__PORT, 3
.set HA2__0__SHIFT, 0
.set HA2__AG, CYREG_PRT3_AG
.set HA2__AMUX, CYREG_PRT3_AMUX
.set HA2__BIE, CYREG_PRT3_BIE
.set HA2__BIT_MASK, CYREG_PRT3_BIT_MASK
.set HA2__BYP, CYREG_PRT3_BYP
.set HA2__CTL, CYREG_PRT3_CTL
.set HA2__DM0, CYREG_PRT3_DM0
.set HA2__DM1, CYREG_PRT3_DM1
.set HA2__DM2, CYREG_PRT3_DM2
.set HA2__DR, CYREG_PRT3_DR
.set HA2__INP_DIS, CYREG_PRT3_INP_DIS
.set HA2__INTTYPE_BASE, CYDEV_PICU_INTTYPE_PICU3_BASE
.set HA2__LCD_COM_SEG, CYREG_PRT3_LCD_COM_SEG
.set HA2__LCD_EN, CYREG_PRT3_LCD_EN
.set HA2__MASK, 0x01
.set HA2__PORT, 3
.set HA2__PRT, CYREG_PRT3_PRT
.set HA2__PRTDSI__CAPS_SEL, CYREG_PRT3_CAPS_SEL
.set HA2__PRTDSI__DBL_SYNC_IN, CYREG_PRT3_DBL_SYNC_IN
.set HA2__PRTDSI__OE_SEL0, CYREG_PRT3_OE_SEL0
.set HA2__PRTDSI__OE_SEL1, CYREG_PRT3_OE_SEL1
.set HA2__PRTDSI__OUT_SEL0, CYREG_PRT3_OUT_SEL0
.set HA2__PRTDSI__OUT_SEL1, CYREG_PRT3_OUT_SEL1
.set HA2__PRTDSI__SYNC_OUT, CYREG_PRT3_SYNC_OUT
.set HA2__PS, CYREG_PRT3_PS
.set HA2__SHIFT, 0
.set HA2__SLW, CYREG_PRT3_SLW

/* HB1 */
.set HB1__0__INTTYPE, CYREG_PICU0_INTTYPE3
.set HB1__0__MASK, 0x08
.set HB1__0__PC, CYREG_PRT0_PC3
.set HB1__0__PORT, 0
.set HB1__0__SHIFT, 3
.set HB1__AG, CYREG_PRT0_AG
.set HB1__AMUX, CYREG_PRT0_AMUX
.set HB1__BIE, CYREG_PRT0_BIE
.set HB1__BIT_MASK, CYREG_PRT0_BIT_MASK
.set HB1__BYP, CYREG_PRT0_BYP
.set HB1__CTL, CYREG_PRT0_CTL
.set HB1__DM0, CYREG_PRT0_DM0
.set HB1__DM1, CYREG_PRT0_DM1
.set HB1__DM2, CYREG_PRT0_DM2
.set HB1__DR, CYREG_PRT0_DR
.set HB1__INP_DIS, CYREG_PRT0_INP_DIS
.set HB1__INTTYPE_BASE, CYDEV_PICU_INTTYPE_PICU0_BASE
.set HB1__LCD_COM_SEG, CYREG_PRT0_LCD_COM_SEG
.set HB1__LCD_EN, CYREG_PRT0_LCD_EN
.set HB1__MASK, 0x08
.set HB1__PORT, 0
.set HB1__PRT, CYREG_PRT0_PRT
.set HB1__PRTDSI__CAPS_SEL, CYREG_PRT0_CAPS_SEL
.set HB1__PRTDSI__DBL_SYNC_IN, CYREG_PRT0_DBL_SYNC_IN
.set HB1__PRTDSI__OE_SEL0, CYREG_PRT0_OE_SEL0
.set HB1__PRTDSI__OE_SEL1, CYREG_PRT0_OE_SEL1
.set HB1__PRTDSI__OUT_SEL0, CYREG_PRT0_OUT_SEL0
.set HB1__PRTDSI__OUT_SEL1, CYREG_PRT0_OUT_SEL1
.set HB1__PRTDSI__SYNC_OUT, CYREG_PRT0_SYNC_OUT
.set HB1__PS, CYREG_PRT0_PS
.set HB1__SHIFT, 3
.set HB1__SLW, CYREG_PRT0_SLW

/* HB2 */
.set HB2__0__INTTYPE, CYREG_PICU3_INTTYPE2
.set HB2__0__MASK, 0x04
.set HB2__0__PC, CYREG_PRT3_PC2
.set HB2__0__PORT, 3
.set HB2__0__SHIFT, 2
.set HB2__AG, CYREG_PRT3_AG
.set HB2__AMUX, CYREG_PRT3_AMUX
.set HB2__BIE, CYREG_PRT3_BIE
.set HB2__BIT_MASK, CYREG_PRT3_BIT_MASK
.set HB2__BYP, CYREG_PRT3_BYP
.set HB2__CTL, CYREG_PRT3_CTL
.set HB2__DM0, CYREG_PRT3_DM0
.set HB2__DM1, CYREG_PRT3_DM1
.set HB2__DM2, CYREG_PRT3_DM2
.set HB2__DR, CYREG_PRT3_DR
.set HB2__INP_DIS, CYREG_PRT3_INP_DIS
.set HB2__INTTYPE_BASE, CYDEV_PICU_INTTYPE_PICU3_BASE
.set HB2__LCD_COM_SEG, CYREG_PRT3_LCD_COM_SEG
.set HB2__LCD_EN, CYREG_PRT3_LCD_EN
.set HB2__MASK, 0x04
.set HB2__PORT, 3
.set HB2__PRT, CYREG_PRT3_PRT
.set HB2__PRTDSI__CAPS_SEL, CYREG_PRT3_CAPS_SEL
.set HB2__PRTDSI__DBL_SYNC_IN, CYREG_PRT3_DBL_SYNC_IN
.set HB2__PRTDSI__OE_SEL0, CYREG_PRT3_OE_SEL0
.set HB2__PRTDSI__OE_SEL1, CYREG_PRT3_OE_SEL1
.set HB2__PRTDSI__OUT_SEL0, CYREG_PRT3_OUT_SEL0
.set HB2__PRTDSI__OUT_SEL1, CYREG_PRT3_OUT_SEL1
.set HB2__PRTDSI__SYNC_OUT, CYREG_PRT3_SYNC_OUT
.set HB2__PS, CYREG_PRT3_PS
.set HB2__SHIFT, 2
.set HB2__SLW, CYREG_PRT3_SLW

/* HC1 */
.set HC1__0__INTTYPE, CYREG_PICU0_INTTYPE5
.set HC1__0__MASK, 0x20
.set HC1__0__PC, CYREG_PRT0_PC5
.set HC1__0__PORT, 0
.set HC1__0__SHIFT, 5
.set HC1__AG, CYREG_PRT0_AG
.set HC1__AMUX, CYREG_PRT0_AMUX
.set HC1__BIE, CYREG_PRT0_BIE
.set HC1__BIT_MASK, CYREG_PRT0_BIT_MASK
.set HC1__BYP, CYREG_PRT0_BYP
.set HC1__CTL, CYREG_PRT0_CTL
.set HC1__DM0, CYREG_PRT0_DM0
.set HC1__DM1, CYREG_PRT0_DM1
.set HC1__DM2, CYREG_PRT0_DM2
.set HC1__DR, CYREG_PRT0_DR
.set HC1__INP_DIS, CYREG_PRT0_INP_DIS
.set HC1__INTTYPE_BASE, CYDEV_PICU_INTTYPE_PICU0_BASE
.set HC1__LCD_COM_SEG, CYREG_PRT0_LCD_COM_SEG
.set HC1__LCD_EN, CYREG_PRT0_LCD_EN
.set HC1__MASK, 0x20
.set HC1__PORT, 0
.set HC1__PRT, CYREG_PRT0_PRT
.set HC1__PRTDSI__CAPS_SEL, CYREG_PRT0_CAPS_SEL
.set HC1__PRTDSI__DBL_SYNC_IN, CYREG_PRT0_DBL_SYNC_IN
.set HC1__PRTDSI__OE_SEL0, CYREG_PRT0_OE_SEL0
.set HC1__PRTDSI__OE_SEL1, CYREG_PRT0_OE_SEL1
.set HC1__PRTDSI__OUT_SEL0, CYREG_PRT0_OUT_SEL0
.set HC1__PRTDSI__OUT_SEL1, CYREG_PRT0_OUT_SEL1
.set HC1__PRTDSI__SYNC_OUT, CYREG_PRT0_SYNC_OUT
.set HC1__PS, CYREG_PRT0_PS
.set HC1__SHIFT, 5
.set HC1__SLW, CYREG_PRT0_SLW

/* HC2 */
.set HC2__0__INTTYPE, CYREG_PICU3_INTTYPE4
.set HC2__0__MASK, 0x10
.set HC2__0__PC, CYREG_PRT3_PC4
.set HC2__0__PORT, 3
.set HC2__0__SHIFT, 4
.set HC2__AG, CYREG_PRT3_AG
.set HC2__AMUX, CYREG_PRT3_AMUX
.set HC2__BIE, CYREG_PRT3_BIE
.set HC2__BIT_MASK, CYREG_PRT3_BIT_MASK
.set HC2__BYP, CYREG_PRT3_BYP
.set HC2__CTL, CYREG_PRT3_CTL
.set HC2__DM0, CYREG_PRT3_DM0
.set HC2__DM1, CYREG_PRT3_DM1
.set HC2__DM2, CYREG_PRT3_DM2
.set HC2__DR, CYREG_PRT3_DR
.set HC2__INP_DIS, CYREG_PRT3_INP_DIS
.set HC2__INTTYPE_BASE, CYDEV_PICU_INTTYPE_PICU3_BASE
.set HC2__LCD_COM_SEG, CYREG_PRT3_LCD_COM_SEG
.set HC2__LCD_EN, CYREG_PRT3_LCD_EN
.set HC2__MASK, 0x10
.set HC2__PORT, 3
.set HC2__PRT, CYREG_PRT3_PRT
.set HC2__PRTDSI__CAPS_SEL, CYREG_PRT3_CAPS_SEL
.set HC2__PRTDSI__DBL_SYNC_IN, CYREG_PRT3_DBL_SYNC_IN
.set HC2__PRTDSI__OE_SEL0, CYREG_PRT3_OE_SEL0
.set HC2__PRTDSI__OE_SEL1, CYREG_PRT3_OE_SEL1
.set HC2__PRTDSI__OUT_SEL0, CYREG_PRT3_OUT_SEL0
.set HC2__PRTDSI__OUT_SEL1, CYREG_PRT3_OUT_SEL1
.set HC2__PRTDSI__SYNC_OUT, CYREG_PRT3_SYNC_OUT
.set HC2__PS, CYREG_PRT3_PS
.set HC2__SHIFT, 4
.set HC2__SLW, CYREG_PRT3_SLW

/* LA1 */
.set LA1__0__INTTYPE, CYREG_PICU0_INTTYPE2
.set LA1__0__MASK, 0x04
.set LA1__0__PC, CYREG_PRT0_PC2
.set LA1__0__PORT, 0
.set LA1__0__SHIFT, 2
.set LA1__AG, CYREG_PRT0_AG
.set LA1__AMUX, CYREG_PRT0_AMUX
.set LA1__BIE, CYREG_PRT0_BIE
.set LA1__BIT_MASK, CYREG_PRT0_BIT_MASK
.set LA1__BYP, CYREG_PRT0_BYP
.set LA1__CTL, CYREG_PRT0_CTL
.set LA1__DM0, CYREG_PRT0_DM0
.set LA1__DM1, CYREG_PRT0_DM1
.set LA1__DM2, CYREG_PRT0_DM2
.set LA1__DR, CYREG_PRT0_DR
.set LA1__INP_DIS, CYREG_PRT0_INP_DIS
.set LA1__INTTYPE_BASE, CYDEV_PICU_INTTYPE_PICU0_BASE
.set LA1__LCD_COM_SEG, CYREG_PRT0_LCD_COM_SEG
.set LA1__LCD_EN, CYREG_PRT0_LCD_EN
.set LA1__MASK, 0x04
.set LA1__PORT, 0
.set LA1__PRT, CYREG_PRT0_PRT
.set LA1__PRTDSI__CAPS_SEL, CYREG_PRT0_CAPS_SEL
.set LA1__PRTDSI__DBL_SYNC_IN, CYREG_PRT0_DBL_SYNC_IN
.set LA1__PRTDSI__OE_SEL0, CYREG_PRT0_OE_SEL0
.set LA1__PRTDSI__OE_SEL1, CYREG_PRT0_OE_SEL1
.set LA1__PRTDSI__OUT_SEL0, CYREG_PRT0_OUT_SEL0
.set LA1__PRTDSI__OUT_SEL1, CYREG_PRT0_OUT_SEL1
.set LA1__PRTDSI__SYNC_OUT, CYREG_PRT0_SYNC_OUT
.set LA1__PS, CYREG_PRT0_PS
.set LA1__SHIFT, 2
.set LA1__SLW, CYREG_PRT0_SLW

/* LA2 */
.set LA2__0__INTTYPE, CYREG_PICU3_INTTYPE1
.set LA2__0__MASK, 0x02
.set LA2__0__PC, CYREG_PRT3_PC1
.set LA2__0__PORT, 3
.set LA2__0__SHIFT, 1
.set LA2__AG, CYREG_PRT3_AG
.set LA2__AMUX, CYREG_PRT3_AMUX
.set LA2__BIE, CYREG_PRT3_BIE
.set LA2__BIT_MASK, CYREG_PRT3_BIT_MASK
.set LA2__BYP, CYREG_PRT3_BYP
.set LA2__CTL, CYREG_PRT3_CTL
.set LA2__DM0, CYREG_PRT3_DM0
.set LA2__DM1, CYREG_PRT3_DM1
.set LA2__DM2, CYREG_PRT3_DM2
.set LA2__DR, CYREG_PRT3_DR
.set LA2__INP_DIS, CYREG_PRT3_INP_DIS
.set LA2__INTTYPE_BASE, CYDEV_PICU_INTTYPE_PICU3_BASE
.set LA2__LCD_COM_SEG, CYREG_PRT3_LCD_COM_SEG
.set LA2__LCD_EN, CYREG_PRT3_LCD_EN
.set LA2__MASK, 0x02
.set LA2__PORT, 3
.set LA2__PRT, CYREG_PRT3_PRT
.set LA2__PRTDSI__CAPS_SEL, CYREG_PRT3_CAPS_SEL
.set LA2__PRTDSI__DBL_SYNC_IN, CYREG_PRT3_DBL_SYNC_IN
.set LA2__PRTDSI__OE_SEL0, CYREG_PRT3_OE_SEL0
.set LA2__PRTDSI__OE_SEL1, CYREG_PRT3_OE_SEL1
.set LA2__PRTDSI__OUT_SEL0, CYREG_PRT3_OUT_SEL0
.set LA2__PRTDSI__OUT_SEL1, CYREG_PRT3_OUT_SEL1
.set LA2__PRTDSI__SYNC_OUT, CYREG_PRT3_SYNC_OUT
.set LA2__PS, CYREG_PRT3_PS
.set LA2__SHIFT, 1
.set LA2__SLW, CYREG_PRT3_SLW

/* LB1 */
.set LB1__0__INTTYPE, CYREG_PICU0_INTTYPE4
.set LB1__0__MASK, 0x10
.set LB1__0__PC, CYREG_PRT0_PC4
.set LB1__0__PORT, 0
.set LB1__0__SHIFT, 4
.set LB1__AG, CYREG_PRT0_AG
.set LB1__AMUX, CYREG_PRT0_AMUX
.set LB1__BIE, CYREG_PRT0_BIE
.set LB1__BIT_MASK, CYREG_PRT0_BIT_MASK
.set LB1__BYP, CYREG_PRT0_BYP
.set LB1__CTL, CYREG_PRT0_CTL
.set LB1__DM0, CYREG_PRT0_DM0
.set LB1__DM1, CYREG_PRT0_DM1
.set LB1__DM2, CYREG_PRT0_DM2
.set LB1__DR, CYREG_PRT0_DR
.set LB1__INP_DIS, CYREG_PRT0_INP_DIS
.set LB1__INTTYPE_BASE, CYDEV_PICU_INTTYPE_PICU0_BASE
.set LB1__LCD_COM_SEG, CYREG_PRT0_LCD_COM_SEG
.set LB1__LCD_EN, CYREG_PRT0_LCD_EN
.set LB1__MASK, 0x10
.set LB1__PORT, 0
.set LB1__PRT, CYREG_PRT0_PRT
.set LB1__PRTDSI__CAPS_SEL, CYREG_PRT0_CAPS_SEL
.set LB1__PRTDSI__DBL_SYNC_IN, CYREG_PRT0_DBL_SYNC_IN
.set LB1__PRTDSI__OE_SEL0, CYREG_PRT0_OE_SEL0
.set LB1__PRTDSI__OE_SEL1, CYREG_PRT0_OE_SEL1
.set LB1__PRTDSI__OUT_SEL0, CYREG_PRT0_OUT_SEL0
.set LB1__PRTDSI__OUT_SEL1, CYREG_PRT0_OUT_SEL1
.set LB1__PRTDSI__SYNC_OUT, CYREG_PRT0_SYNC_OUT
.set LB1__PS, CYREG_PRT0_PS
.set LB1__SHIFT, 4
.set LB1__SLW, CYREG_PRT0_SLW

/* LB2 */
.set LB2__0__INTTYPE, CYREG_PICU3_INTTYPE3
.set LB2__0__MASK, 0x08
.set LB2__0__PC, CYREG_PRT3_PC3
.set LB2__0__PORT, 3
.set LB2__0__SHIFT, 3
.set LB2__AG, CYREG_PRT3_AG
.set LB2__AMUX, CYREG_PRT3_AMUX
.set LB2__BIE, CYREG_PRT3_BIE
.set LB2__BIT_MASK, CYREG_PRT3_BIT_MASK
.set LB2__BYP, CYREG_PRT3_BYP
.set LB2__CTL, CYREG_PRT3_CTL
.set LB2__DM0, CYREG_PRT3_DM0
.set LB2__DM1, CYREG_PRT3_DM1
.set LB2__DM2, CYREG_PRT3_DM2
.set LB2__DR, CYREG_PRT3_DR
.set LB2__INP_DIS, CYREG_PRT3_INP_DIS
.set LB2__INTTYPE_BASE, CYDEV_PICU_INTTYPE_PICU3_BASE
.set LB2__LCD_COM_SEG, CYREG_PRT3_LCD_COM_SEG
.set LB2__LCD_EN, CYREG_PRT3_LCD_EN
.set LB2__MASK, 0x08
.set LB2__PORT, 3
.set LB2__PRT, CYREG_PRT3_PRT
.set LB2__PRTDSI__CAPS_SEL, CYREG_PRT3_CAPS_SEL
.set LB2__PRTDSI__DBL_SYNC_IN, CYREG_PRT3_DBL_SYNC_IN
.set LB2__PRTDSI__OE_SEL0, CYREG_PRT3_OE_SEL0
.set LB2__PRTDSI__OE_SEL1, CYREG_PRT3_OE_SEL1
.set LB2__PRTDSI__OUT_SEL0, CYREG_PRT3_OUT_SEL0
.set LB2__PRTDSI__OUT_SEL1, CYREG_PRT3_OUT_SEL1
.set LB2__PRTDSI__SYNC_OUT, CYREG_PRT3_SYNC_OUT
.set LB2__PS, CYREG_PRT3_PS
.set LB2__SHIFT, 3
.set LB2__SLW, CYREG_PRT3_SLW

/* LC1 */
.set LC1__0__INTTYPE, CYREG_PICU0_INTTYPE6
.set LC1__0__MASK, 0x40
.set LC1__0__PC, CYREG_PRT0_PC6
.set LC1__0__PORT, 0
.set LC1__0__SHIFT, 6
.set LC1__AG, CYREG_PRT0_AG
.set LC1__AMUX, CYREG_PRT0_AMUX
.set LC1__BIE, CYREG_PRT0_BIE
.set LC1__BIT_MASK, CYREG_PRT0_BIT_MASK
.set LC1__BYP, CYREG_PRT0_BYP
.set LC1__CTL, CYREG_PRT0_CTL
.set LC1__DM0, CYREG_PRT0_DM0
.set LC1__DM1, CYREG_PRT0_DM1
.set LC1__DM2, CYREG_PRT0_DM2
.set LC1__DR, CYREG_PRT0_DR
.set LC1__INP_DIS, CYREG_PRT0_INP_DIS
.set LC1__INTTYPE_BASE, CYDEV_PICU_INTTYPE_PICU0_BASE
.set LC1__LCD_COM_SEG, CYREG_PRT0_LCD_COM_SEG
.set LC1__LCD_EN, CYREG_PRT0_LCD_EN
.set LC1__MASK, 0x40
.set LC1__PORT, 0
.set LC1__PRT, CYREG_PRT0_PRT
.set LC1__PRTDSI__CAPS_SEL, CYREG_PRT0_CAPS_SEL
.set LC1__PRTDSI__DBL_SYNC_IN, CYREG_PRT0_DBL_SYNC_IN
.set LC1__PRTDSI__OE_SEL0, CYREG_PRT0_OE_SEL0
.set LC1__PRTDSI__OE_SEL1, CYREG_PRT0_OE_SEL1
.set LC1__PRTDSI__OUT_SEL0, CYREG_PRT0_OUT_SEL0
.set LC1__PRTDSI__OUT_SEL1, CYREG_PRT0_OUT_SEL1
.set LC1__PRTDSI__SYNC_OUT, CYREG_PRT0_SYNC_OUT
.set LC1__PS, CYREG_PRT0_PS
.set LC1__SHIFT, 6
.set LC1__SLW, CYREG_PRT0_SLW

/* LC2 */
.set LC2__0__INTTYPE, CYREG_PICU3_INTTYPE5
.set LC2__0__MASK, 0x20
.set LC2__0__PC, CYREG_PRT3_PC5
.set LC2__0__PORT, 3
.set LC2__0__SHIFT, 5
.set LC2__AG, CYREG_PRT3_AG
.set LC2__AMUX, CYREG_PRT3_AMUX
.set LC2__BIE, CYREG_PRT3_BIE
.set LC2__BIT_MASK, CYREG_PRT3_BIT_MASK
.set LC2__BYP, CYREG_PRT3_BYP
.set LC2__CTL, CYREG_PRT3_CTL
.set LC2__DM0, CYREG_PRT3_DM0
.set LC2__DM1, CYREG_PRT3_DM1
.set LC2__DM2, CYREG_PRT3_DM2
.set LC2__DR, CYREG_PRT3_DR
.set LC2__INP_DIS, CYREG_PRT3_INP_DIS
.set LC2__INTTYPE_BASE, CYDEV_PICU_INTTYPE_PICU3_BASE
.set LC2__LCD_COM_SEG, CYREG_PRT3_LCD_COM_SEG
.set LC2__LCD_EN, CYREG_PRT3_LCD_EN
.set LC2__MASK, 0x20
.set LC2__PORT, 3
.set LC2__PRT, CYREG_PRT3_PRT
.set LC2__PRTDSI__CAPS_SEL, CYREG_PRT3_CAPS_SEL
.set LC2__PRTDSI__DBL_SYNC_IN, CYREG_PRT3_DBL_SYNC_IN
.set LC2__PRTDSI__OE_SEL0, CYREG_PRT3_OE_SEL0
.set LC2__PRTDSI__OE_SEL1, CYREG_PRT3_OE_SEL1
.set LC2__PRTDSI__OUT_SEL0, CYREG_PRT3_OUT_SEL0
.set LC2__PRTDSI__OUT_SEL1, CYREG_PRT3_OUT_SEL1
.set LC2__PRTDSI__SYNC_OUT, CYREG_PRT3_SYNC_OUT
.set LC2__PS, CYREG_PRT3_PS
.set LC2__SHIFT, 5
.set LC2__SLW, CYREG_PRT3_SLW

/* PWM1 */
.set PWM1__0__INTTYPE, CYREG_PICU3_INTTYPE6
.set PWM1__0__MASK, 0x40
.set PWM1__0__PC, CYREG_PRT3_PC6
.set PWM1__0__PORT, 3
.set PWM1__0__SHIFT, 6
.set PWM1__AG, CYREG_PRT3_AG
.set PWM1__AMUX, CYREG_PRT3_AMUX
.set PWM1__BIE, CYREG_PRT3_BIE
.set PWM1__BIT_MASK, CYREG_PRT3_BIT_MASK
.set PWM1__BYP, CYREG_PRT3_BYP
.set PWM1__CTL, CYREG_PRT3_CTL
.set PWM1__DM0, CYREG_PRT3_DM0
.set PWM1__DM1, CYREG_PRT3_DM1
.set PWM1__DM2, CYREG_PRT3_DM2
.set PWM1__DR, CYREG_PRT3_DR
.set PWM1__INP_DIS, CYREG_PRT3_INP_DIS
.set PWM1__INTTYPE_BASE, CYDEV_PICU_INTTYPE_PICU3_BASE
.set PWM1__LCD_COM_SEG, CYREG_PRT3_LCD_COM_SEG
.set PWM1__LCD_EN, CYREG_PRT3_LCD_EN
.set PWM1__MASK, 0x40
.set PWM1__PORT, 3
.set PWM1__PRT, CYREG_PRT3_PRT
.set PWM1__PRTDSI__CAPS_SEL, CYREG_PRT3_CAPS_SEL
.set PWM1__PRTDSI__DBL_SYNC_IN, CYREG_PRT3_DBL_SYNC_IN
.set PWM1__PRTDSI__OE_SEL0, CYREG_PRT3_OE_SEL0
.set PWM1__PRTDSI__OE_SEL1, CYREG_PRT3_OE_SEL1
.set PWM1__PRTDSI__OUT_SEL0, CYREG_PRT3_OUT_SEL0
.set PWM1__PRTDSI__OUT_SEL1, CYREG_PRT3_OUT_SEL1
.set PWM1__PRTDSI__SYNC_OUT, CYREG_PRT3_SYNC_OUT
.set PWM1__PS, CYREG_PRT3_PS
.set PWM1__SHIFT, 6
.set PWM1__SLW, CYREG_PRT3_SLW

/* PWM2 */
.set PWM2__0__INTTYPE, CYREG_PICU3_INTTYPE7
.set PWM2__0__MASK, 0x80
.set PWM2__0__PC, CYREG_PRT3_PC7
.set PWM2__0__PORT, 3
.set PWM2__0__SHIFT, 7
.set PWM2__AG, CYREG_PRT3_AG
.set PWM2__AMUX, CYREG_PRT3_AMUX
.set PWM2__BIE, CYREG_PRT3_BIE
.set PWM2__BIT_MASK, CYREG_PRT3_BIT_MASK
.set PWM2__BYP, CYREG_PRT3_BYP
.set PWM2__CTL, CYREG_PRT3_CTL
.set PWM2__DM0, CYREG_PRT3_DM0
.set PWM2__DM1, CYREG_PRT3_DM1
.set PWM2__DM2, CYREG_PRT3_DM2
.set PWM2__DR, CYREG_PRT3_DR
.set PWM2__INP_DIS, CYREG_PRT3_INP_DIS
.set PWM2__INTTYPE_BASE, CYDEV_PICU_INTTYPE_PICU3_BASE
.set PWM2__LCD_COM_SEG, CYREG_PRT3_LCD_COM_SEG
.set PWM2__LCD_EN, CYREG_PRT3_LCD_EN
.set PWM2__MASK, 0x80
.set PWM2__PORT, 3
.set PWM2__PRT, CYREG_PRT3_PRT
.set PWM2__PRTDSI__CAPS_SEL, CYREG_PRT3_CAPS_SEL
.set PWM2__PRTDSI__DBL_SYNC_IN, CYREG_PRT3_DBL_SYNC_IN
.set PWM2__PRTDSI__OE_SEL0, CYREG_PRT3_OE_SEL0
.set PWM2__PRTDSI__OE_SEL1, CYREG_PRT3_OE_SEL1
.set PWM2__PRTDSI__OUT_SEL0, CYREG_PRT3_OUT_SEL0
.set PWM2__PRTDSI__OUT_SEL1, CYREG_PRT3_OUT_SEL1
.set PWM2__PRTDSI__SYNC_OUT, CYREG_PRT3_SYNC_OUT
.set PWM2__PS, CYREG_PRT3_PS
.set PWM2__SHIFT, 7
.set PWM2__SLW, CYREG_PRT3_SLW

/* HALL_A1 */
.set HALL_A1__0__INTTYPE, CYREG_PICU1_INTTYPE5
.set HALL_A1__0__MASK, 0x20
.set HALL_A1__0__PC, CYREG_PRT1_PC5
.set HALL_A1__0__PORT, 1
.set HALL_A1__0__SHIFT, 5
.set HALL_A1__AG, CYREG_PRT1_AG
.set HALL_A1__AMUX, CYREG_PRT1_AMUX
.set HALL_A1__BIE, CYREG_PRT1_BIE
.set HALL_A1__BIT_MASK, CYREG_PRT1_BIT_MASK
.set HALL_A1__BYP, CYREG_PRT1_BYP
.set HALL_A1__CTL, CYREG_PRT1_CTL
.set HALL_A1__DM0, CYREG_PRT1_DM0
.set HALL_A1__DM1, CYREG_PRT1_DM1
.set HALL_A1__DM2, CYREG_PRT1_DM2
.set HALL_A1__DR, CYREG_PRT1_DR
.set HALL_A1__INP_DIS, CYREG_PRT1_INP_DIS
.set HALL_A1__INTTYPE_BASE, CYDEV_PICU_INTTYPE_PICU1_BASE
.set HALL_A1__LCD_COM_SEG, CYREG_PRT1_LCD_COM_SEG
.set HALL_A1__LCD_EN, CYREG_PRT1_LCD_EN
.set HALL_A1__MASK, 0x20
.set HALL_A1__PORT, 1
.set HALL_A1__PRT, CYREG_PRT1_PRT
.set HALL_A1__PRTDSI__CAPS_SEL, CYREG_PRT1_CAPS_SEL
.set HALL_A1__PRTDSI__DBL_SYNC_IN, CYREG_PRT1_DBL_SYNC_IN
.set HALL_A1__PRTDSI__OE_SEL0, CYREG_PRT1_OE_SEL0
.set HALL_A1__PRTDSI__OE_SEL1, CYREG_PRT1_OE_SEL1
.set HALL_A1__PRTDSI__OUT_SEL0, CYREG_PRT1_OUT_SEL0
.set HALL_A1__PRTDSI__OUT_SEL1, CYREG_PRT1_OUT_SEL1
.set HALL_A1__PRTDSI__SYNC_OUT, CYREG_PRT1_SYNC_OUT
.set HALL_A1__PS, CYREG_PRT1_PS
.set HALL_A1__SHIFT, 5
.set HALL_A1__SLW, CYREG_PRT1_SLW

/* HALL_A2 */
.set HALL_A2__0__INTTYPE, CYREG_PICU12_INTTYPE2
.set HALL_A2__0__MASK, 0x04
.set HALL_A2__0__PC, CYREG_PRT12_PC2
.set HALL_A2__0__PORT, 12
.set HALL_A2__0__SHIFT, 2
.set HALL_A2__AG, CYREG_PRT12_AG
.set HALL_A2__BIE, CYREG_PRT12_BIE
.set HALL_A2__BIT_MASK, CYREG_PRT12_BIT_MASK
.set HALL_A2__BYP, CYREG_PRT12_BYP
.set HALL_A2__DM0, CYREG_PRT12_DM0
.set HALL_A2__DM1, CYREG_PRT12_DM1
.set HALL_A2__DM2, CYREG_PRT12_DM2
.set HALL_A2__DR, CYREG_PRT12_DR
.set HALL_A2__INP_DIS, CYREG_PRT12_INP_DIS
.set HALL_A2__INTTYPE_BASE, CYDEV_PICU_INTTYPE_PICU12_BASE
.set HALL_A2__MASK, 0x04
.set HALL_A2__PORT, 12
.set HALL_A2__PRT, CYREG_PRT12_PRT
.set HALL_A2__PRTDSI__DBL_SYNC_IN, CYREG_PRT12_DBL_SYNC_IN
.set HALL_A2__PRTDSI__OE_SEL0, CYREG_PRT12_OE_SEL0
.set HALL_A2__PRTDSI__OE_SEL1, CYREG_PRT12_OE_SEL1
.set HALL_A2__PRTDSI__OUT_SEL0, CYREG_PRT12_OUT_SEL0
.set HALL_A2__PRTDSI__OUT_SEL1, CYREG_PRT12_OUT_SEL1
.set HALL_A2__PRTDSI__SYNC_OUT, CYREG_PRT12_SYNC_OUT
.set HALL_A2__PS, CYREG_PRT12_PS
.set HALL_A2__SHIFT, 2
.set HALL_A2__SIO_CFG, CYREG_PRT12_SIO_CFG
.set HALL_A2__SIO_DIFF, CYREG_PRT12_SIO_DIFF
.set HALL_A2__SIO_HYST_EN, CYREG_PRT12_SIO_HYST_EN
.set HALL_A2__SIO_REG_HIFREQ, CYREG_PRT12_SIO_REG_HIFREQ
.set HALL_A2__SLW, CYREG_PRT12_SLW

/* HALL_B1 */
.set HALL_B1__0__INTTYPE, CYREG_PICU1_INTTYPE6
.set HALL_B1__0__MASK, 0x40
.set HALL_B1__0__PC, CYREG_PRT1_PC6
.set HALL_B1__0__PORT, 1
.set HALL_B1__0__SHIFT, 6
.set HALL_B1__AG, CYREG_PRT1_AG
.set HALL_B1__AMUX, CYREG_PRT1_AMUX
.set HALL_B1__BIE, CYREG_PRT1_BIE
.set HALL_B1__BIT_MASK, CYREG_PRT1_BIT_MASK
.set HALL_B1__BYP, CYREG_PRT1_BYP
.set HALL_B1__CTL, CYREG_PRT1_CTL
.set HALL_B1__DM0, CYREG_PRT1_DM0
.set HALL_B1__DM1, CYREG_PRT1_DM1
.set HALL_B1__DM2, CYREG_PRT1_DM2
.set HALL_B1__DR, CYREG_PRT1_DR
.set HALL_B1__INP_DIS, CYREG_PRT1_INP_DIS
.set HALL_B1__INTTYPE_BASE, CYDEV_PICU_INTTYPE_PICU1_BASE
.set HALL_B1__LCD_COM_SEG, CYREG_PRT1_LCD_COM_SEG
.set HALL_B1__LCD_EN, CYREG_PRT1_LCD_EN
.set HALL_B1__MASK, 0x40
.set HALL_B1__PORT, 1
.set HALL_B1__PRT, CYREG_PRT1_PRT
.set HALL_B1__PRTDSI__CAPS_SEL, CYREG_PRT1_CAPS_SEL
.set HALL_B1__PRTDSI__DBL_SYNC_IN, CYREG_PRT1_DBL_SYNC_IN
.set HALL_B1__PRTDSI__OE_SEL0, CYREG_PRT1_OE_SEL0
.set HALL_B1__PRTDSI__OE_SEL1, CYREG_PRT1_OE_SEL1
.set HALL_B1__PRTDSI__OUT_SEL0, CYREG_PRT1_OUT_SEL0
.set HALL_B1__PRTDSI__OUT_SEL1, CYREG_PRT1_OUT_SEL1
.set HALL_B1__PRTDSI__SYNC_OUT, CYREG_PRT1_SYNC_OUT
.set HALL_B1__PS, CYREG_PRT1_PS
.set HALL_B1__SHIFT, 6
.set HALL_B1__SLW, CYREG_PRT1_SLW

/* HALL_B2 */
.set HALL_B2__0__INTTYPE, CYREG_PICU12_INTTYPE3
.set HALL_B2__0__MASK, 0x08
.set HALL_B2__0__PC, CYREG_PRT12_PC3
.set HALL_B2__0__PORT, 12
.set HALL_B2__0__SHIFT, 3
.set HALL_B2__AG, CYREG_PRT12_AG
.set HALL_B2__BIE, CYREG_PRT12_BIE
.set HALL_B2__BIT_MASK, CYREG_PRT12_BIT_MASK
.set HALL_B2__BYP, CYREG_PRT12_BYP
.set HALL_B2__DM0, CYREG_PRT12_DM0
.set HALL_B2__DM1, CYREG_PRT12_DM1
.set HALL_B2__DM2, CYREG_PRT12_DM2
.set HALL_B2__DR, CYREG_PRT12_DR
.set HALL_B2__INP_DIS, CYREG_PRT12_INP_DIS
.set HALL_B2__INTTYPE_BASE, CYDEV_PICU_INTTYPE_PICU12_BASE
.set HALL_B2__MASK, 0x08
.set HALL_B2__PORT, 12
.set HALL_B2__PRT, CYREG_PRT12_PRT
.set HALL_B2__PRTDSI__DBL_SYNC_IN, CYREG_PRT12_DBL_SYNC_IN
.set HALL_B2__PRTDSI__OE_SEL0, CYREG_PRT12_OE_SEL0
.set HALL_B2__PRTDSI__OE_SEL1, CYREG_PRT12_OE_SEL1
.set HALL_B2__PRTDSI__OUT_SEL0, CYREG_PRT12_OUT_SEL0
.set HALL_B2__PRTDSI__OUT_SEL1, CYREG_PRT12_OUT_SEL1
.set HALL_B2__PRTDSI__SYNC_OUT, CYREG_PRT12_SYNC_OUT
.set HALL_B2__PS, CYREG_PRT12_PS
.set HALL_B2__SHIFT, 3
.set HALL_B2__SIO_CFG, CYREG_PRT12_SIO_CFG
.set HALL_B2__SIO_DIFF, CYREG_PRT12_SIO_DIFF
.set HALL_B2__SIO_HYST_EN, CYREG_PRT12_SIO_HYST_EN
.set HALL_B2__SIO_REG_HIFREQ, CYREG_PRT12_SIO_REG_HIFREQ
.set HALL_B2__SLW, CYREG_PRT12_SLW

/* HALL_C1 */
.set HALL_C1__0__INTTYPE, CYREG_PICU1_INTTYPE7
.set HALL_C1__0__MASK, 0x80
.set HALL_C1__0__PC, CYREG_PRT1_PC7
.set HALL_C1__0__PORT, 1
.set HALL_C1__0__SHIFT, 7
.set HALL_C1__AG, CYREG_PRT1_AG
.set HALL_C1__AMUX, CYREG_PRT1_AMUX
.set HALL_C1__BIE, CYREG_PRT1_BIE
.set HALL_C1__BIT_MASK, CYREG_PRT1_BIT_MASK
.set HALL_C1__BYP, CYREG_PRT1_BYP
.set HALL_C1__CTL, CYREG_PRT1_CTL
.set HALL_C1__DM0, CYREG_PRT1_DM0
.set HALL_C1__DM1, CYREG_PRT1_DM1
.set HALL_C1__DM2, CYREG_PRT1_DM2
.set HALL_C1__DR, CYREG_PRT1_DR
.set HALL_C1__INP_DIS, CYREG_PRT1_INP_DIS
.set HALL_C1__INTTYPE_BASE, CYDEV_PICU_INTTYPE_PICU1_BASE
.set HALL_C1__LCD_COM_SEG, CYREG_PRT1_LCD_COM_SEG
.set HALL_C1__LCD_EN, CYREG_PRT1_LCD_EN
.set HALL_C1__MASK, 0x80
.set HALL_C1__PORT, 1
.set HALL_C1__PRT, CYREG_PRT1_PRT
.set HALL_C1__PRTDSI__CAPS_SEL, CYREG_PRT1_CAPS_SEL
.set HALL_C1__PRTDSI__DBL_SYNC_IN, CYREG_PRT1_DBL_SYNC_IN
.set HALL_C1__PRTDSI__OE_SEL0, CYREG_PRT1_OE_SEL0
.set HALL_C1__PRTDSI__OE_SEL1, CYREG_PRT1_OE_SEL1
.set HALL_C1__PRTDSI__OUT_SEL0, CYREG_PRT1_OUT_SEL0
.set HALL_C1__PRTDSI__OUT_SEL1, CYREG_PRT1_OUT_SEL1
.set HALL_C1__PRTDSI__SYNC_OUT, CYREG_PRT1_SYNC_OUT
.set HALL_C1__PS, CYREG_PRT1_PS
.set HALL_C1__SHIFT, 7
.set HALL_C1__SLW, CYREG_PRT1_SLW

/* HALL_C2 */
.set HALL_C2__0__INTTYPE, CYREG_PICU12_INTTYPE4
.set HALL_C2__0__MASK, 0x10
.set HALL_C2__0__PC, CYREG_PRT12_PC4
.set HALL_C2__0__PORT, 12
.set HALL_C2__0__SHIFT, 4
.set HALL_C2__AG, CYREG_PRT12_AG
.set HALL_C2__BIE, CYREG_PRT12_BIE
.set HALL_C2__BIT_MASK, CYREG_PRT12_BIT_MASK
.set HALL_C2__BYP, CYREG_PRT12_BYP
.set HALL_C2__DM0, CYREG_PRT12_DM0
.set HALL_C2__DM1, CYREG_PRT12_DM1
.set HALL_C2__DM2, CYREG_PRT12_DM2
.set HALL_C2__DR, CYREG_PRT12_DR
.set HALL_C2__INP_DIS, CYREG_PRT12_INP_DIS
.set HALL_C2__INTTYPE_BASE, CYDEV_PICU_INTTYPE_PICU12_BASE
.set HALL_C2__MASK, 0x10
.set HALL_C2__PORT, 12
.set HALL_C2__PRT, CYREG_PRT12_PRT
.set HALL_C2__PRTDSI__DBL_SYNC_IN, CYREG_PRT12_DBL_SYNC_IN
.set HALL_C2__PRTDSI__OE_SEL0, CYREG_PRT12_OE_SEL0
.set HALL_C2__PRTDSI__OE_SEL1, CYREG_PRT12_OE_SEL1
.set HALL_C2__PRTDSI__OUT_SEL0, CYREG_PRT12_OUT_SEL0
.set HALL_C2__PRTDSI__OUT_SEL1, CYREG_PRT12_OUT_SEL1
.set HALL_C2__PRTDSI__SYNC_OUT, CYREG_PRT12_SYNC_OUT
.set HALL_C2__PS, CYREG_PRT12_PS
.set HALL_C2__SHIFT, 4
.set HALL_C2__SIO_CFG, CYREG_PRT12_SIO_CFG
.set HALL_C2__SIO_DIFF, CYREG_PRT12_SIO_DIFF
.set HALL_C2__SIO_HYST_EN, CYREG_PRT12_SIO_HYST_EN
.set HALL_C2__SIO_REG_HIFREQ, CYREG_PRT12_SIO_REG_HIFREQ
.set HALL_C2__SLW, CYREG_PRT12_SLW

/* REVERSE1 */
.set REVERSE1__0__INTTYPE, CYREG_PICU15_INTTYPE0
.set REVERSE1__0__MASK, 0x01
.set REVERSE1__0__PC, CYREG_IO_PC_PRT15_PC0
.set REVERSE1__0__PORT, 15
.set REVERSE1__0__SHIFT, 0
.set REVERSE1__AG, CYREG_PRT15_AG
.set REVERSE1__AMUX, CYREG_PRT15_AMUX
.set REVERSE1__BIE, CYREG_PRT15_BIE
.set REVERSE1__BIT_MASK, CYREG_PRT15_BIT_MASK
.set REVERSE1__BYP, CYREG_PRT15_BYP
.set REVERSE1__CTL, CYREG_PRT15_CTL
.set REVERSE1__DM0, CYREG_PRT15_DM0
.set REVERSE1__DM1, CYREG_PRT15_DM1
.set REVERSE1__DM2, CYREG_PRT15_DM2
.set REVERSE1__DR, CYREG_PRT15_DR
.set REVERSE1__INP_DIS, CYREG_PRT15_INP_DIS
.set REVERSE1__INTTYPE_BASE, CYDEV_PICU_INTTYPE_PICU15_BASE
.set REVERSE1__LCD_COM_SEG, CYREG_PRT15_LCD_COM_SEG
.set REVERSE1__LCD_EN, CYREG_PRT15_LCD_EN
.set REVERSE1__MASK, 0x01
.set REVERSE1__PORT, 15
.set REVERSE1__PRT, CYREG_PRT15_PRT
.set REVERSE1__PRTDSI__CAPS_SEL, CYREG_PRT15_CAPS_SEL
.set REVERSE1__PRTDSI__DBL_SYNC_IN, CYREG_PRT15_DBL_SYNC_IN
.set REVERSE1__PRTDSI__OE_SEL0, CYREG_PRT15_OE_SEL0
.set REVERSE1__PRTDSI__OE_SEL1, CYREG_PRT15_OE_SEL1
.set REVERSE1__PRTDSI__OUT_SEL0, CYREG_PRT15_OUT_SEL0
.set REVERSE1__PRTDSI__OUT_SEL1, CYREG_PRT15_OUT_SEL1
.set REVERSE1__PRTDSI__SYNC_OUT, CYREG_PRT15_SYNC_OUT
.set REVERSE1__PS, CYREG_PRT15_PS
.set REVERSE1__SHIFT, 0
.set REVERSE1__SLW, CYREG_PRT15_SLW

/* REVERSE2 */
.set REVERSE2__0__INTTYPE, CYREG_PICU15_INTTYPE1
.set REVERSE2__0__MASK, 0x02
.set REVERSE2__0__PC, CYREG_IO_PC_PRT15_PC1
.set REVERSE2__0__PORT, 15
.set REVERSE2__0__SHIFT, 1
.set REVERSE2__AG, CYREG_PRT15_AG
.set REVERSE2__AMUX, CYREG_PRT15_AMUX
.set REVERSE2__BIE, CYREG_PRT15_BIE
.set REVERSE2__BIT_MASK, CYREG_PRT15_BIT_MASK
.set REVERSE2__BYP, CYREG_PRT15_BYP
.set REVERSE2__CTL, CYREG_PRT15_CTL
.set REVERSE2__DM0, CYREG_PRT15_DM0
.set REVERSE2__DM1, CYREG_PRT15_DM1
.set REVERSE2__DM2, CYREG_PRT15_DM2
.set REVERSE2__DR, CYREG_PRT15_DR
.set REVERSE2__INP_DIS, CYREG_PRT15_INP_DIS
.set REVERSE2__INTTYPE_BASE, CYDEV_PICU_INTTYPE_PICU15_BASE
.set REVERSE2__LCD_COM_SEG, CYREG_PRT15_LCD_COM_SEG
.set REVERSE2__LCD_EN, CYREG_PRT15_LCD_EN
.set REVERSE2__MASK, 0x02
.set REVERSE2__PORT, 15
.set REVERSE2__PRT, CYREG_PRT15_PRT
.set REVERSE2__PRTDSI__CAPS_SEL, CYREG_PRT15_CAPS_SEL
.set REVERSE2__PRTDSI__DBL_SYNC_IN, CYREG_PRT15_DBL_SYNC_IN
.set REVERSE2__PRTDSI__OE_SEL0, CYREG_PRT15_OE_SEL0
.set REVERSE2__PRTDSI__OE_SEL1, CYREG_PRT15_OE_SEL1
.set REVERSE2__PRTDSI__OUT_SEL0, CYREG_PRT15_OUT_SEL0
.set REVERSE2__PRTDSI__OUT_SEL1, CYREG_PRT15_OUT_SEL1
.set REVERSE2__PRTDSI__SYNC_OUT, CYREG_PRT15_SYNC_OUT
.set REVERSE2__PS, CYREG_PRT15_PS
.set REVERSE2__SHIFT, 1
.set REVERSE2__SLW, CYREG_PRT15_SLW

/* Miscellaneous */
.set BCLK__BUS_CLK__HZ, 24000000
.set BCLK__BUS_CLK__KHZ, 24000
.set BCLK__BUS_CLK__MHZ, 24
.set CYDEV_CHIP_DIE_LEOPARD, 1
.set CYDEV_CHIP_DIE_PSOC4A, 18
.set CYDEV_CHIP_DIE_PSOC5LP, 2
.set CYDEV_CHIP_DIE_PSOC5TM, 3
.set CYDEV_CHIP_DIE_TMA4, 4
.set CYDEV_CHIP_DIE_UNKNOWN, 0
.set CYDEV_CHIP_FAMILY_FM0P, 5
.set CYDEV_CHIP_FAMILY_FM3, 6
.set CYDEV_CHIP_FAMILY_FM4, 7
.set CYDEV_CHIP_FAMILY_PSOC3, 1
.set CYDEV_CHIP_FAMILY_PSOC4, 2
.set CYDEV_CHIP_FAMILY_PSOC5, 3
.set CYDEV_CHIP_FAMILY_PSOC6, 4
.set CYDEV_CHIP_FAMILY_UNKNOWN, 0
.set CYDEV_CHIP_FAMILY_USED, CYDEV_CHIP_FAMILY_PSOC5
.set CYDEV_CHIP_JTAG_ID, 0x2E161069
.set CYDEV_CHIP_MEMBER_3A, 1
.set CYDEV_CHIP_MEMBER_4A, 18
.set CYDEV_CHIP_MEMBER_4D, 13
.set CYDEV_CHIP_MEMBER_4E, 6
.set CYDEV_CHIP_MEMBER_4F, 19
.set CYDEV_CHIP_MEMBER_4G, 4
.set CYDEV_CHIP_MEMBER_4H, 17
.set CYDEV_CHIP_MEMBER_4I, 23
.set CYDEV_CHIP_MEMBER_4J, 14
.set CYDEV_CHIP_MEMBER_4K, 15
.set CYDEV_CHIP_MEMBER_4L, 22
.set CYDEV_CHIP_MEMBER_4M, 21
.set CYDEV_CHIP_MEMBER_4N, 10
.set CYDEV_CHIP_MEMBER_4O, 7
.set CYDEV_CHIP_MEMBER_4P, 20
.set CYDEV_CHIP_MEMBER_4Q, 12
.set CYDEV_CHIP_MEMBER_4R, 8
.set CYDEV_CHIP_MEMBER_4S, 11
.set CYDEV_CHIP_MEMBER_4T, 9
.set CYDEV_CHIP_MEMBER_4U, 5
.set CYDEV_CHIP_MEMBER_4V, 16
.set CYDEV_CHIP_MEMBER_5A, 3
.set CYDEV_CHIP_MEMBER_5B, 2
.set CYDEV_CHIP_MEMBER_6A, 24
.set CYDEV_CHIP_MEMBER_FM3, 28
.set CYDEV_CHIP_MEMBER_FM4, 29
.set CYDEV_CHIP_MEMBER_PDL_FM0P_TYPE1, 25
.set CYDEV_CHIP_MEMBER_PDL_FM0P_TYPE2, 26
.set CYDEV_CHIP_MEMBER_PDL_FM0P_TYPE3, 27
.set CYDEV_CHIP_MEMBER_UNKNOWN, 0
.set CYDEV_CHIP_MEMBER_USED, CYDEV_CHIP_MEMBER_5B
.set CYDEV_CHIP_DIE_EXPECT, CYDEV_CHIP_MEMBER_USED
.set CYDEV_CHIP_DIE_ACTUAL, CYDEV_CHIP_DIE_EXPECT
.set CYDEV_CHIP_REV_LEOPARD_ES1, 0
.set CYDEV_CHIP_REV_LEOPARD_ES2, 1
.set CYDEV_CHIP_REV_LEOPARD_ES3, 3
.set CYDEV_CHIP_REV_LEOPARD_PRODUCTION, 3
.set CYDEV_CHIP_REV_PSOC4A_ES0, 17
.set CYDEV_CHIP_REV_PSOC4A_PRODUCTION, 17
.set CYDEV_CHIP_REV_PSOC5LP_ES0, 0
.set CYDEV_CHIP_REV_PSOC5LP_PRODUCTION, 0
.set CYDEV_CHIP_REV_PSOC5TM_ES0, 0
.set CYDEV_CHIP_REV_PSOC5TM_ES1, 1
.set CYDEV_CHIP_REV_PSOC5TM_PRODUCTION, 1
.set CYDEV_CHIP_REV_TMA4_ES, 17
.set CYDEV_CHIP_REV_TMA4_ES2, 33
.set CYDEV_CHIP_REV_TMA4_PRODUCTION, 17
.set CYDEV_CHIP_REVISION_3A_ES1, 0
.set CYDEV_CHIP_REVISION_3A_ES2, 1
.set CYDEV_CHIP_REVISION_3A_ES3, 3
.set CYDEV_CHIP_REVISION_3A_PRODUCTION, 3
.set CYDEV_CHIP_REVISION_4A_ES0, 17
.set CYDEV_CHIP_REVISION_4A_PRODUCTION, 17
.set CYDEV_CHIP_REVISION_4D_PRODUCTION, 0
.set CYDEV_CHIP_REVISION_4E_CCG2_NO_USBPD, 0
.set CYDEV_CHIP_REVISION_4E_PRODUCTION, 0
.set CYDEV_CHIP_REVISION_4F_PRODUCTION, 0
.set CYDEV_CHIP_REVISION_4F_PRODUCTION_256DMA, 0
.set CYDEV_CHIP_REVISION_4F_PRODUCTION_256K, 0
.set CYDEV_CHIP_REVISION_4G_ES, 17
.set CYDEV_CHIP_REVISION_4G_ES2, 33
.set CYDEV_CHIP_REVISION_4G_PRODUCTION, 17
.set CYDEV_CHIP_REVISION_4H_PRODUCTION, 0
.set CYDEV_CHIP_REVISION_4I_PRODUCTION, 0
.set CYDEV_CHIP_REVISION_4J_PRODUCTION, 0
.set CYDEV_CHIP_REVISION_4K_PRODUCTION, 0
.set CYDEV_CHIP_REVISION_4L_PRODUCTION, 0
.set CYDEV_CHIP_REVISION_4M_PRODUCTION, 0
.set CYDEV_CHIP_REVISION_4N_PRODUCTION, 0
.set CYDEV_CHIP_REVISION_4O_PRODUCTION, 0
.set CYDEV_CHIP_REVISION_4P_PRODUCTION, 0
.set CYDEV_CHIP_REVISION_4Q_PRODUCTION, 0
.set CYDEV_CHIP_REVISION_4R_PRODUCTION, 0
.set CYDEV_CHIP_REVISION_4S_PRODUCTION, 0
.set CYDEV_CHIP_REVISION_4T_PRODUCTION, 0
.set CYDEV_CHIP_REVISION_4U_PRODUCTION, 0
.set CYDEV_CHIP_REVISION_4V_PRODUCTION, 0
.set CYDEV_CHIP_REVISION_5A_ES0, 0
.set CYDEV_CHIP_REVISION_5A_ES1, 1
.set CYDEV_CHIP_REVISION_5A_PRODUCTION, 1
.set CYDEV_CHIP_REVISION_5B_ES0, 0
.set CYDEV_CHIP_REVISION_5B_PRODUCTION, 0
.set CYDEV_CHIP_REVISION_6A_ES, 17
.set CYDEV_CHIP_REVISION_6A_NO_UDB, 33
.set CYDEV_CHIP_REVISION_6A_PRODUCTION, 33
.set CYDEV_CHIP_REVISION_FM3_PRODUCTION, 0
.set CYDEV_CHIP_REVISION_FM4_PRODUCTION, 0
.set CYDEV_CHIP_REVISION_PDL_FM0P_TYPE1_PRODUCTION, 0
.set CYDEV_CHIP_REVISION_PDL_FM0P_TYPE2_PRODUCTION, 0
.set CYDEV_CHIP_REVISION_PDL_FM0P_TYPE3_PRODUCTION, 0
.set CYDEV_CHIP_REVISION_USED, CYDEV_CHIP_REVISION_5B_PRODUCTION
.set CYDEV_CHIP_REV_EXPECT, CYDEV_CHIP_REVISION_USED
.set CYDEV_CONFIG_FASTBOOT_ENABLED, 1
.set CYDEV_CONFIG_UNUSED_IO_AllowButWarn, 0
.set CYDEV_CONFIG_UNUSED_IO, CYDEV_CONFIG_UNUSED_IO_AllowButWarn
.set CYDEV_CONFIG_UNUSED_IO_AllowWithInfo, 1
.set CYDEV_CONFIG_UNUSED_IO_Disallowed, 2
.set CYDEV_CONFIGURATION_COMPRESSED, 1
.set CYDEV_CONFIGURATION_DMA, 0
.set CYDEV_CONFIGURATION_ECC, 1
.set CYDEV_CONFIGURATION_IMOENABLED, CYDEV_CONFIG_FASTBOOT_ENABLED
.set CYDEV_CONFIGURATION_MODE_COMPRESSED, 0
.set CYDEV_CONFIGURATION_MODE, CYDEV_CONFIGURATION_MODE_COMPRESSED
.set CYDEV_CONFIGURATION_MODE_DMA, 2
.set CYDEV_CONFIGURATION_MODE_UNCOMPRESSED, 1
.set CYDEV_DEBUG_ENABLE_MASK, 0x20
.set CYDEV_DEBUG_ENABLE_REGISTER, CYREG_MLOGIC_DEBUG
.set CYDEV_DEBUGGING_DPS_Disable, 3
.set CYDEV_DEBUGGING_DPS_JTAG_4, 1
.set CYDEV_DEBUGGING_DPS_JTAG_5, 0
.set CYDEV_DEBUGGING_DPS_SWD, 2
.set CYDEV_DEBUGGING_DPS_SWD_SWV, 6
.set CYDEV_DEBUGGING_DPS, CYDEV_DEBUGGING_DPS_SWD_SWV
.set CYDEV_DEBUGGING_ENABLE, 1
.set CYDEV_DEBUGGING_XRES, 0
.set CYDEV_DMA_CHANNELS_AVAILABLE, 24
.set CYDEV_ECC_ENABLE, 0
.set CYDEV_HEAP_SIZE, 0x80
.set CYDEV_INSTRUCT_CACHE_ENABLED, 1
.set CYDEV_INTR_RISING, 0x00000000
.set CYDEV_IS_EXPORTING_CODE, 0
.set CYDEV_IS_IMPORTING_CODE, 0
.set CYDEV_PROJ_TYPE, 0
.set CYDEV_PROJ_TYPE_BOOTLOADER, 1
.set CYDEV_PROJ_TYPE_LAUNCHER, 5
.set CYDEV_PROJ_TYPE_LOADABLE, 2
.set CYDEV_PROJ_TYPE_LOADABLEANDBOOTLOADER, 4
.set CYDEV_PROJ_TYPE_MULTIAPPBOOTLOADER, 3
.set CYDEV_PROJ_TYPE_STANDARD, 0
.set CYDEV_PROTECTION_ENABLE, 0
.set CYDEV_STACK_SIZE, 0x0800
.set CYDEV_USE_BUNDLED_CMSIS, 1
.set CYDEV_VARIABLE_VDDA, 0
.set CYDEV_VDDA_MV, 5000
.set CYDEV_VDDD_MV, 5000
.set CYDEV_VDDIO0_MV, 5000
.set CYDEV_VDDIO1_MV, 5000
.set CYDEV_VDDIO2_MV, 5000
.set CYDEV_VDDIO3_MV, 5000
.set CYDEV_VIO0_MV, 5000
.set CYDEV_VIO1_MV, 5000
.set CYDEV_VIO2_MV, 5000
.set CYDEV_VIO3_MV, 5000
.set CYIPBLOCK_ARM_CM3_VERSION, 0
.set CYIPBLOCK_P3_ANAIF_VERSION, 0
.set CYIPBLOCK_P3_CAN_VERSION, 0
.set CYIPBLOCK_P3_CAPSENSE_VERSION, 0
.set CYIPBLOCK_P3_COMP_VERSION, 0
.set CYIPBLOCK_P3_DECIMATOR_VERSION, 0
.set CYIPBLOCK_P3_DFB_VERSION, 0
.set CYIPBLOCK_P3_DMA_VERSION, 0
.set CYIPBLOCK_P3_DRQ_VERSION, 0
.set CYIPBLOCK_P3_DSM_VERSION, 0
.set CYIPBLOCK_P3_EMIF_VERSION, 0
.set CYIPBLOCK_P3_I2C_VERSION, 0
.set CYIPBLOCK_P3_LCD_VERSION, 0
.set CYIPBLOCK_P3_LPF_VERSION, 0
.set CYIPBLOCK_P3_OPAMP_VERSION, 0
.set CYIPBLOCK_P3_PM_VERSION, 0
.set CYIPBLOCK_P3_SCCT_VERSION, 0
.set CYIPBLOCK_P3_TIMER_VERSION, 0
.set CYIPBLOCK_P3_USB_VERSION, 0
.set CYIPBLOCK_P3_VIDAC_VERSION, 0
.set CYIPBLOCK_P3_VREF_VERSION, 0
.set CYIPBLOCK_S8_GPIO_VERSION, 0
.set CYIPBLOCK_S8_IRQ_VERSION, 0
.set CYIPBLOCK_S8_SAR_VERSION, 0
.set CYIPBLOCK_S8_SIO_VERSION, 0
.set CYIPBLOCK_S8_UDB_VERSION, 0
.set DMA_CHANNELS_USED__MASK0, 0x00000000
.set CYDEV_BOOTLOADER_ENABLE, 0
.endif
